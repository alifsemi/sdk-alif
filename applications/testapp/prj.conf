## CMakeLists.txt
```
# Copyright (C) 2023 Alif Semiconductor - All Rights Reserved.
# Use, distribution and modification of this code is permitted under the
# terms stated in the Alif Semiconductor Software License Agreement
#
# You should have received a copy of the Alif Semiconductor Software
# License Agreement with this file. If not, please write to:
# contact@alifsemi.com, or visit: https://alifsemi.com/license

cmake_minimum_required(VERSION 3.20.0)

if(NOT zephyr-bluetooth-shell IN_LIST SNIPPET)
  # Include Zephyr BT shell snippet by default
  set(SNIPPET zephyr-bluetooth-shell ${SNIPPET} CACHE STRING "" FORCE)
endif()

find_package(Zephyr REQUIRED HINTS $ENV{ZEPHYR_BASE})
project(test_application)

target_sources(app PRIVATE
  src/main.c
)
```

## prj.conf
```kconfig
## Enable networking
CONFIG_NETWORKING=y
CONFIG_NET_UDP=y
CONFIG_NET_IPV6=y
CONFIG_NET_SOCKETS=y


# Usage:
# `kernel log-level modulename severity`
# e.g.,
#
# kernel log-level bt_hci_core 0
# kernel log-level bt_l2cap 2
# kernel log-level bt_att 4
CONFIG_LOG_RUNTIME_FILTERING=n
```

## overlay-ethosu.conf
```kconfig
## Ethos-U subsystem shell
CONFIG_ALIF_ETHOSU_SHELL=y
CONFIG_STD_CPP17=y
CONFIG_HEAP_MEM_POOL_SIZE=16384
CONFIG_NEWLIB_LIBC_MIN_REQUIRED_HEAP_SIZE=8192
```

## overlay-sed.conf
```kconfig
CONFIG_OPENTHREAD_MTD=y
CONFIG_OPENTHREAD_FTD=n
CONFIG_OPENTHREAD_MTD_SED=y
CONFIG_OPENTHREAD_POLL_PERIOD=1000
CONFIG_OPENTHREAD_CSL_RECEIVER=y
CONFIG_OPENTHREAD_CSL_AUTO_SYNC=y
CONFIG_OPENTHREAD_CSL_TIMEOUT=40
CONFIG_OPENTHREAD_CSL_RECEIVE_TIME_AHEAD=15000
CONFIG_OPENTHREAD_MIN_RECEIVE_ON_AHEAD=2000
CONFIG_OPENTHREAD_MIN_RECEIVE_ON_AFTER=15000
CONFIG_OPENTHREAD_CHILD_SUPERVISION_INTERVAL=40
```

## boards/alif_b1_dk_ab1c1f4m51820ph0_rtss_he.conf
```kconfig
## Net configuration
CONFIG_NET_L2_OPENTHREAD=y
CONFIG_NET_PKT_TXTIME=y
CONFIG_NET_PKT_TIMESTAMP=y
CONFIG_NET_TCP=n
CONFIG_NET_IPV6_NBR_CACHE=n
CONFIG_NET_IPV6_MLD=n
CONFIG_NET_CONFIG_NEED_IPV4=n

CONFIG_OPENTHREAD_MANUAL_START=y
## Openthread parameters
CONFIG_OPENTHREAD_SHELL=y
CONFIG_OPENTHREAD_THREAD_VERSION_1_3=y
CONFIG_OPENTHREAD_PANID=4660
CONFIG_OPENTHREAD_CHANNEL=11
CONFIG_OPENTHREAD_NETWORKKEY="00:11:22:33:44:55:66:77:88:99:aa:bb:cc:dd:ee:ff"
CONFIG_OPENTHREAD_PING_SENDER=y

# Increased stack due to settings API usage
CONFIG_SYSTEM_WORKQUEUE_STACK_SIZE=2048

CONFIG_TEST=n
CONFIG_TEST_LOGGING_DEFAULTS=n

# Increase default MbedTLS default heap size
CONFIG_MBEDTLS_HEAP_SIZE=30000

# Usage:
# `kernel log-level modulename severity`
# e.g.,
#
# kernel log-level bt_hci_core 0
# kernel log-level bt_l2cap 2
# kernel log-level bt_att 4
CONFIG_LOG_RUNTIME_FILTERING=y

CONFIG_ALIF_CERT_SHELL=y
```

## boards/alif_b1_dk_rtss_he.conf
```kconfig
## Net configuration
CONFIG_NET_L2_OPENTHREAD=y
CONFIG_NET_PKT_TXTIME=y
CONFIG_NET_PKT_TIMESTAMP=y
CONFIG_NET_TCP=n
CONFIG_NET_IPV6_NBR_CACHE=n
CONFIG_NET_IPV6_MLD=n
CONFIG_NET_CONFIG_NEED_IPV4=n

CONFIG_OPENTHREAD_MANUAL_START=y
## Openthread parameters
CONFIG_OPENTHREAD_SHELL=y
CONFIG_OPENTHREAD_THREAD_VERSION_1_3=y
CONFIG_OPENTHREAD_PANID=4660
CONFIG_OPENTHREAD_CHANNEL=11
CONFIG_OPENTHREAD_NETWORKKEY="00:11:22:33:44:55:66:77:88:99:aa:bb:cc:dd:ee:ff"
CONFIG_OPENTHREAD_PING_SENDER=y

# Increased stack due to settings API usage
CONFIG_SYSTEM_WORKQUEUE_STACK_SIZE=2048

CONFIG_TEST=n
CONFIG_TEST_LOGGING_DEFAULTS=n
CONFIG_BT=y
CONFIG_LOG=y
CONFIG_BT_CENTRAL=y
CONFIG_BT_PERIPHERAL=y
CONFIG_BT_PRIVACY=y
CONFIG_BT_SMP=y
CONFIG_BT_PASSKEY_KEYPRESS=y
CONFIG_BT_SIGNING=y
CONFIG_BT_FIXED_PASSKEY=y
CONFIG_BT_ATT_PREPARE_COUNT=2
CONFIG_BT_GATT_CLIENT=y
CONFIG_BT_L2CAP_DYNAMIC_CHANNEL=y
CONFIG_BT_SHELL=y
CONFIG_BT_DEVICE_NAME="test shell"
CONFIG_BT_DEVICE_NAME_DYNAMIC=y
CONFIG_BT_L2CAP_TX_BUF_COUNT=4
CONFIG_BT_ID_MAX=2
CONFIG_BT_EATT=y
CONFIG_BT_L2CAP_ECRED=y
CONFIG_BT_GATT_DYNAMIC_DB=y
CONFIG_BT_GATT_NOTIFY_MULTIPLE=y
CONFIG_BT_HRS=y
CONFIG_BT_FILTER_ACCEPT_LIST=y
CONFIG_BT_REMOTE_INFO=y
CONFIG_BT_REMOTE_VERSION=y
CONFIG_BT_GATT_AUTO_DISCOVER_CCC=y

CONFIG_BT_SETTINGS=y
CONFIG_FLASH=y
CONFIG_FLASH_MAP=y
CONFIG_NVS=y
CONFIG_SETTINGS=y

CONFIG_BT_EXT_ADV=y
CONFIG_BT_EXT_ADV_LEGACY_SUPPORT=y
CONFIG_BT_PER_ADV=y
CONFIG_BT_PER_ADV_SYNC=y

CONFIG_BT_USER_DATA_LEN_UPDATE=y
CONFIG_BT_AUTO_DATA_LEN_UPDATE=y

CONFIG_BT_EAD=y

CONFIG_BT_USER_PHY_UPDATE=y
CONFIG_BT_AUTO_PHY_UPDATE=y

CONFIG_BT_ISO_BROADCASTER=y
CONFIG_BT_ISO_SYNC_RECEIVER=y
CONFIG_BT_ISO_CENTRAL=y
CONFIG_BT_ISO_PERIPHERAL=y

# Support multiple connections
CONFIG_BT_MAX_CONN=8

# Increase default MbedTLS default heap size
CONFIG_MBEDTLS_HEAP_SIZE=30000

# Usage:
# `kernel log-level modulename severity`
# e.g.,
#
# kernel log-level bt_hci_core 0
# kernel log-level bt_l2cap 2
# kernel log-level bt_att 4
CONFIG_LOG_RUNTIME_FILTERING=y
```

## boards/alif_b1_eb_ab1c1f4m51820ph0_rtss_he.conf
```kconfig
## Net configuration
CONFIG_NET_L2_OPENTHREAD=y
CONFIG_NET_PKT_TXTIME=y
CONFIG_NET_PKT_TIMESTAMP=y
CONFIG_NET_TCP=n
CONFIG_NET_IPV6_NBR_CACHE=n
CONFIG_NET_IPV6_MLD=n
CONFIG_NET_CONFIG_NEED_IPV4=n

CONFIG_OPENTHREAD_MANUAL_START=y
## Openthread parameters
CONFIG_OPENTHREAD_SHELL=y
CONFIG_OPENTHREAD_THREAD_VERSION_1_3=y
CONFIG_OPENTHREAD_PANID=4660
CONFIG_OPENTHREAD_CHANNEL=11
CONFIG_OPENTHREAD_NETWORKKEY="00:11:22:33:44:55:66:77:88:99:aa:bb:cc:dd:ee:ff"
CONFIG_OPENTHREAD_PING_SENDER=y

# Increased stack due to settings API usage
CONFIG_SYSTEM_WORKQUEUE_STACK_SIZE=2048

CONFIG_TEST=n
CONFIG_TEST_LOGGING_DEFAULTS=n

# Increase default MbedTLS default heap size
CONFIG_MBEDTLS_HEAP_SIZE=30000

# Usage:
# `kernel log-level modulename severity`
# e.g.,
#
# kernel log-level bt_hci_core 0
# kernel log-level bt_l2cap 2
# kernel log-level bt_att 4
CONFIG_LOG_RUNTIME_FILTERING=y
```

## boards/alif_b1_fpga_ble_rtss_he.conf
```kconfig
## OpenThread configuration
CONFIG_NEWLIB_LIBC=y
CONFIG_NET_L2_OPENTHREAD=y

CONFIG_NET_TCP=n
CONFIG_NET_IPV6_NBR_CACHE=n
CONFIG_NET_IPV6_MLD=n
CONFIG_NET_CONFIG_NEED_IPV4=n

## Openthread parameters
CONFIG_OPENTHREAD_THREAD_VERSION_1_3=y
CONFIG_OPENTHREAD_PANID=4660
CONFIG_OPENTHREAD_CHANNEL=11
CONFIG_OPENTHREAD_NETWORKKEY="00:11:22:33:44:55:66:77:88:99:aa:bb:cc:dd:ee:ff"

## BT configuration
# Increased stack due to settings API usage
CONFIG_SYSTEM_WORKQUEUE_STACK_SIZE=2048

CONFIG_TEST=n
CONFIG_TEST_LOGGING_DEFAULTS=n
CONFIG_BT=y
CONFIG_BT_DEBUG_LOG=y
CONFIG_BT_CENTRAL=y
CONFIG_BT_PERIPHERAL=y
CONFIG_BT_PRIVACY=y
CONFIG_BT_SMP=y
CONFIG_BT_SIGNING=y
CONFIG_BT_FIXED_PASSKEY=y
CONFIG_BT_ATT_PREPARE_COUNT=2
CONFIG_BT_GATT_CLIENT=y
CONFIG_BT_L2CAP_DYNAMIC_CHANNEL=y
CONFIG_BT_TINYCRYPT_ECC=y
CONFIG_BT_SHELL=y
CONFIG_BT_DEVICE_NAME="test shell"
CONFIG_BT_DEVICE_NAME_DYNAMIC=y
CONFIG_BT_L2CAP_TX_BUF_COUNT=4
CONFIG_BT_ID_MAX=2
CONFIG_BT_EATT=y
CONFIG_BT_L2CAP_ECRED=y
CONFIG_BT_GATT_DYNAMIC_DB=y
CONFIG_BT_GATT_NOTIFY_MULTIPLE=y
CONFIG_BT_HRS=y
CONFIG_BT_FILTER_ACCEPT_LIST=y
CONFIG_BT_REMOTE_INFO=y
CONFIG_BT_REMOTE_VERSION=y
CONFIG_BT_GATT_AUTO_DISCOVER_CCC=y

CONFIG_BT_SETTINGS=y
CONFIG_FLASH=y
CONFIG_FLASH_PAGE_LAYOUT=y
CONFIG_FLASH_MAP=y
CONFIG_NVS=y
CONFIG_SETTINGS=y

CONFIG_BT_EXT_ADV=y
CONFIG_BT_EXT_ADV_LEGACY_SUPPORT=y
CONFIG_BT_PER_ADV=y
CONFIG_BT_PER_ADV_SYNC=y

CONFIG_BT_USER_DATA_LEN_UPDATE=y
CONFIG_BT_AUTO_DATA_LEN_UPDATE=y

CONFIG_BT_USER_PHY_UPDATE=y
CONFIG_BT_AUTO_PHY_UPDATE=y

CONFIG_BT_ISO_BROADCASTER=y
CONFIG_BT_ISO_SYNC_RECEIVER=y
CONFIG_BT_ISO_CENTRAL=y
CONFIG_BT_ISO_PERIPHERAL=y
```

## src/main.c
```c
/* Copyright (C) 2024 Alif Semiconductor - All Rights Reserved.
 * Use, distribution and modification of this code is permitted under the
 * terms stated in the Alif Semiconductor Software License Agreement
 *
 * You should have received a copy of the Alif Semiconductor Software
 * License Agreement with this file. If not, please write to:
 * contact@alifsemi.com, or visit: https://alifsemi.com/license
 */

#include <errno.h>
#include <zephyr/types.h>
#include <stddef.h>
#include <stdlib.h>
#include <string.h>
#include <zephyr/sys/printk.h>
#include <zephyr/sys/byteorder.h>
#include <zephyr/kernel.h>
#include <zephyr/usb/usb_device.h>
#include <zephyr/drivers/uart.h>

#include <zephyr/shell/shell.h>

#include <zephyr/bluetooth/hci.h>
#include <zephyr/bluetooth/bluetooth.h>
#include <zephyr/bluetooth/uuid.h>
#include <zephyr/bluetooth/services/hrs.h>

#include <se_service.h>
#include <es0_power_manager.h>

/**
 * Set the RUN profile parameters for this application.
 */
static int app_set_run_params(void)
{
	run_profile_t runp;
	int ret;

	runp.power_domains =
		PD_VBAT_AON_MASK | PD_SYST_MASK | PD_SSE700_AON_MASK | PD_DBSS_MASK | PD_SESS_MASK;
	runp.dcdc_voltage  = 775;
	runp.dcdc_mode = DCDC_MODE_PFM_FORCED;
	runp.aon_clk_src   = CLK_SRC_LFXO;
	runp.run_clk_src   = CLK_SRC_PLL;
	runp.cpu_clk_freq = CLOCK_FREQUENCY_160MHZ;
	runp.phy_pwr_gating = 0;
	runp.ip_clock_gating = LP_PERIPH_MASK;
	runp.vdd_ioflex_3V3 = IOFLEX_LEVEL_1V8;
	runp.scaled_clk_freq = SCALED_FREQ_XO_HIGH_DIV_38_4_MHZ;

	runp.memory_blocks = MRAM_MASK;
	runp.memory_blocks |= SRAM2_MASK | SRAM3_MASK;
	runp.memory_blocks |= SERAM_1_MASK | SERAM_2_MASK | SERAM_3_MASK | SERAM_4_MASK;
	runp.memory_blocks |=
		SRAM4_1_MASK | SRAM4_2_MASK | SRAM4_3_MASK | SRAM4_4_MASK; /* M55-HE ITCM */
	runp.memory_blocks |= SRAM5_1_MASK | SRAM5_2_MASK | SRAM5_3_MASK | SRAM5_4_MASK |
			      SRAM5_5_MASK; /* M55-HE DTCM */

	if (IS_ENABLED(CONFIG_MIPI_DSI)) {
		runp.phy_pwr_gating |= MIPI_TX_DPHY_MASK | MIPI_RX_DPHY_MASK | MIPI_PLL_DPHY_MASK;
		runp.ip_clock_gating |= CDC200_MASK | MIPI_DSI_MASK | GPU_MASK;
	}

	ret = se_service_set_run_cfg(&runp);
	__ASSERT(ret == 0, "SE: set_run_cfg failed = %d", ret);

	return ret;
}
/*
 * CRITICAL: Must run at PRE_KERNEL_1 to restore SYSTOP before peripherals initialize.
 *
 * On cold boot: SYSTOP is already ON by default, safe to call.
 * On SOFT_OFF wakeup: SYSTOP is OFF, must restore BEFORE peripherals access registers.
 */
SYS_INIT(app_set_run_params, PRE_KERNEL_1, 3);

int main(void)
{
	printk("Type \"help\" for supported commands.\n");
	printk("Type \"cert\" for certification information.\n");

	while (1) {
		k_sleep(K_SECONDS(1));
	}
	return 0;
}
```

## src/cert.c
```c
/* Copyright (C) 2024 Alif Semiconductor - All Rights Reserved.
 * Use, distribution and modification of this code is permitted under the
 * terms stated in the Alif Semiconductor Software License Agreement
 *
 * You should have received a copy of the Alif Semiconductor Software
 * License Agreement with this file. If not, please write to:
 * contact@alifsemi.com, or visit: https://alifsemi.com/license
 */

#include <zephyr/kernel.h>
#include <zephyr/shell/shell.h>
#include <stdlib.h>
#include <string.h>

#define CERT_BUF_SIZE 16

/* Tracks which menu step the user is currently on. */
enum cert_state {
	CERT_STATE_MODEL,
	CERT_STATE_CERT_TYPE,
};

/* Runtime context for the interactive cert menu. Reset on each invocation. */
static struct {
	enum cert_state state;
	int model; /* 1 = DevKit, 2 = StartKit */
	char buf[CERT_BUF_SIZE];
	int buf_pos;
} cert_ctx;

/* Holds the display strings for a single product model. */
struct cert_info {
	const char *brand;
	const char *model_name;
	const char *fcc_id;
	const char *ised_id;
	const char *ncc_id;
	const char *jp_id;
};

/* Update the ID strings below once real cert IDs are available. Index 0 unused. */
static const struct cert_info cert_db[] = {
	[1] = { /* DevKit */
		.brand      = "Balletto DevKit",
		.model_name = "DK-B1",
		.fcc_id     = "2A58G-DKB1",
		.ised_id    = "xyz",
		.ncc_id     = "xyz",
		.jp_id      = "xyz",
	},
	[2] = { /* StartKit */
		.brand      = "Balletto StartKit",
		.model_name = "SK-B1",
		.fcc_id     = "xyz",
		.ised_id    = "xyz",
		.ncc_id     = "xyz",
		.jp_id      = "xyz",
	},
};

/* Prints the certification ID, brand name, and model name for the given
 * model + cert type selection.
 */
static void print_cert_info(const struct shell *sh, int model, int cert_type)
{
	const struct cert_info *info = &cert_db[model];
	const char *id_label;
	const char *id_value;

	switch (cert_type) {
	case 1:
		id_label = "FCC ID";
		id_value = info->fcc_id;
		break;
	case 2:
		id_label = "ISED ID";
		id_value = info->ised_id;
		break;
	case 3:
		id_label = "NCC ID";
		id_value = info->ncc_id;
		break;
	case 4:
		id_label = "JP ID";
		id_value = info->jp_id;
		break;
	default:
		return;
	}

	shell_print(sh, "%s: %s", id_label, id_value);
	shell_print(sh, "Brand Name: %s", info->brand);
	shell_print(sh, "Model Name: %s", info->model_name);
}

/* Raw keystroke handler. The shell calls this instead of its normal command
 * processing while the menu is active. Calling shell_set_bypass(sh, NULL)
 * exits bypass mode and returns control to the shell.
 */
static void cert_bypass_cb(const struct shell *sh, uint8_t *recv, size_t len)
{
	for (size_t i = 0; i < len; i++) {
		char c = (char)recv[i];

		if (c == '\r' || c == '\n') {
			if (cert_ctx.buf_pos == 0) {
				continue;
			}

			shell_fprintf(sh, SHELL_NORMAL, "\n");
			cert_ctx.buf[cert_ctx.buf_pos] = '\0';
			cert_ctx.buf_pos = 0;

			int choice = atoi(cert_ctx.buf);

			if (cert_ctx.state == CERT_STATE_MODEL) {
				if (choice == 1 || choice == 2) {
					cert_ctx.model = choice;
					const char *name = (choice == 1) ? "DevKit" : "StartKit";

					shell_print(sh, "Selected: %s", name);
					cert_ctx.state = CERT_STATE_CERT_TYPE;
					shell_print(sh, "\nSelect certification:");
					shell_print(sh, "1. FCC");
					shell_print(sh, "2. ISED");
					shell_print(sh, "3. NCC");
					shell_print(sh, "4. JP");
					shell_print(sh, "0. Exit");
					shell_print(sh, "");
				} else {
					shell_error(sh, "Invalid choice. Please enter 1 or 2.");
					shell_print(sh, "1. DevKit");
					shell_print(sh, "2. StartKit");
					shell_print(sh, "");
				}
			} else {
				if (choice == 0) {
					shell_set_bypass(sh, NULL);
				} else if (choice >= 1 && choice <= 4) {
					shell_print(sh, "");
					print_cert_info(sh, cert_ctx.model, choice);
					shell_print(sh, "\nSelect certification:");
					shell_print(sh, "1. FCC");
					shell_print(sh, "2. ISED");
					shell_print(sh, "3. NCC");
					shell_print(sh, "4. JP");
					shell_print(sh, "0. Exit");
					shell_print(sh, "");
				} else {
					shell_error(sh, "Invalid choice. Please enter 0-4.");
					shell_print(sh, "1. FCC");
					shell_print(sh, "2. ISED");
					shell_print(sh, "3. NCC");
					shell_print(sh, "4. JP");
					shell_print(sh, "0. Exit");
					shell_print(sh, "");
				}
			}
		} else if (cert_ctx.buf_pos < CERT_BUF_SIZE - 1) {
			/* Echo the character so the user can see what they typed */
			shell_fprintf(sh, SHELL_NORMAL, "%c", c);
			cert_ctx.buf[cert_ctx.buf_pos++] = c;
		}
	}
}

/* Shell command handler for "cert". Resets state and shows the first menu,
 * then hands raw input over to cert_bypass_cb until the flow completes.
 */
static int cmd_cert(const struct shell *sh, size_t argc, char **argv)
{
	ARG_UNUSED(argc);
	ARG_UNUSED(argv);

	memset(&cert_ctx, 0, sizeof(cert_ctx));
	cert_ctx.state = CERT_STATE_MODEL;

	shell_print(sh, "Select model:");
	shell_print(sh, "1. DevKit");
	shell_print(sh, "2. StartKit");
	shell_print(sh, "");

	shell_set_bypass(sh, cert_bypass_cb);

	return 0;
}

SHELL_CMD_REGISTER(cert, NULL, "Display certification information", cmd_cert);
```
