## applications/testapp/boards/alif_b1_sk_ab1c1f4m51820ph0_rtss_he.conf
```kconfig
## Net configuration
CONFIG_NET_L2_OPENTHREAD=y
CONFIG_NET_PKT_TXTIME=y
CONFIG_NET_PKT_TIMESTAMP=y
CONFIG_NET_TCP=n
CONFIG_NET_IPV6_NBR_CACHE=n
CONFIG_NET_IPV6_MLD=n
CONFIG_NET_CONFIG_NEED_IPV4=n

CONFIG_OPENTHREAD_MANUAL_START=y
## Openthread parameters
CONFIG_OPENTHREAD_SHELL=y
CONFIG_OPENTHREAD_THREAD_VERSION_1_3=y
CONFIG_OPENTHREAD_PANID=4660
CONFIG_OPENTHREAD_CHANNEL=11
CONFIG_OPENTHREAD_NETWORKKEY="00:11:22:33:44:55:66:77:88:99:aa:bb:cc:dd:ee:ff"
CONFIG_OPENTHREAD_PING_SENDER=y

# Increased stack due to settings API usage
CONFIG_SYSTEM_WORKQUEUE_STACK_SIZE=2048

CONFIG_TEST=n
CONFIG_TEST_LOGGING_DEFAULTS=n

# Increase default MbedTLS default heap size
CONFIG_MBEDTLS_HEAP_SIZE=30000

# Usage:
# `kernel log-level modulename severity`
# e.g.,
#
# kernel log-level bt_hci_core 0
# kernel log-level bt_l2cap 2
# kernel log-level bt_att 4
CONFIG_LOG_RUNTIME_FILTERING=y
```

## boards/alif/alif_b1_eb/Kconfig.alif_b1_eb
```kconfig
# Copyright (C) 2025 Alif Semiconductor - All Rights Reserved.
# Use, distribution and modification of this code is permitted under the
# terms stated in the Alif Semiconductor Software License Agreement
#
# You should have received a copy of the Alif Semiconductor Software
# License Agreement with this file. If not, please write to:
# contact@alifsemi.com, or visit: https://alifsemi.com/license

config BOARD_ALIF_B1_EB
	select SOC_AB1C1F4M51820HH0_RTSS_HE if BOARD_ALIF_B1_EB_AB1C1F4M51820HH0_RTSS_HE

if BOARD_ALIF_B1_EB
config UART_DMA_ENABLE
	bool
endif
```

## boards/alif/alif_b1_eb/Kconfig.defconfig
```kconfig
# Copyright (C) 2025 Alif Semiconductor - All Rights Reserved.
# Use, distribution and modification of this code is permitted under the
# terms stated in the Alif Semiconductor Software License Agreement
#
# You should have received a copy of the Alif Semiconductor Software
# License Agreement with this file. If not, please write to:
# contact@alifsemi.com, or visit: https://alifsemi.com/license

config MAIN_STACK_SIZE
	default 4096

config BT_BUF_ACL_RX_SIZE
	range 251 65535
	default 251

config BT_BUF_EVT_RX_COUNT
	default 20 if (BT_MESH && !(BT_BUF_EVT_DISCARDABLE_COUNT > 0))
	default 10
	range 10 255

config BT_BUF_ACL_TX_COUNT
	default 6
	range 6 255

config UART_DMA_ENABLE
	default n if BT
	default n if IEEE802154_ALIF_SUPPORT
	select DMA
	select UART_ASYNC_API
	select RING_BUFFER
```

## boards/alif/alif_b1_eb/alif_b1_eb_ab1c1f4m51820hh_rtss_he_defconfig
```kconfig
# Copyright (C) 2025 Alif Semiconductor - All Rights Reserved.
# Use, distribution and modification of this code is permitted under the
# terms stated in the Alif Semiconductor Software License Agreement
#
# You should have received a copy of the Alif Semiconductor Software
# License Agreement with this file. If not, please write to:
# contact@alifsemi.com, or visit: https://alifsemi.com/license

CONFIG_CORTEX_M_SYSTICK=y
CONFIG_XIP=y
CONFIG_RUNTIME_NMI=y
CONFIG_ARM_MPU=y
CONFIG_PINCTRL=y
CONFIG_FPU=y
CONFIG_FP_HARDABI=y
CONFIG_SOC_SUPPORT_ARM_MHUV2=y

CONFIG_SERIAL=y
CONFIG_CONSOLE=y
CONFIG_UART_CONSOLE=y
CONFIG_UART_INTERRUPT_DRIVEN=y
CONFIG_UART_NS16550=y
# UART variant of ns16550 that supports auto flow control
CONFIG_UART_NS16550_VARIANT_NS16750=y
# Support break condition
CONFIG_UART_LINE_CTRL=y
CONFIG_UART_NS16550_LINE_CTRL=y
CONFIG_GPIO=y
CONFIG_GPIO_DW=y

# Cache Management
CONFIG_CACHE_MANAGEMENT=y

CONFIG_CLOCK_CONTROL=y
CONFIG_SYS_CLOCK_HW_CYCLES_PER_SEC=160000000
# Set Kernel device Priority levels
CONFIG_KERNEL_INIT_PRIORITY_DEFAULT=0
CONFIG_SE_SERVICE_INIT_PRIORITY=1
CONFIG_GPIO_INIT_PRIORITY=40
```

## boards/alif/alif_b1_eb/board.yml
```yaml
board:
  name: alif_b1_eb
  full_name: alif b1 EB
  vendor: alif
  socs:
  - name: ab1c1f4m51820hh0
```

## dts/bindings/invensense,ch201.yaml
```yaml
# Copyright (C) 2025 Alif Semiconductor - All Rights Reserved.
# Use, distribution and modification of this code is permitted under the
# terms stated in the Alif Semiconductor Software License Agreement
#
# You should have received a copy of the Alif Semiconductor Software
# License Agreement with this file. If not, please write to:
# contact@alifsemi.com, or visit: https://alifsemi.com/license

description: Chirp CH201 Time of Flight Sensor device

compatible: "invensense,ch201"

include: [sensor-device.yaml, i2c-device.yaml]

properties:
  int-gpios:
    type: phandle-array
    description: |
      The INT signal default configuration is active-high. The
      property value should ensure the flags properly describe the
      signal that is presented to the driver.

  prog-gpios:
    type: phandle-array
    description: |
      The PROG signal default configuration is active-high. The
      property value should ensure the flags properly describe the
      signal that is presented to the driver.

  reset-gpios:
    type: phandle-array
    description: |
      The RESETn signal default configuration is active-low. The
      property value should ensure the flags properly describe the
      signal that is presented to the driver.
```
