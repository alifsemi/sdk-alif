## samples/bluetooth/common/Kconfig
```kconfig
# Copyright (C) Alif Semiconductor - All Rights Reserved.
# Use, distribution and modification of this code is permitted under the
# terms stated in the Alif Semiconductor Software License Agreement
#
# You should have received a copy of the Alif Semiconductor Software
# License Agreement with this file. If not, please write to:
# contact@alifsemi.com, or visit: https://alifsemi.com/license

config ALIF_BLUETOOTH_COMMON
	bool "Alif Bluetooth Common"
	depends on SOC_FAMILY_BALLETTO
	depends on BT
	depends on BT_CUSTOM
	help
	  Enable Alif Bluetooth Common features.

menu "Alif Bluetooth Common Configuration"
	depends on ALIF_BLUETOOTH_COMMON

config ALIF_BLUETOOTH_COMMON_ACLK_DIVIDER_VALUE
	int "Alif Bluetooth Common ACLK Divider Value"
	default 0
	range 0 31
	help
	  Alif Bluetooth Common ACLK Divider Value

endmenu
```

## samples/drivers/ipm/ipm_alif_hwsem/sample.yaml
```yaml
---
sample:
  name: Demo for Alif's Hardware Semaphore Driver Sample
tests:
  sample.drivers.ipm.alif_hwsem:
    tags: drivers hwsem
    depends_on: hwsem
```

## samples/drivers/ipm/ipm_arm_mhuv2/Kconfig
```kconfig
# Copyright (C) Alif Semiconductor - All Rights Reserved.
# Use, distribution and modification of this code is permitted under the
# terms stated in the Alif Semiconductor Software License Agreement

mainmenu "MHUv2 Sample Configuration"

choice
	prompt "MHUv2 test case"
	default SE_SERVICES
	help
	  Select which test case to build. Exactly one test case is built
	  per image.

config SE_SERVICES
	bool "SE services test"
	help
	  Build the Secure Enclave (SE) services test case.

config APSS_R
	bool "M55 responder to APSS (A32) initiated MHU messages"
	help
	  Build the M55 responder that replies to MHU messages initiated by
	  the APSS (A32) core.

config HE_HP_S
	bool "RTSS-HE (M55) to RTSS-HP (M55) initiator/sender"
	help
	  Build the RTSS-HE (M55) to RTSS-HP (M55) MHU initiator/sender.

config HP_HE_R
	bool "RTSS-HP (M55) to RTSS-HE (M55) responder"
	help
	  Build the RTSS-HP (M55) to RTSS-HE (M55) shared MHU responder.

config HE_A32_S
	bool "RTSS-HE (M55) to APSS (A32) initiator/sender"
	help
	  Build the RTSS-HE (M55) to APSS (A32) shared MHU initiator/sender.

endchoice

config USE_MHU1
	bool "Use MHU1 instead of MHU0 for inter-core communication"
	default n
	help
	  Select MHU1 channel for communication between M55 cores.
	  Default is MHU0.

source "Kconfig.zephyr"
```

## samples/drivers/ipm/ipm_arm_mhuv2/apss/sample.yaml
```yaml
---
sample:
  name: MHUv2 driver sample for the APSS
tests:
  sample.drivers.ipm:
    tags: MHUv2
    platform_allow:
      alif_e7_ak_apss alif_e7_dk_apss
```

## samples/drivers/ipm/ipm_arm_mhuv2/rtss_he/sample.yaml
```yaml
---
sample:
  name: MHUv2 driver sample
tests:
  sample.drivers.ipm:
    tags: MHUv2
    platform_allow:
      - alif_b1_dk/ab1c1f4m51820hh0/rtss_he
      - alif_b1_dk/ab1c1f4m51820ph0/rtss_he
      - alif_b1_dk/ab1c1f1m41820hh0/rtss_he
      - alif_b1_dk/ab1c1f1m41820ph0/rtss_he
      - alif_e1c_dk/ae1c1f4051920hh/rtss_he
      - alif_e7_dk/ae302f80f55d5xx/rtss_he
      - alif_e7_dk/ae722f80f55d5xx/rtss_he
      - alif_e8_dk/ae402fa0e5597xx0/rtss_he
      - alif_e8_dk/ae822fa0e5597xx0/rtss_he
      - alif_e7_ak/ae722f80f55d5xx/rtss_he
      - alif_e8_ak/ae822fa0e5597xx0/rtss_he
```

## samples/drivers/ipm/ipm_arm_mhuv2/rtss_hp/sample.yaml
```yaml
---
sample:
  name: MHUv2 driver sample
tests:
  sample.drivers.ipm:
    tags: MHUv2
    platform_allow:
      - alif_e7_dk/ae302f80f55d5xx/rtss_hp
      - alif_e7_dk/ae722f80f55d5xx/rtss_hp
      - alif_e8_dk/ae402fa0e5597xx0/rtss_hp
      - alif_e8_dk/ae822fa0e5597xx0/rtss_hp
      - alif_e7_ak/ae722f80f55d5xx/rtss_hp
      - alif_e8_ak/ae822fa0e5597xx0/rtss_hp
```

## samples/drivers/spi_flash/src/Kconfig
```kconfig
# Copyright (C) 2026 Alif Semiconductor.
# SPDX-License-Identifier: Apache-2.0

config ALIF_OSPI_FLASH_BOOT_XIP_IMAGE
	bool "Boot image from OSPI XIP"
	depends on ALIF_OSPI_FLASH_XIP
	help
	  Boot or jump to an image stored in OSPI flash XIP address space.
          This option is only for demonstration purposes.
```

## samples/drivers/video/boards/serial_camera_mt9m114.conf
```kconfig
CONFIG_VIDEO_MIPI_CSI2_DW=y
CONFIG_VIDEO_BUFFER_POOL_SZ_MAX=1900000
CONFIG_VIDEO_BUFFER_POOL_NUM_MAX=2
CONFIG_REGULATOR=y
CONFIG_REGULATOR_FIXED_INIT_PRIORITY=40
CONFIG_MT9M114_PARALLEL_INIT=n
```

## samples/modules/tflite-micro/alif_asr/Kconfig
```kconfig
# Copyright (C) 2025 Alif Semiconductor - All Rights Reserved.
# Use, distribution and modification of this code is permitted under the
# terms stated in the Alif Semiconductor Software License Agreement
#
# You should have received a copy of the Alif Semiconductor Software
# License Agreement with this file. If not, please write to:
# contact@alifsemi.com, or visit: https://alifsemi.com/license

source "Kconfig.zephyr"

config USE_APP_MENU
	bool "Use application menu to choose a test case"
	default false

config ACTIVATION_BUF_SECTION
	string "Linker section where activation buffer (tensor arena) is placed"
	default ".bss.activation_buf"

config ACTIVATION_BUF_SZ
	hex "Tensor arena size"
	default 0x00091000

config MODEL_IN_EXT_FLASH
	bool "Put ML model to external flash"
	select FLASH
	select ALIF_OSPI_FLASH_XIP
	help
		Initialize OSPI controller to XIP mode. Initialize the onboard flash device. Link ML model data to external flash address space.
		In addition to normal zephyr.bin output, ospi0/1.bin is generated. When enabled, the model memory section is set automatically (See BufAttributes.h)

config MODEL_SECTION
	string "Linker section where ML model is placed"
	depends on !MODEL_IN_EXT_FLASH
	default ".rodata.tflm_model"

config ETHOS_U_AXI0_ONLY
	bool "Only use AXI0 port on the Ethos"
	default false

config AUDIO_SAMPLES
	int "Number of audio samples to store"
	default 16000

config AUDIO_STRIDE
	int "Number of audio samples in a single stride"
	default 8000

config RESULTS_MEMORY
	int "Number of inference results to keep in memory"
	default 8

config AUDIO_CHANNELS
	int "Number of input audio channels"
	default 2

config SAMPLE_CNT
	int "Number of samples per slab buffer"
	default 400

config NUM_BUFFERS
	int "Number of slab buffers to allocate"
	default 4

config I2S_GAIN
	int "Fixed linear again applied to I2S samples (e.g 10 = 20dB gain)"
	default 20

config THREAD_STACK_SIZE
	int "Stack size of audio thread"
	default 1024

config THREAD_PRIORITY
	int "Priority of audio thread"
	default 0

config PUSH_TO_TALK
	bool "Use push to talk power example"
	default false

config OUTPUT_TO_LINE_OUT
	depends on I2S
	bool "Output audio to line out"
	default false

config LPGPIO_WAKEUP_SOURCE
	depends on "$(dt_nodelabel_enabled,lpgpio)"
	int "LPGPIO Wakeup source will be used to wakeup from sleep"
	range 0 4
	default 1
	help
	  Defines which LPGPIO pin will be used as wakeup source from sleep.
	  0 - LPGPIO0, 1 - LPGPIO1, ...

config LPGPIO_M55_IRQ_ENABLED
	depends on "$(dt_nodelabel_enabled,lpgpio)"
	bool "LPGPIO M55 core IRQ enabled"
	default y
	help
	  Configures LPGPIO to generate interrupt on M55 core when M55 is
	  running.

choice
	depends on LPGPIO_M55_IRQ_ENABLED
	prompt "LPGPIO IRQ edge trigger select"
	default LPGPIO_M55_IRQ_EDGE_FALLING
	help
	  Select which signal edge will trigger the interrupt.
	config LPGPIO_M55_IRQ_EDGE_RISING
	bool "Rising edge"
	config LPGPIO_M55_IRQ_EDGE_FALLING
	bool "Falling edge"
	config LPGPIO_M55_IRQ_EDGE_BOTH
	bool "Rising and falling edges"
endchoice
```

## samples/modules/tflite-micro/alif_asr/boards/alif_b1_dk_ab1c1f4m51820ph0_rtss_he.conf
```kconfig
CONFIG_ALIF_PM_SLEEP_ENABLE=1
CONFIG_LPGPIO_WAKEUP_SOURCE=0

# ####### Configuration supported with the updated Secure Enclave software
CONFIG_ALIF_EXT_WAKEUP_TIME=0
CONFIG_ALIF_OSC_WAKEUP_TIME=1700
CONFIG_ALIF_RM_WAKEUP_TIME=0
CONFIG_ALIF_EXT_WARMBOOT_WAKEUP_TIME=3000
CONFIG_ALIF_MAX_SLEEP_CLOCK_DRIFT=252
CONFIG_ALIF_MAX_ACTIVE_CLOCK_DRIFT=252
CONFIG_AUDIO_DMIC=y

# enable if CONFIG_OUTPUT_TO_LINE_OUT is set as ASR uses I2S for audio output
CONFIG_I2S=n
```

## samples/subsys/usb/cdc_acm_alif/sample.yaml
```yaml
sample:
  name: CDC ACM USB
tests:
  sample.usb_device_next.cdc-acm:
    depends_on: usbd
    tags: usb
    integration_platforms:
      - alif_e7_dk/ae722f80f55d5xx/m55_hp
```

## subsys/bluetooth/le_audio/Kconfig.lc3
```kconfig
#Copyright(C) 2025 Alif Semiconductor - All Rights Reserved.
#Use, distribution and modification of this code is permitted under the
#terms stated in the Alif Semiconductor Software License Agreement
#
#You should have received a copy of the Alif Semiconductor Software
#License Agreement with this file.If not, please write to:
#contact @alifsemi.com, or visit : https: // alifsemi.com/license

menuconfig ALIF_LC3
	bool "Alif LC3 codec"
	default y
	help
	  The Alif LC3 codec configuration contains common code to be re-used across LE audio applications.

if ALIF_LC3

module = ALIF_LC3
module-str = alif-lc3
source "subsys/logging/Kconfig.template.log_config"

config LC3_ENCODER_STACK_SIZE
	int "Stack size for LC3 encoder thread"
	default 6144
	help
	  Stack size for LC3 encoder thread. Stack requirements have been experimentally determined
	  to be around 5.5k for typical settings, so default is 6k to leave some margin.

config LC3_DECODER_STACK_SIZE
	int "Stack size for LC3 decoder thread"
	default 3072 if ALIF_BLE_AUDIO_FS_48KHZ
	default 2048
	help
	  Stack size for LC3 decoder thread.

choice
	prompt "Choose BAP frame duration"
	default ALIF_LC3_FRAME_DURATION_10MS if ALIF_BLE_AUDIO_FRAME_DURATION_10MS

	config ALIF_LC3_FRAME_DURATION_7_5MS
	bool "7.5ms"
	config ALIF_LC3_FRAME_DURATION_10MS
	bool "10ms"

endchoice

config ALIF_LC3_FRAME_DURATION_MS_X100
	int
	default 750  if ALIF_LC3_FRAME_DURATION_7_5MS
	default 1000 if ALIF_LC3_FRAME_DURATION_10MS
	help
	  Numerical representation of the enum values of LC3 frame duration

endif # ALIF_LC3
```

## subsys/ieee802154/Kconfig
```kconfig
# Copyright (C) 2023 Alif Semiconductor - All Rights Reserved.
# Use, distribution and modification of this code is permitted under the
# terms stated in the Alif Semiconductor Software License Agreement
#
# You should have received a copy of the Alif Semiconductor Software
# License Agreement with this file. If not, please write to:
# contact@alifsemi.com, or visit: https://alifsemi.com/license

config IEEE802154_ALIF_AHI_MSG_LIB
	bool "Build AHI MSG library from sources"
	depends on IEEE802154_ALIF_SUPPORT
	default n

config IEEE802154_ALIF_SHELL
	bool "IEEE 802.15.4 HAL test commands"
	default y
	depends on SHELL
	depends on IEEE802154_ALIF_SUPPORT
	help
	  Enable RF driver testing related shell commands.
```

## subsys/modules/testcommands/Kconfig
```kconfig
# Copyright (C) 2026 Alif Semiconductor - All Rights Reserved.
# Use, distribution and modification of this code is permitted under the
# terms stated in the Alif Semiconductor Software License Agreement
#
# You should have received a copy of the Alif Semiconductor Software
# License Agreement with this file. If not, please write to:
# contact@alifsemi.com, or visit: https://alifsemi.com/license

config ALIF_TESTCOMMANDS_SHELL
	bool "Testcommands for Pytest"
	default n
	depends on SHELL

	help
		Enable testcommands required by Pytest harness
```

## subsys/powermgr/Kconfig
```kconfig
# Copyright (C) 2024 Alif Semiconductor - All Rights Reserved.
# Use, distribution and modification of this code is permitted under the
# terms stated in the Alif Semiconductor Software License Agreement
#
# You should have received a copy of the Alif Semiconductor Software
# License Agreement with this file. If not, please write to:
# contact@alifsemi.com, or visit: https://alifsemi.com/license

config ALIF_POWER_MGR_SHELL
	bool "HAL power manager commands"
	default y
	depends on SHELL
	depends on HAS_ALIF_POWER_MANAGER
	help
	  Enable Alif Power manager commands

config ALIF_PWR_AUTOSTART
	bool "Automatically start ES0 BLE radio on boot"
	default n
	depends on ALIF_POWER_MGR_SHELL
	help
	  When enabled, automatically initializes the ES0 BLE radio
	  with HPA mode on boot. Equivalent to running the shell
	  commands 'pwr start --hpa' and 'pwr hci' at startup.

config ALIF_PWR_AUTOSTART_HCI_PINMUX_B
	bool "Use pinmux_b for HCI UART on autostart"
	default n
	depends on ALIF_PWR_AUTOSTART
	help
	  When enabled, the autostart HCI configuration uses pinmux_b.
	  Equivalent to running 'pwr hci --pinmux_b'.
```
