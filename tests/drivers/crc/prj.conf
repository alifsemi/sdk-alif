## CMakeLists.txt
```
cmake_minimum_required(VERSION 3.20.0)

include(${CMAKE_CURRENT_SOURCE_DIR}/../../common/pstate_dt.cmake)

find_package(Zephyr REQUIRED HINTS $ENV{ZEPHYR_BASE})
project(alif_crc)

target_sources(app PRIVATE
	src/main.c
	src/software_crc.c
)

target_sources_ifdef(CONFIG_ALIF_CPU_FREQ_PSTATE app PRIVATE
		     ../../common/pstate_main.c)

target_sources_ifdef(CONFIG_TEST_CRC_8 app PRIVATE src/test_crc_8.c)
target_sources_ifdef(CONFIG_TEST_CRC_16 app PRIVATE src/test_crc_16.c)
target_sources_ifdef(CONFIG_TEST_CRC_16_ALT app PRIVATE src/test_crc_16_alt.c)
target_sources_ifdef(CONFIG_TEST_CRC_32 app PRIVATE src/test_crc_32.c)
target_sources_ifdef(CONFIG_TEST_CRC_32C app PRIVATE src/test_crc_32c.c)
target_sources_ifdef(CONFIG_TEST_CRC_STRESS app PRIVATE
		     src/test_crc_stress.c)
```

## Kconfig
```
menu "Alif CRC test options"

config TEST_CRC_ALL
	bool "Enable all CRC test suites"
	select TEST_CRC_8
	select TEST_CRC_16
	select TEST_CRC_16_ALT
	select TEST_CRC_32
	select TEST_CRC_32C
	help
	  Enable all CRC algorithm test suites (CRC-8, CRC-16-CCITT,
	  CRC-16, CRC-32, CRC-32C) in a single configuration.

config TEST_CRC_8
	bool "Test CRC 8-bit CCITT algorithm"
	default n
	help
	  This configuration enables comprehensive test cases for the 8-bit CRC
	  CCITT algorithm implementation. The tests cover basic CRC computation,
	  reflection modes, byte and bit swapping options, and output inversion
	  capabilities to ensure robust functionality across various use cases.

config TEST_CRC_16
	bool "Test CRC 16-bit CCITT algorithm"
	default n
	help
	  This configuration enables comprehensive test cases for the 16-bit CRC
	  CCITT algorithm implementation. The tests cover basic CRC computation,
	  reflection modes, byte and bit swapping options, and output inversion
	  capabilities to ensure robust functionality across various use cases.

config TEST_CRC_16_ALT
	bool "Test CRC 16-bit alternate polynomial algorithm"
	default n
	help
	  This configuration enables comprehensive test cases for the 16-bit CRC
	  alternate polynomial implementation using polynomial 0x8005. The tests
	  cover basic CRC computation, reflection modes, byte and bit swapping
	  options, output inversion, single-byte input, and seed variation for
	  the alternate 16-bit mode.

config TEST_CRC_32
	bool "Test CRC 32-bit algorithm"
	default n
	help
	  This configuration enables comprehensive test cases for the 32-bit CRC
	  algorithm implementation using the standard polynomial 0x04C11DB7.
	  The tests validate basic CRC computation, reflection modes, byte and
	  bit swapping options, output inversion, and compatibility with common
	  CRC-32 applications.

config TEST_CRC_32C
	bool "Test CRC-32C (Castagnoli) algorithm"
	default n
	help
	  This configuration enables test cases for the CRC-32C (Castagnoli)
	  algorithm implementation using polynomial 0x1EDC6F41. CRC-32C is
	  widely used in networking protocols including iSCSI, SCTP, and
	  filesystem integrity checks in ext4 and Btrfs. Tests cover standard
	  operations, reflection, swapping, and inversion modes.

config TEST_CRC_STRESS
	bool "CRC stress and robustness tests"
	default n
	help
	  Enable runtime-driven stress tests that exercise driver resilience
	  across all enabled CRC algorithms. Tests cover repeatability,
	  back-to-back operations, boundary conditions, bit-flip sensitivity,
	  parameter orthogonality, output width masking, and large data
	  handling.

	  Combine with any algorithm config (TEST_CRC_8, TEST_CRC_16,
	  TEST_CRC_16_ALT, TEST_CRC_32, or TEST_CRC_32C) to run the
	  corresponding stress vectors in a single image. The 32-bit variants
	  additionally exercise the custom-polynomial path because that
	  capability is exposed by the public driver API.

endmenu

rsource "../../common/Kconfig.pstate"

source "Kconfig.zephyr"
```

## prj.conf
```kconfig
# Copyright Alif Semiconductor - All Rights Reserved.
# Use, distribution and modification of this code is permitted under the
# terms stated in the Alif Semiconductor Software License Agreement
#
# You should have received a copy of the Alif Semiconductor Software
# License Agreement with this file. If not, please write to:
# contact@alifsemi.com, or visit: https://alifsemi.com/license

CONFIG_CRC_DRV=y
CONFIG_ZTEST=y
```

## boards/crc0.overlay
```dts
/* Copyright Alif Semiconductor - All Rights Reserved.
 * Use, distribution and modification of this code is permitted under the
 * terms stated in the Alif Semiconductor Software License Agreement
 *
 * You should have received a copy of the Alif Semiconductor Software
 * License Agreement with this file. If not, please write to:
 * contact@alifsemi.com, or visit: https://alifsemi.com/license
 */


#include "pstate_common.overlay"

/ {
	aliases {
		crc = &crc0;
	};
};

&crc0 {
	status = "okay";
};
```

## boards/crc0_16_bit.overlay
```dts
// SPDX-License-Identifier: Apache-2.0

/*
 * Copyright (c) 2025 Alif Semiconductor.
 */

/ {
	aliases {
		crc = &crc0;
	};
};

&crc0 {
	crc_algo = "CRC_16_BIT_SIZE";
	status = "okay";
};
```

## boards/crc0_32_bit.overlay
```dts
// SPDX-License-Identifier: Apache-2.0
/*
 * Copyright (c) 2025 Alif Semiconductor.
 */
/ {
	aliases {
		crc = &crc0;
	};
};

&crc0 {
	crc_algo = "CRC_32_BIT_SIZE";
	status = "okay";
};
```

## boards/crc0_8_bit.overlay
```dts
// SPDX-License-Identifier: Apache-2.0
/*
 * Copyright (c) 2025 Alif Semiconductor.
 */

/ {
	aliases {
		crc = &crc0;
	};
};

&crc0 {
	crc_algo = "CRC_8_BIT_SIZE";
	status = "okay";
};
```

## boards/crc1.overlay
```dts
/* Copyright Alif Semiconductor - All Rights Reserved.
 * Use, distribution and modification of this code is permitted under the
 * terms stated in the Alif Semiconductor Software License Agreement
 *
 * You should have received a copy of the Alif Semiconductor Software
 * License Agreement with this file. If not, please write to:
 * contact@alifsemi.com, or visit: https://alifsemi.com/license
 */

#include "pstate_common.overlay"

/ {
	aliases {
		crc = &crc1;
	};
};

&crc1 {
	status = "okay";
};
```

## boards/crc1_16_bit.overlay
```dts
// SPDX-License-Identifier: Apache-2.0
/*
 * Copyright (c) 2025 Alif Semiconductor.
 */

/ {
	aliases {
		crc = &crc1;
	};
};

&crc1 {
	crc_algo = "CRC_16_BIT_SIZE";
	status = "okay";
};
```

## src/main.c
```c
/* Copyright Alif Semiconductor - All Rights Reserved.
 * Use, distribution and modification of this code is permitted under the
 * terms stated in the Alif Semiconductor Software License Agreement
 *
 * You should have received a copy of the Alif Semiconductor Software
 * License Agreement with this file. If not, please write to:
 * contact@alifsemi.com, or visit: https://alifsemi.com/license
 */
#include "software_crc.h"

#include <zephyr/logging/log.h>

LOG_MODULE_REGISTER(alif_crc_test);

const uint8_t crc_test_data[] = {0x67, 0x3F, 0x90, 0xC9, 0x25,
				 0xF0, 0x4A, 0xB1, 0x13};

const size_t crc_test_data_len = ARRAY_SIZE(crc_test_data);

const uint8_t crc_check_string[] = {'1', '2', '3', '4', '5',
				    '6', '7', '8', '9'};

const struct device *const crc_dev = DEVICE_DT_GET(DT_ALIAS(crc));

/*
 * Mirror the first field of the driver-private runtime data so the tests can
 * steer the active CRC algorithm without changing the public driver API.
 *
 * This keeps multi-algorithm validation in a single image possible while the
 * driver still selects its algorithm from devicetree at init time.
 */
struct crc_test_runtime_data {
	uint8_t crc_algo;
};

void crc_test_force_hw_algo(enum test_crc_hw_algo algo)
{
	struct crc_test_runtime_data *data =
		(struct crc_test_runtime_data *)crc_dev->data;

	zassert_not_null(data, "CRC driver data not available");
	zassert_true(algo <= TEST_CRC_HW_ALGO_CRC32C, "invalid CRC algo %u",
		     (unsigned int)algo);

	data->crc_algo = (uint8_t)algo;
}

uint32_t bit_reflect_n(uint32_t input, uint32_t width)
{
	uint32_t reflected = 0U;

	for (uint32_t i = 0U; i < width; i++) {
		if (input & BIT(i)) {
			reflected |= BIT(width - 1U - i);
		}
	}

	return reflected;
}

uint32_t bit_reflect_32(uint32_t input) { return bit_reflect_n(input, 32U); }

void crc_test_verify_device(void)
{
	zassert_true(crc_dev != NULL, "CRC device not found");
	zassert_true(device_is_ready(crc_dev), "CRC device not ready");
	LOG_DBG("CRC device ready: %s", crc_dev->name);
}
```

## src/software_crc.c
```c
/* Copyright Alif Semiconductor - All Rights Reserved.
 * Use, distribution and modification of this code is permitted under the
 * terms stated in the Alif Semiconductor Software License Agreement
 *
 * You should have received a copy of the Alif Semiconductor Software
 * License Agreement with this file. If not, please write to:
 * contact@alifsemi.com, or visit: https://alifsemi.com/license
 */

#include <stdbool.h>
#include "software_crc.h"
#include <zephyr/sys/util.h>

typedef struct crc_config_t {
	int id;
	int degree;
	unsigned long poly;
} crc_config_t;

#define CRC_START_32 0xFFFFFFFFL

static const crc_config_t crc_config[] = {
	{CRC32_PRIME, 32, CRC32_POLY_NORMAL},
	{CRC32C_PRIME, 32, CRC32C_HW_POLY},
	{CRC16_802_15_4, 16, CRC16_CCITT_HW_POLY},
	{CRC16_ALT, 16, CRC16_ALT_HW_POLY},
	{CRC8_PRIME, 8, CRC8_HW_POLY},
};

static unsigned long crc_table[256] = {0};

static const crc_config_t *find_config(int id)
{
	size_t i;

	for (i = 0; i < ARRAY_SIZE(crc_config); i++) {
		if (crc_config[i].id == id) {
			return &crc_config[i];
		}
	}
	return NULL;
}

/*---------------------------------------------------------------------------*/
/* Table-driven version */
/*---------------------------------------------------------------------------*/
static unsigned long generate_mask(int degree)
{
	unsigned long half = (1ul << (degree / 2)) - 1;

	return half << (degree / 2) | half;
}

static void generate_crc_table(const crc_config_t *config)
{
	int i, j;
	unsigned long bit, crc;
	unsigned long high_bit = (1ul << (config->degree - 1));
	unsigned long mask = generate_mask(config->degree);

	for (i = 0; i < 256; i++) {
		crc = (unsigned long)i << (config->degree - 8);
		for (j = 0; j < 8; j++) {
			bit = crc & high_bit;
			crc <<= 1;
			if (bit) {
				crc ^= config->poly;
			}
		}
		crc_table[i] = crc & mask;
	}
}

/*****************************************************************************/
/* gen_crc - Return the CRC value for the data using the given CRC algorithm */
/* int id : identifies the CRC algorithm */
/* char *data : the data */
/* size_t len : the size of the data */
/*****************************************************************************/
unsigned long gen_crc(int id, const unsigned char *data, size_t len)
{
	const crc_config_t *config = find_config(id);
	unsigned long crc = 0;
	unsigned long mask;
	size_t i;

	if (config == NULL) {
		return 0U;
	}

	mask = generate_mask(config->degree);

	if ((id == CRC32_PRIME) || (id == CRC32C_PRIME)) {
		crc = 0xFFFFFFFFUL;
	}

	generate_crc_table(config);
	for (i = 0; i < len; i++) {
		unsigned int datum = data[i];

		/*
		 * This loop handles 16-bit chars when we compile on 16-bit
		 * machines.
		 */
		int n;

		for (n = 0; n < (CHAR_BIT / 8); n++) {
			unsigned long octet = ((datum >> (8 * n)) & 0xff);
			unsigned long term1 = (crc << 8);
			int idx =
				((crc >> (config->degree - 8)) & 0xff) ^ octet;

			crc = term1 ^ crc_table[idx];
		}
	}
	return crc & mask;
}

/*****************************************************************************/
/* 32 Bit CRC */
/*****************************************************************************/
static void init_crc32_tab(unsigned long CRC_POLY_32);
static uint32_t crc_tab32[256];

/*
 * uint32_t crc_32(const unsigned char *input_str, size_t num_bytes,
 *                  unsigned long CRC_POLY_32);
 *
 * The function crc_32() calculates in one pass the common 32 bit CRC value for
 * a byte string that is passed to the function together with a parameter
 * indicating the length.
 */
uint32_t crc_32(const unsigned char *input_str, size_t num_bytes,
		unsigned long CRC_POLY_32)
{

	uint32_t crc;
	uint32_t tmp;
	uint32_t long_c;
	const unsigned char *ptr;
	size_t a;

	init_crc32_tab(CRC_POLY_32);
	crc = CRC_START_32;
	ptr = input_str;
	if (ptr != NULL) {
		for (a = 0; a < num_bytes; a++) {
			long_c = 0x000000FFL & (uint32_t)*ptr;
			tmp = crc ^ long_c;
			crc = (crc >> 8) ^ crc_tab32[tmp & 0xff];
			ptr++;
		}
	}
	crc ^= 0xffffffffL;
	return crc & 0xffffffffL;
}

/*
 * static void init_crc32_tab(unsigned long CRC_POLY_32);
 *
 * For optimal speed, the CRC32 calculation uses a table with pre-calculated
 * bit patterns which are used in the XOR operations in the program. This table
 * is generated once, the first time the CRC update routine is called.
 */
static void init_crc32_tab(unsigned long CRC_POLY_32)
{
	uint32_t i;
	uint32_t j;
	uint32_t crc;

	for (i = 0; i < 256; i++) {
		crc = i;
		for (j = 0; j < 8; j++) {
			if (crc & 0x00000001L) {
				crc = (crc >> 1) ^ CRC_POLY_32;
			} else {
				crc = crc >> 1;
			}
		}
		crc_tab32[i] = crc;
	}
}

uint32_t crc32_update_msb(uint32_t crc, uint8_t data, uint32_t poly)
{
	crc ^= ((uint32_t)data << 24);

	for (int bit = 0; bit < 8; bit++) {
		if (crc & 0x80000000U) {
			crc = (crc << 1) ^ poly;
		} else {
			crc <<= 1;
		}
	}

	return crc;
}

uint32_t crc32_update_msb_word(uint32_t crc, const uint8_t *word, bool bit_swap,
			       bool byte_swap, uint32_t poly)
{
	for (int i = 0; i < 4; i++) {
		const int src = byte_swap ? i : (3 - i);
		uint8_t byte = word[src];

		if (bit_swap) {
			byte = (uint8_t)bit_reflect_n(byte, 8);
		}

		crc = crc32_update_msb(crc, byte, poly);
	}

	return crc;
}

uint32_t crc32_sw_unaligned(uint32_t crc, const uint8_t *input, uint32_t length,
			    uint32_t poly)
{
	uint32_t poly_refl = bit_reflect_32(poly);

	for (uint32_t byte_idx = 0; byte_idx < length; byte_idx++) {
		uint8_t data = input[byte_idx];

		for (uint32_t bit_idx = 0; bit_idx < 8; bit_idx++) {
			uint32_t check_bit = (crc ^ data) & 1U;

			crc >>= 1;
			if (check_bit) {
				crc ^= poly_refl;
			}
			data >>= 1;
		}
	}

	return ~crc;
}

uint32_t crc32_driver_reference(const uint8_t *data, size_t len, uint32_t seed,
				bool bit_swap, bool byte_swap, bool reflect,
				bool invert, uint32_t poly_normal,
				uint32_t poly_reflected)
{
	uint32_t crc = seed;
	uint32_t aligned_len = len - (len % 4);
	uint32_t unaligned_len = len % 4;
	const uint8_t *tail = data + aligned_len;

	ARG_UNUSED(poly_reflected);

	/* --- Aligned phase: feed LE32 words (MSB-first engine) --- */
	for (uint32_t off = 0; off < aligned_len; off += 4) {
		crc = crc32_update_msb_word(crc, &data[off], bit_swap,
					    byte_swap, poly_normal);
	}

	/*
	 * HW applies reflect + invert to CRC_OUT automatically.
	 * Apply the same transforms so we match the value that
	 * crc_calculate_32bit_unaligned_sw receives as input.
	 */
	if (reflect) {
		crc = bit_reflect_32(crc);
	}
	if (invert) {
		crc = ~crc;
	}

	/* --- Unaligned tail: replicate driver SW fallback --- */
	if (unaligned_len > 0) {
		if (invert) {
			crc = ~crc;
		}
		if (!reflect) {
			crc = bit_reflect_32(crc);
		}

		crc = crc32_sw_unaligned(crc, tail, unaligned_len, poly_normal);

		if (!reflect) {
			crc = bit_reflect_32(crc);
		}
		if (!invert) {
			crc = ~crc;
		}
	}

	return crc;
}

uint32_t crc32_full_reference(const uint8_t *data, size_t len)
{
	return crc32_driver_reference(data, len, 0xFFFFFFFFU, true, true, true,
				      true, CRC32_POLY_NORMAL,
				      CRC32_POLY_REFLECTED);
}

uint32_t crc32c_full_reference(const uint8_t *data, size_t len)
{
	return crc32_driver_reference(data, len, 0xFFFFFFFFU, true, true, true,
				      true, CRC32C_HW_POLY,
				      CRC32C_SW_POLY_REFL);
}

uint32_t custom_poly_crc(const uint8_t *data, size_t len, uint32_t poly,
			 uint32_t bits)
{
	uint32_t crc = 0; /* Seed 0, no invert */
	uint32_t mask = (bits == 32U) ? UINT32_MAX : ((1U << bits) - 1U);

	for (size_t i = 0; i < len; i++) {
		crc ^= (uint32_t)data[i] << (bits - 8U);
		for (int j = 0; j < 8; j++) {
			if (crc & BIT(bits - 1U)) {
				crc = (crc << 1) ^ poly;
			} else {
				crc <<= 1;
			}
			crc &= mask;
		}
	}

	return crc;
}
```

## src/software_crc.h
```c
/* Copyright Alif Semiconductor - All Rights Reserved.
 * Use, distribution and modification of this code is permitted under the
 * terms stated in the Alif Semiconductor Software License Agreement
 *
 * You should have received a copy of the Alif Semiconductor Software
 * License Agreement with this file. If not, please write to:
 * contact@alifsemi.com, or visit: https://alifsemi.com/license
 */
#ifndef SOFTWARE_CRC_H_
#define SOFTWARE_CRC_H_

#include <stddef.h>
#include <stdint.h>

#include <zephyr/device.h>
#include <zephyr/drivers/crc.h>
#include <zephyr/kernel.h>
#include <zephyr/ztest.h>

/* Software reference algorithm identifiers used by gen_crc(). */
#define CRC32_PRIME 0
#define CRC16_802_15_4 1
#define CRC16_ALT 2
#define CRC8_PRIME 3
#define CRC32C_PRIME 4

/*
 * Keep this compatibility alias so local test edits that use CRC32C as an ID
 * continue to build. The canonical software-reference ID is CRC32C_PRIME.
 */
#define CRC32C CRC32C_PRIME

#define CRC_TRUE 1
#define CRC_FALSE 0

#ifndef CHAR_BIT
#define CHAR_BIT 8
#endif

/* Standard hardware polynomials used by the software reference model. */
#define CRC8_HW_POLY 0x07UL
#define CRC16_CCITT_HW_POLY 0x1021UL
#define CRC16_HW_POLY 0x8005UL

/* Keep the existing test-facing name for the non-CCITT 16-bit polynomial. */
#define CRC16_ALT_HW_POLY CRC16_HW_POLY

/* Additional polynomials used by the extended test matrix. */
#define CRC16_CUSTOM_TEST_POLY 0xA001UL
#define CRC8_CUSTOM_TEST_POLY 0x9BUL
#define CRC32C_HW_POLY 0x1EDC6F41UL
#define CRC32C_SW_POLY_REFL 0x82F63B78UL
#define CRC32_CUSTOM_HW_POLY 0x2CEEA6C8UL
#define CRC32_CUSTOM_SW_POLY_REFL 0x13657734UL
#define CRC32_POLY_NORMAL 0x04C11DB7UL
#define CRC32_POLY_REFLECTED 0xEDB88320UL

enum test_crc_hw_algo {
	TEST_CRC_HW_ALGO_CRC8_CCITT = 0,
	TEST_CRC_HW_ALGO_CRC16 = 1,
	TEST_CRC_HW_ALGO_CRC16_CCITT = 2,
	TEST_CRC_HW_ALGO_CRC32 = 3,
	TEST_CRC_HW_ALGO_CRC32C = 4,
};

/*
 * Test-side runtime algorithm selection and common device validation.
 *
 * The current driver still fixes its algorithm from devicetree at init time,
 * so the test suite mirrors the first byte of the driver runtime data in
 * order to exercise multiple algorithms from one image.
 */
void crc_test_force_hw_algo(enum test_crc_hw_algo algo);
void crc_test_verify_device(void);

/* Shared test input data (defined in main.c). */
extern const uint8_t crc_test_data[];
extern const size_t crc_test_data_len;

/* CRC device handle (defined in main.c). */
extern const struct device *const crc_dev;

/* Shared CRC check string "123456789" - canonical CRC test vector. */
extern const uint8_t crc_check_string[];

#define CRC_CHECK_STRING_LEN 9

/* Bit-reflect helpers (defined in main.c). */
uint32_t bit_reflect_n(uint32_t input, uint32_t width);
uint32_t bit_reflect_32(uint32_t input);

/* CRC32 driver-path reference helpers. */
uint32_t crc32_update_msb(uint32_t crc, uint8_t data, uint32_t poly);
uint32_t crc32_update_msb_word(uint32_t crc, const uint8_t *word, bool bit_swap,
			       bool byte_swap, uint32_t poly);
uint32_t crc32_sw_unaligned(uint32_t crc, const uint8_t *input, uint32_t length,
			    uint32_t poly);
uint32_t crc32_driver_reference(const uint8_t *data, size_t len, uint32_t seed,
				bool bit_swap, bool byte_swap, bool reflect,
				bool invert, uint32_t poly_normal,
				uint32_t poly_reflected);

/* Convenience functions for standard CRC32 configurations. */
uint32_t crc32_full_reference(const uint8_t *data, size_t len);
uint32_t crc32c_full_reference(const uint8_t *data, size_t len);

unsigned long gen_crc(int id, const unsigned char *data, size_t len);

uint32_t crc_32(const unsigned char *input_str, size_t num_bytes,
		unsigned long crc_poly);

uint32_t custom_poly_crc(const uint8_t *data, size_t len, uint32_t poly,
			 uint32_t bits);

#endif /* SOFTWARE_CRC_H_ */
```

## src/test_crc_16.c
```c
/* Copyright Alif Semiconductor - All Rights Reserved.
 * Use, distribution and modification of this code is permitted under the
 * terms stated in the Alif Semiconductor Software License Agreement
 *
 * You should have received a copy of the Alif Semiconductor Software
 * License Agreement with this file. If not, please write to:
 * contact@alifsemi.com, or visit: https://alifsemi.com/license
 */

#include "software_crc.h"

#include <zephyr/logging/log.h>

LOG_MODULE_DECLARE(alif_crc_test);

#if IS_ENABLED(CONFIG_TEST_CRC_16)

static void crc_16_before(void *fixture)
{
	ARG_UNUSED(fixture);

	crc_test_verify_device();
	crc_test_force_hw_algo(TEST_CRC_HW_ALGO_CRC16_CCITT);
}

/* ZTC-1185 / ZTC-1186: Basic 16-bit CRC */
ZTEST(crc_16_tests, test_crc_16_bit)
{
	uint32_t crc_output, software_output;
	struct crc_params params = {
		.data_in = (uint8_t *)crc_test_data,
		.len = crc_test_data_len,
		.bit_swap = CRC_FALSE,
		.byte_swap = CRC_FALSE,
		.reflect = CRC_FALSE,
		.invert = CRC_FALSE,
		.custom_poly = CRC_FALSE,
		.data_out = &crc_output,
	};

	zassert_equal(crc_set_seed(crc_dev, 0x00), 0, "CRC set seed failed");
	zassert_equal(crc_compute(crc_dev, &params), 0, "CRC compute failed");
	LOG_INF("16-bit CRC HW output: 0x%X", crc_output);

	software_output =
		gen_crc(CRC16_802_15_4, (const unsigned char *)crc_test_data,
			crc_test_data_len);
	LOG_INF("16-bit CRC SW output: 0x%X", software_output);

	zassert_equal(crc_output, software_output,
		      "HW/SW CRC mismatch: 0x%X != 0x%X", crc_output,
		      software_output);
}

/* ZTC-1376: 16-bit CRC with reflected output */
ZTEST(crc_16_tests, test_crc_16_bit_reflect_output_en)
{
	uint32_t crc_output, software_output;
	struct crc_params params = {
		.data_in = (uint8_t *)crc_test_data,
		.len = crc_test_data_len,
		.bit_swap = CRC_FALSE,
		.byte_swap = CRC_FALSE,
		.reflect = CRC_TRUE,
		.invert = CRC_FALSE,
		.custom_poly = CRC_FALSE,
		.data_out = &crc_output,
	};

	zassert_equal(crc_set_seed(crc_dev, 0x00), 0, "CRC set seed failed");
	zassert_equal(crc_compute(crc_dev, &params), 0, "CRC compute failed");
	LOG_INF("16-bit CRC HW output: 0x%X", crc_output);

	software_output =
		gen_crc(CRC16_802_15_4, (const unsigned char *)crc_test_data,
			crc_test_data_len);
	software_output = bit_reflect_n(software_output, 16);
	LOG_INF("16-bit CRC SW output (reflected): 0x%X", software_output);

	zassert_equal(crc_output, software_output,
		      "HW/SW CRC mismatch: 0x%X != 0x%X", crc_output,
		      software_output);
}

/* ZTC-1391: 16-bit CRC with bit/byte swap */
ZTEST(crc_16_tests, test_crc_16_bit_swap_en)
{
	uint32_t crc_output, software_output;
	uint8_t input[] = {0x67, 0x37};
	uint8_t reflected_input[] = {0xE6, 0xEC};
	struct crc_params params = {
		.data_in = (uint8_t *)input,
		.len = ARRAY_SIZE(input),
		.bit_swap = CRC_TRUE,
		.byte_swap = CRC_TRUE,
		.reflect = CRC_FALSE,
		.invert = CRC_FALSE,
		.custom_poly = CRC_FALSE,
		.data_out = &crc_output,
	};

	zassert_equal(crc_set_seed(crc_dev, 0x00), 0, "CRC set seed failed");
	zassert_equal(crc_compute(crc_dev, &params), 0, "CRC compute failed");
	LOG_INF("16-bit CRC HW output: 0x%X", crc_output);

	software_output = gen_crc(CRC16_802_15_4, reflected_input,
				  sizeof(reflected_input));
	LOG_INF("16-bit CRC SW output (swapped): 0x%X", software_output);

	zassert_equal(crc_output, software_output,
		      "HW/SW CRC mismatch: 0x%X != 0x%X", crc_output,
		      software_output);
}

/* ZTC-1393: 16-bit CRC with inverted output */
ZTEST(crc_16_tests, test_crc_16_bit_invert_output)
{
	uint32_t crc_output, software_output;
	struct crc_params params = {
		.data_in = (uint8_t *)crc_test_data,
		.len = crc_test_data_len,
		.bit_swap = CRC_FALSE,
		.byte_swap = CRC_FALSE,
		.reflect = CRC_FALSE,
		.invert = CRC_TRUE,
		.custom_poly = CRC_FALSE,
		.data_out = &crc_output,
	};

	zassert_equal(crc_set_seed(crc_dev, 0x00), 0, "CRC set seed failed");
	zassert_equal(crc_compute(crc_dev, &params), 0, "CRC compute failed");
	LOG_INF("16-bit CRC HW output: 0x%X", crc_output);

	software_output =
		gen_crc(CRC16_802_15_4, (const unsigned char *)crc_test_data,
			crc_test_data_len);
	software_output = (software_output ^ 0xFFFF);
	LOG_INF("16-bit CRC SW output (inverted): 0x%X", software_output);

	crc_output = (crc_output & 0xFFFF);

	zassert_equal(crc_output, software_output,
		      "HW/SW CRC mismatch: 0x%X != 0x%X", crc_output,
		      software_output);
}

/* ZTC-NEW: 16-bit CRC with single byte input */
ZTEST(crc_16_tests, test_crc_16_bit_single_byte)
{
	uint32_t crc_output, software_output;
	uint8_t single_byte[] = {0x55};
	struct crc_params params = {
		.data_in = single_byte,
		.len = 1,
		.bit_swap = CRC_FALSE,
		.byte_swap = CRC_FALSE,
		.reflect = CRC_FALSE,
		.invert = CRC_FALSE,
		.custom_poly = CRC_FALSE,
		.data_out = &crc_output,
	};

	zassert_equal(crc_set_seed(crc_dev, 0x00), 0, "CRC set seed failed");
	zassert_equal(crc_compute(crc_dev, &params), 0, "CRC compute failed");
	LOG_INF("16-bit CRC HW single byte output: 0x%X", crc_output);

	software_output = gen_crc(CRC16_802_15_4, single_byte, 1);
	LOG_INF("16-bit CRC SW single byte output: 0x%X", software_output);

	zassert_equal((crc_output & 0xFFFF), software_output,
		      "HW/SW CRC mismatch: 0x%X != 0x%X", (crc_output & 0xFFFF),
		      software_output);
}

/* ZTC-NEW: 16-bit CRC with non-zero seed */
ZTEST(crc_16_tests, test_crc_16_bit_nonzero_seed)
{
	uint32_t crc_seed0 = 0, crc_seedFFFF = 0;
	struct crc_params params = {
		.data_in = (uint8_t *)crc_test_data,
		.len = crc_test_data_len,
		.bit_swap = CRC_FALSE,
		.byte_swap = CRC_FALSE,
		.reflect = CRC_FALSE,
		.invert = CRC_FALSE,
		.custom_poly = CRC_FALSE,
		.data_out = &crc_seed0,
	};

	zassert_equal(crc_set_seed(crc_dev, 0x0000), 0, "seed 0 failed");
	zassert_equal(crc_compute(crc_dev, &params), 0, "compute seed 0");

	params.data_out = &crc_seedFFFF;
	zassert_equal(crc_set_seed(crc_dev, 0xFFFF), 0, "seed FFFF failed");
	zassert_equal(crc_compute(crc_dev, &params), 0, "compute seed FFFF");

	LOG_INF("16-bit CRC seed=0x0000: 0x%X, seed=0xFFFF: 0x%X", crc_seed0,
		crc_seedFFFF);

	zassert_not_equal((crc_seed0 & 0xFFFF), (crc_seedFFFF & 0xFFFF),
			  "Different seeds produced same 16-bit CRC: 0x%X",
			  (crc_seed0 & 0xFFFF));
}

/* ZTC-NEW: 16-bit CRC with reflect + invert combined */
ZTEST(crc_16_tests, test_crc_16_bit_reflect_invert_combined)
{
	uint32_t crc_output, software_output;
	struct crc_params params = {
		.data_in = (uint8_t *)crc_test_data,
		.len = crc_test_data_len,
		.bit_swap = CRC_FALSE,
		.byte_swap = CRC_FALSE,
		.reflect = CRC_TRUE,
		.invert = CRC_TRUE,
		.custom_poly = CRC_FALSE,
		.data_out = &crc_output,
	};

	zassert_equal(crc_set_seed(crc_dev, 0x00), 0, "CRC set seed failed");
	zassert_equal(crc_compute(crc_dev, &params), 0, "CRC compute failed");
	LOG_INF("16-bit CRC HW reflect+invert output: 0x%X", crc_output);

	software_output =
		gen_crc(CRC16_802_15_4, (const unsigned char *)crc_test_data,
			crc_test_data_len);
	software_output = bit_reflect_n(software_output, 16);
	software_output = (software_output ^ 0xFFFF);
	LOG_INF("16-bit CRC SW reflect+invert output: 0x%X", software_output);

	zassert_equal((crc_output & 0xFFFF), software_output,
		      "HW/SW CRC mismatch: 0x%X != 0x%X", (crc_output & 0xFFFF),
		      software_output);
}

ZTEST_SUITE(crc_16_tests, NULL, NULL, crc_16_before, NULL, NULL);

#endif /* CONFIG_TEST_CRC_16 */
```

## src/test_crc_16_alt.c
```c
/* Copyright Alif Semiconductor - All Rights Reserved.
 * Use, distribution and modification of this code is permitted under the
 * terms stated in the Alif Semiconductor Software License Agreement
 *
 * You should have received a copy of the Alif Semiconductor Software
 * License Agreement with this file. If not, please write to:
 * contact@alifsemi.com, or visit: https://alifsemi.com/license
 */

#include "software_crc.h"

#include <zephyr/logging/log.h>

LOG_MODULE_DECLARE(alif_crc_test);

#if IS_ENABLED(CONFIG_TEST_CRC_16_ALT)

static void crc_16_alt_before(void *fixture)
{
	ARG_UNUSED(fixture);

	crc_test_verify_device();
	crc_test_force_hw_algo(TEST_CRC_HW_ALGO_CRC16);
}

static uint32_t crc16_alt_sw(const uint8_t *data, size_t len)
{
	return gen_crc(CRC16_ALT, data, len);
}

ZTEST(crc_16_alt_tests, test_crc_16_alt)
{
	uint32_t crc_output;
	uint32_t software_output;
	struct crc_params params = {
		.data_in = (uint8_t *)crc_test_data,
		.len = crc_test_data_len,
		.bit_swap = CRC_FALSE,
		.byte_swap = CRC_FALSE,
		.reflect = CRC_FALSE,
		.invert = CRC_FALSE,
		.custom_poly = CRC_FALSE, /* Use native hardware support */
		.data_out = &crc_output,
	};

	zassert_equal(crc_set_seed(crc_dev, 0x0000), 0, "CRC set seed failed");
	zassert_equal(crc_compute(crc_dev, &params), 0, "CRC compute failed");

	software_output = crc16_alt_sw(crc_test_data, crc_test_data_len);
	LOG_INF("16-bit ALT HW output: 0x%X", crc_output);
	LOG_INF("16-bit ALT SW output: 0x%X", software_output);

	zassert_equal(crc_output, software_output,
		      "HW/SW CRC mismatch: 0x%X != 0x%X", crc_output,
		      software_output);
}

ZTEST(crc_16_alt_tests, test_crc_16_alt_reflect_output_en)
{
	uint32_t crc_output;
	uint32_t software_output;
	struct crc_params params = {
		.data_in = (uint8_t *)crc_test_data,
		.len = crc_test_data_len,
		.bit_swap = CRC_FALSE,
		.byte_swap = CRC_FALSE,
		.reflect = CRC_TRUE,
		.invert = CRC_FALSE,
		.custom_poly = CRC_FALSE, /* Use native hardware support */
		.data_out = &crc_output,
	};

	zassert_equal(crc_set_seed(crc_dev, 0x0000), 0, "CRC set seed failed");
	zassert_equal(crc_compute(crc_dev, &params), 0, "CRC compute failed");

	software_output = crc16_alt_sw(crc_test_data, crc_test_data_len);
	software_output = bit_reflect_n(software_output, 16);
	zassert_equal(crc_output & 0xFFFF, software_output,
		      "HW/SW CRC mismatch: 0x%X != 0x%X", crc_output & 0xFFFF,
		      software_output);
}

ZTEST(crc_16_alt_tests, test_crc_16_alt_bit_swap_en)
{
	uint32_t crc_output;
	uint32_t software_output;
	uint8_t input[] = {0x67, 0x37};
	uint8_t reflected_input[] = {0xE6, 0xEC};
	struct crc_params params = {
		.data_in = input,
		.len = ARRAY_SIZE(input),
		.bit_swap = CRC_TRUE,
		.byte_swap = CRC_TRUE,
		.reflect = CRC_FALSE,
		.invert = CRC_FALSE,
		.custom_poly = CRC_FALSE, /* Use native hardware support */
		.data_out = &crc_output,
	};

	zassert_equal(crc_set_seed(crc_dev, 0x0000), 0, "CRC set seed failed");
	zassert_equal(crc_compute(crc_dev, &params), 0, "CRC compute failed");

	software_output =
		crc16_alt_sw(reflected_input, ARRAY_SIZE(reflected_input));
	zassert_equal(crc_output & 0xFFFF, software_output,
		      "HW/SW CRC mismatch: 0x%X != 0x%X", crc_output & 0xFFFF,
		      software_output);
}

ZTEST(crc_16_alt_tests, test_crc_16_alt_invert_output)
{
	uint32_t crc_output;
	uint32_t software_output;
	struct crc_params params = {
		.data_in = (uint8_t *)crc_test_data,
		.len = crc_test_data_len,
		.bit_swap = CRC_FALSE,
		.byte_swap = CRC_FALSE,
		.reflect = CRC_FALSE,
		.invert = CRC_TRUE,
		.custom_poly = CRC_FALSE, /* Use native hardware support */
		.data_out = &crc_output,
	};

	zassert_equal(crc_set_seed(crc_dev, 0x0000), 0, "CRC set seed failed");
	zassert_equal(crc_compute(crc_dev, &params), 0, "CRC compute failed");

	software_output =
		crc16_alt_sw(crc_test_data, crc_test_data_len) ^ 0xFFFFU;
	zassert_equal(crc_output & 0xFFFF, software_output,
		      "HW/SW CRC mismatch: 0x%X != 0x%X", crc_output & 0xFFFF,
		      software_output);
}

ZTEST(crc_16_alt_tests, test_crc_16_alt_single_byte)
{
	uint32_t crc_output;
	uint32_t software_output;
	uint8_t single_byte[] = {0x55};
	struct crc_params params = {
		.data_in = single_byte,
		.len = ARRAY_SIZE(single_byte),
		.bit_swap = CRC_FALSE,
		.byte_swap = CRC_FALSE,
		.reflect = CRC_FALSE,
		.invert = CRC_FALSE,
		.custom_poly = CRC_FALSE, /* Use native hardware support */
		.data_out = &crc_output,
	};

	zassert_equal(crc_set_seed(crc_dev, 0x0000), 0, "CRC set seed failed");
	zassert_equal(crc_compute(crc_dev, &params), 0, "CRC compute failed");

	software_output = crc16_alt_sw(single_byte, ARRAY_SIZE(single_byte));
	zassert_equal(crc_output & 0xFFFF, software_output,
		      "HW/SW CRC mismatch: 0x%X != 0x%X", crc_output & 0xFFFF,
		      software_output);
}

ZTEST(crc_16_alt_tests, test_crc_16_alt_nonzero_seed)
{
	uint32_t crc_seed0 = 0;
	uint32_t crc_seedffff = 0;
	struct crc_params params = {
		.data_in = (uint8_t *)crc_test_data,
		.len = crc_test_data_len,
		.bit_swap = CRC_FALSE,
		.byte_swap = CRC_FALSE,
		.reflect = CRC_FALSE,
		.invert = CRC_FALSE,
		.custom_poly = CRC_FALSE, /* Use native hardware support */
		.data_out = &crc_seed0,
	};

	zassert_equal(crc_set_seed(crc_dev, 0x0000), 0, "seed 0 failed");
	zassert_equal(crc_compute(crc_dev, &params), 0,
		      "compute seed 0 failed");

	params.data_out = &crc_seedffff;
	zassert_equal(crc_set_seed(crc_dev, 0xFFFF), 0, "seed FFFF failed");
	zassert_equal(crc_compute(crc_dev, &params), 0,
		      "compute seed FFFF failed");

	zassert_not_equal(crc_seed0 & 0xFFFF, crc_seedffff & 0xFFFF,
			  "Different seeds produced same CRC16_ALT: 0x%X",
			  crc_seed0 & 0xFFFF);
}

ZTEST(crc_16_alt_tests, test_crc_16_alt_reflect_invert_combined)
{
	uint32_t crc_output;
	uint32_t software_output;
	struct crc_params params = {
		.data_in = (uint8_t *)crc_test_data,
		.len = crc_test_data_len,
		.bit_swap = CRC_FALSE,
		.byte_swap = CRC_FALSE,
		.reflect = CRC_TRUE,
		.invert = CRC_TRUE,
		.custom_poly = CRC_FALSE, /* Use native hardware support */
		.data_out = &crc_output,
	};

	zassert_equal(crc_set_seed(crc_dev, 0x0000), 0, "CRC set seed failed");
	zassert_equal(crc_compute(crc_dev, &params), 0, "CRC compute failed");

	software_output = crc16_alt_sw(crc_test_data, crc_test_data_len);
	software_output = bit_reflect_n(software_output, 16);
	software_output = (software_output ^ 0xFFFF);
	zassert_equal(crc_output & 0xFFFF, software_output,
		      "HW/SW CRC mismatch: 0x%X != 0x%X", crc_output & 0xFFFF,
		      software_output);
}

ZTEST_SUITE(crc_16_alt_tests, NULL, NULL, crc_16_alt_before, NULL, NULL);

#endif /* CONFIG_TEST_CRC_16_ALT */
```

## src/test_crc_32.c
```c
/* Copyright Alif Semiconductor - All Rights Reserved.
 * Use, distribution and modification of this code is permitted under the
 * terms stated in the Alif Semiconductor Software License Agreement
 *
 * You should have received a copy of the Alif Semiconductor Software
 * License Agreement with this file. If not, please write to:
 * contact@alifsemi.com, or visit: https://alifsemi.com/license
 */

#include "software_crc.h"

#include <zephyr/logging/log.h>

LOG_MODULE_DECLARE(alif_crc_test);

#if IS_ENABLED(CONFIG_TEST_CRC_32)

static void crc_32_before(void *fixture)
{
	ARG_UNUSED(fixture);

	crc_test_verify_device();
	crc_test_force_hw_algo(TEST_CRC_HW_ALGO_CRC32);
}

/* CRC32_POLY_REFLECTED now defined in test_crc_common.h */

static void crc32_validate_native_mode(const uint8_t *data, size_t len,
				       uint32_t *crc_output)
{
	struct crc_params params = {
		.data_in = data,
		.len = len,
		.bit_swap = CRC_TRUE,
		.byte_swap = CRC_TRUE,
		.reflect = CRC_TRUE,
		.invert = CRC_TRUE,
		.custom_poly = CRC_FALSE,
		.data_out = crc_output,
	};
	uint32_t software_output;

	zassert_equal(crc_set_seed(crc_dev, 0xFFFFFFFFU), 0,
		      "CRC set seed failed");
	zassert_equal(crc_compute(crc_dev, &params), 0, "CRC compute failed");

	software_output = crc32_full_reference(data, len);
	zassert_equal(*crc_output, software_output,
		      "HW/SW CRC mismatch: 0x%X != 0x%X", *crc_output,
		      software_output);
}

/* ZTC-1377 / ZTC-1379: Standard 32-bit CRC (full mode: */
/* swap + reflect + invert) */
ZTEST(crc_32_tests, test_crc_32_bit)
{
	uint32_t crc_output, software_output;
	struct crc_params params = {
		.data_in = (uint8_t *)crc_test_data,
		.len = crc_test_data_len,
		.bit_swap = CRC_TRUE,
		.byte_swap = CRC_TRUE,
		.reflect = CRC_TRUE,
		.invert = CRC_TRUE,
		.custom_poly = CRC_FALSE,
		.data_out = &crc_output,
	};

	zassert_equal(crc_set_seed(crc_dev, 0xFFFFFFFF), 0,
		      "CRC set seed failed");
	zassert_equal(crc_compute(crc_dev, &params), 0, "CRC compute failed");
	LOG_INF("32-bit CRC HW output: 0x%X", crc_output);

	software_output = crc32_full_reference((const uint8_t *)crc_test_data,
					       crc_test_data_len);
	LOG_INF("32-bit CRC SW output: 0x%X", software_output);

	zassert_equal(crc_output, software_output,
		      "HW/SW CRC mismatch: 0x%X != 0x%X", crc_output,
		      software_output);
}

/* ZTC-1187: 32-bit CRC with reflect output disabled */
ZTEST(crc_32_tests, test_crc_32_bit_reflect_output_disable)
{
	uint32_t crc_output, software_output;
	struct crc_params params = {
		.data_in = (uint8_t *)crc_test_data,
		.len = crc_test_data_len,
		.bit_swap = CRC_TRUE,
		.byte_swap = CRC_TRUE,
		.reflect = CRC_FALSE,
		.invert = CRC_TRUE,
		.custom_poly = CRC_FALSE,
		.data_out = &crc_output,
	};

	zassert_equal(crc_set_seed(crc_dev, 0xFFFFFFFF), 0,
		      "CRC set seed failed");
	zassert_equal(crc_compute(crc_dev, &params), 0, "CRC compute failed");
	LOG_INF("32-bit CRC HW output: 0x%X", crc_output);

	software_output = crc32_driver_reference(
		(const uint8_t *)crc_test_data, crc_test_data_len, 0xFFFFFFFFU,
		true, true, false, true, CRC32_POLY_NORMAL,
		CRC32_POLY_REFLECTED);
	LOG_INF("32-bit CRC SW output (reflect disabled): 0x%X",
		software_output);

	zassert_equal(crc_output, software_output,
		      "HW/SW CRC mismatch: 0x%X != 0x%X", crc_output,
		      software_output);
}

/* ZTC-NEW: 32-bit CRC with unaligned length (5 bytes — */
/* exercises SW fallback) */
ZTEST(crc_32_tests, test_crc_32_bit_unaligned_5_bytes)
{
	uint32_t crc_output, software_output;
	uint8_t data_5[] = {0x67, 0x3F, 0x90, 0xC9, 0x25};
	struct crc_params params = {
		.data_in = data_5,
		.len = 5,
		.bit_swap = CRC_TRUE,
		.byte_swap = CRC_TRUE,
		.reflect = CRC_TRUE,
		.invert = CRC_TRUE,
		.custom_poly = CRC_FALSE,
		.data_out = &crc_output,
	};

	zassert_equal(crc_set_seed(crc_dev, 0xFFFFFFFF), 0,
		      "CRC set seed failed");
	zassert_equal(crc_compute(crc_dev, &params), 0, "CRC compute failed");
	LOG_INF("32-bit CRC HW 5-byte output: 0x%X", crc_output);

	software_output = crc32_full_reference(data_5, 5);
	LOG_INF("32-bit CRC SW 5-byte output: 0x%X", software_output);

	zassert_equal(crc_output, software_output,
		      "HW/SW CRC mismatch (5-byte unaligned): 0x%X != 0x%X",
		      crc_output, software_output);
}

/* ZTC-NEW: 32-bit CRC with unaligned length (7 bytes) */
ZTEST(crc_32_tests, test_crc_32_bit_unaligned_7_bytes)
{
	uint32_t crc_output, software_output;
	uint8_t data_7[] = {0x67, 0x3F, 0x90, 0xC9, 0x25, 0xF0, 0x4A};
	struct crc_params params = {
		.data_in = data_7,
		.len = 7,
		.bit_swap = CRC_TRUE,
		.byte_swap = CRC_TRUE,
		.reflect = CRC_TRUE,
		.invert = CRC_TRUE,
		.custom_poly = CRC_FALSE,
		.data_out = &crc_output,
	};

	zassert_equal(crc_set_seed(crc_dev, 0xFFFFFFFF), 0,
		      "CRC set seed failed");
	zassert_equal(crc_compute(crc_dev, &params), 0, "CRC compute failed");
	LOG_INF("32-bit CRC HW 7-byte output: 0x%X", crc_output);

	software_output = crc32_full_reference(data_7, 7);
	LOG_INF("32-bit CRC SW 7-byte output: 0x%X", software_output);

	zassert_equal(crc_output, software_output,
		      "HW/SW CRC mismatch (7-byte unaligned): 0x%X != 0x%X",
		      crc_output, software_output);
}

/* ZTC-NEW: 32-bit CRC with unaligned length (1 byte — all SW fallback) */
ZTEST(crc_32_tests, test_crc_32_bit_unaligned_1_byte)
{
	uint32_t crc_output, software_output;
	uint8_t data_1[] = {0xAB};
	struct crc_params params = {
		.data_in = data_1,
		.len = 1,
		.bit_swap = CRC_TRUE,
		.byte_swap = CRC_TRUE,
		.reflect = CRC_TRUE,
		.invert = CRC_TRUE,
		.custom_poly = CRC_FALSE,
		.data_out = &crc_output,
	};

	zassert_equal(crc_set_seed(crc_dev, 0xFFFFFFFF), 0,
		      "CRC set seed failed");
	zassert_equal(crc_compute(crc_dev, &params), 0, "CRC compute failed");
	LOG_INF("32-bit CRC HW 1-byte output: 0x%X", crc_output);

	software_output = crc32_full_reference(data_1, 1);
	LOG_INF("32-bit CRC SW 1-byte output: 0x%X", software_output);

	zassert_equal(crc_output, software_output,
		      "HW/SW CRC mismatch (1-byte unaligned): 0x%X != 0x%X",
		      crc_output, software_output);
}

/* ZTC-NEW: 32-bit CRC with exactly 4-byte aligned length */
ZTEST(crc_32_tests, test_crc_32_bit_aligned_4_bytes)
{
	uint32_t crc_output, software_output;
	uint8_t data_4[] = {0x67, 0x3F, 0x90, 0xC9};
	struct crc_params params = {
		.data_in = data_4,
		.len = 4,
		.bit_swap = CRC_TRUE,
		.byte_swap = CRC_TRUE,
		.reflect = CRC_TRUE,
		.invert = CRC_TRUE,
		.custom_poly = CRC_FALSE,
		.data_out = &crc_output,
	};

	zassert_equal(crc_set_seed(crc_dev, 0xFFFFFFFF), 0,
		      "CRC set seed failed");
	zassert_equal(crc_compute(crc_dev, &params), 0, "CRC compute failed");
	LOG_INF("32-bit CRC HW 4-byte output: 0x%X", crc_output);

	software_output = crc32_full_reference(data_4, 4);
	LOG_INF("32-bit CRC SW 4-byte output: 0x%X", software_output);

	zassert_equal(crc_output, software_output,
		      "HW/SW CRC mismatch (4-byte aligned): 0x%X != 0x%X",
		      crc_output, software_output);
}

/* ZTC-NEW: 32-bit CRC with 8-byte aligned length */
ZTEST(crc_32_tests, test_crc_32_bit_aligned_8_bytes)
{
	uint32_t crc_output, software_output;
	uint8_t data_8[] = {0x67, 0x3F, 0x90, 0xC9, 0x25, 0xF0, 0x4A, 0xB1};
	struct crc_params params = {
		.data_in = data_8,
		.len = 8,
		.bit_swap = CRC_TRUE,
		.byte_swap = CRC_TRUE,
		.reflect = CRC_TRUE,
		.invert = CRC_TRUE,
		.custom_poly = CRC_FALSE,
		.data_out = &crc_output,
	};

	zassert_equal(crc_set_seed(crc_dev, 0xFFFFFFFF), 0,
		      "CRC set seed failed");
	zassert_equal(crc_compute(crc_dev, &params), 0, "CRC compute failed");
	LOG_INF("32-bit CRC HW 8-byte output: 0x%X", crc_output);

	software_output = crc32_full_reference(data_8, 8);
	LOG_INF("32-bit CRC SW 8-byte output: 0x%X", software_output);

	zassert_equal(crc_output, software_output,
		      "HW/SW CRC mismatch (8-byte aligned): 0x%X != 0x%X",
		      crc_output, software_output);
}

ZTEST(crc_32_tests, test_crc_32_bit_single_byte)
{
	uint32_t crc_output;
	uint32_t software_output;
	uint8_t single_byte[] = {0x55};
	struct crc_params params = {
		.data_in = single_byte,
		.len = ARRAY_SIZE(single_byte),
		.bit_swap = CRC_TRUE,
		.byte_swap = CRC_TRUE,
		.reflect = CRC_TRUE,
		.invert = CRC_TRUE,
		.custom_poly = CRC_FALSE,
		.data_out = &crc_output,
	};

	zassert_equal(crc_set_seed(crc_dev, 0xFFFFFFFF), 0,
		      "CRC set seed failed");
	zassert_equal(crc_compute(crc_dev, &params), 0, "CRC compute failed");

	software_output =
		crc32_full_reference(single_byte, ARRAY_SIZE(single_byte));
	zassert_equal(crc_output, software_output,
		      "HW/SW CRC mismatch: 0x%X != 0x%X", crc_output,
		      software_output);
}

ZTEST(crc_32_tests, test_crc_32_bit_misaligned_ptr_aligned_len)
{
	uint32_t crc_output = 0U;
	uint8_t raw_data[] = {0xA5, 0x67, 0x3F, 0x90, 0xC9,
			      0x25, 0xF0, 0x4A, 0xB1};
	const uint8_t *misaligned = &raw_data[1];

	zassert_true((((uintptr_t)misaligned) & 0x3U) != 0U,
		     "test buffer is unexpectedly aligned");

	crc32_validate_native_mode(misaligned, 8U, &crc_output);
}

ZTEST(crc_32_tests, test_crc_32_bit_misaligned_ptr_tail_len)
{
	uint32_t crc_output = 0U;
	uint8_t raw_data[] = {0x5A, 0x67, 0x3F, 0x90, 0xC9, 0x25, 0xF0, 0x4A};
	const uint8_t *misaligned = &raw_data[1];

	zassert_true((((uintptr_t)misaligned) & 0x3U) != 0U,
		     "test buffer is unexpectedly aligned");

	crc32_validate_native_mode(misaligned, 7U, &crc_output);
}

ZTEST(crc_32_tests, test_stress_vector_123456789)
{
	uint32_t crc_hw = 0;
	uint32_t crc_sw;
	struct crc_params params = {
		.data_in = crc_check_string,
		.len = CRC_CHECK_STRING_LEN,
		.bit_swap = CRC_TRUE,
		.byte_swap = CRC_TRUE,
		.reflect = CRC_TRUE,
		.invert = CRC_TRUE,
		.custom_poly = CRC_TRUE,
		.data_out = &crc_hw,
	};

	zassert_equal(crc_set_seed(crc_dev, 0xFFFFFFFFU), 0, "seed failed");
	zassert_equal(crc_set_polynomial(crc_dev, CRC32_POLY_NORMAL), 0,
		      "set CRC-32 polynomial failed");
	zassert_equal(crc_compute(crc_dev, &params), 0, "compute failed");

	crc_sw = crc32_full_reference(crc_check_string, CRC_CHECK_STRING_LEN);

	zassert_equal(crc_hw, crc_sw,
		      "CRC-32 full known vector mismatch: HW=0x%X SW=0x%X",
		      crc_hw, crc_sw);
}

ZTEST(crc_32_tests, test_stress_32x_std_repeat)
{
	uint32_t crc_first = 0;
	uint32_t crc_repeat = 0;
	uint32_t crc_sw;
	struct crc_params params = {
		.data_in = (uint8_t *)crc_test_data,
		.len = crc_test_data_len,
		.bit_swap = CRC_TRUE,
		.byte_swap = CRC_TRUE,
		.reflect = CRC_TRUE,
		.invert = CRC_TRUE,
		.custom_poly = CRC_FALSE,
		.data_out = &crc_first,
	};

	zassert_equal(crc_set_seed(crc_dev, 0xFFFFFFFFU), 0, "seed failed");
	zassert_equal(crc_compute(crc_dev, &params), 0, "compute first failed");

	crc_sw = crc32_full_reference((const uint8_t *)crc_test_data,
				      crc_test_data_len);
	zassert_equal(crc_first, crc_sw,
		      "CRC-32 full HW/SW mismatch: HW=0x%X SW=0x%X", crc_first,
		      crc_sw);

	for (int i = 0; i < 50; i++) {
		params.data_out = &crc_repeat;
		zassert_equal(crc_set_seed(crc_dev, 0xFFFFFFFFU), 0,
			      "seed iter %d failed", i);
		zassert_equal(crc_compute(crc_dev, &params), 0,
			      "compute iter %d failed", i);
		zassert_equal(crc_first, crc_repeat,
			      "CRC-32 full repeatability iter %d: 0x%X != 0x%X",
			      i, crc_first, crc_repeat);
	}
}

ZTEST(crc_32_tests, test_stress_unaligned_7_bytes)
{
	uint32_t crc_hw = 0;
	uint32_t crc_sw;
	uint8_t unaligned_data[7] = {0x12, 0x34, 0x56, 0x78, 0x9A, 0xBC, 0xDE};
	struct crc_params params = {
		.data_in = unaligned_data,
		.len = sizeof(unaligned_data),
		.bit_swap = CRC_TRUE,
		.byte_swap = CRC_TRUE,
		.reflect = CRC_TRUE,
		.invert = CRC_TRUE,
		.custom_poly = CRC_TRUE,
		.data_out = &crc_hw,
	};

	zassert_equal(crc_set_seed(crc_dev, 0xFFFFFFFFU), 0, "seed failed");
	zassert_equal(crc_set_polynomial(crc_dev, CRC32_POLY_NORMAL), 0,
		      "set CRC-32 polynomial failed");
	zassert_equal(crc_compute(crc_dev, &params), 0, "compute failed");

	crc_sw = crc32_full_reference(unaligned_data, sizeof(unaligned_data));

	zassert_equal(crc_hw, crc_sw,
		      "CRC-32 full unaligned tail mismatch: HW=0x%X SW=0x%X",
		      crc_hw, crc_sw);
}

ZTEST_SUITE(crc_32_tests, NULL, NULL, crc_32_before, NULL, NULL);

#endif /* CONFIG_TEST_CRC_32 */
```

## src/test_crc_32_custom.c
```c
// SPDX-License-Identifier: Apache-2.0

/* Copyright Alif Semiconductor - All Rights Reserved.
 * Use, distribution and modification of this code is permitted under the
 * terms stated in the Alif Semiconductor Software License Agreement
 *
 * You should have received a copy of the Alif Semiconductor Software
 * License Agreement with this file. If not, please write to:
 * contact@alifsemi.com, or visit: https://alifsemi.com/license
 */

#include "test_crc_common.h"

#include <zephyr/logging/log.h>
LOG_MODULE_DECLARE(alif_crc, CONFIG_LOG_DEFAULT_LEVEL);

#if IS_ENABLED(CONFIG_TEST_CRC_32_CUSTOM_POLY)

/* CRC-32 custom polynomial constants now defined in test_crc_common.h */

/* ZTC-1188 / ZTC-1379: 32-bit CRC with custom polynomial */
ZTEST(crc_test, crc_32_bit_custom_poly)
{
	uint32_t crc_output, software_output;
	struct crc_params params = {
		.data_in     = (uint8_t *)crc_test_data,
		.len         = crc_test_data_len,
		.bit_swap    = CRC_TRUE,
		.byte_swap   = CRC_TRUE,
		.reflect     = CRC_FALSE,
		.invert      = CRC_TRUE,
		.custom_poly = CRC_TRUE,
		.data_out    = &crc_output,
	};

	zassert_equal(crc_set_seed(crc_dev, 0xFFFFFFFF), 0,
		      "CRC set seed failed");
	zassert_equal(crc_set_polynomial(crc_dev, CRC32_CUSTOM_HW_POLY), 0,
		      "CRC set custom polynomial failed");
	zassert_equal(crc_compute(crc_dev, &params), 0,
		      "CRC compute failed");
	LOG_INF("32-bit custom poly CRC HW output: 0x%X", crc_output);

	software_output = crc_32((const unsigned char *)crc_test_data,
				 crc_test_data_len, CRC32_CUSTOM_SW_POLY_REFL);
	software_output = bit_reflect_32(software_output);
	LOG_INF("32-bit custom poly CRC SW output: 0x%X", software_output);

	zassert_equal(crc_output, software_output,
		      "HW/SW CRC mismatch: 0x%X != 0x%X",
		      crc_output, software_output);
}

/* ZTC-1386: 32-bit CRC custom poly with reflected output enabled */
ZTEST(crc_test, crc_32_bit_custom_poly_reflect_output_en)
{
	uint32_t crc_output, software_output;
	struct crc_params params = {
		.data_in     = (uint8_t *)crc_test_data,
		.len         = crc_test_data_len,
		.bit_swap    = CRC_TRUE,
		.byte_swap   = CRC_TRUE,
		.reflect     = CRC_TRUE,
		.invert      = CRC_TRUE,
		.custom_poly = CRC_TRUE,
		.data_out    = &crc_output,
	};

	zassert_equal(crc_set_seed(crc_dev, 0xFFFFFFFF), 0,
		      "CRC set seed failed");
	zassert_equal(crc_set_polynomial(crc_dev, CRC32_CUSTOM_HW_POLY), 0,
		      "CRC set custom polynomial failed");
	zassert_equal(crc_compute(crc_dev, &params), 0,
		      "CRC compute failed");
	LOG_INF("32-bit custom poly CRC HW output: 0x%X", crc_output);

	software_output = crc_32((const unsigned char *)crc_test_data,
				 crc_test_data_len, CRC32_CUSTOM_SW_POLY_REFL);
	LOG_INF("32-bit custom poly CRC SW output: 0x%X", software_output);

	zassert_equal(crc_output, software_output,
		      "HW/SW CRC mismatch: 0x%X != 0x%X",
		      crc_output, software_output);
}

#endif /* CONFIG_TEST_CRC_32_CUSTOM_POLY */
```
