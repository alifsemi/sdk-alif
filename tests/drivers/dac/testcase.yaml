## tests/drivers/utimer_qdec/testcase.yaml
```yaml
common:
  depends_on: utimer_qdec
  tags: qdec
  harness: ztest

tests:
  drivers.utimer.qdec:
    extra_dtc_overlay_files:
      - boards/alif_ensemble_qdec.overlay
    integration_platforms:
      - alif_e8_dk/ae822fa0e5597xx0/rtss_he
      - alif_e8_dk/ae822fa0e5597xx0/rtss_hp
      - alif_e7_dk/ae722f80f55d5xx/rtss_he
      - alif_e7_dk/ae722f80f55d5xx/rtss_hp
    platform_allow:
      - alif_e8_dk/ae822fa0e5597xx0/rtss_he
      - alif_e8_dk/ae822fa0e5597xx0/rtss_hp
      - alif_e7_dk/ae722f80f55d5xx/rtss_he
      - alif_e7_dk/ae722f80f55d5xx/rtss_hp

  drivers.sensor.alif_utimer_qdec.b1:
    extra_dtc_overlay_files:
      - boards/alif_b1_dk_rtss_he.overlay
    integration_platforms:
      - alif_b1_dk/ab1c1f4m51820ph0/rtss_he
    platform_allow:
      - alif_b1_dk/ab1c1f4m51820ph0/rtss_he

  drivers.sensor.alif_utimer_qdec.e1c:
    extra_dtc_overlay_files:
      - boards/alif_e1c_dk_rtss_he.overlay
    integration_platforms:
      - alif_e1c_dk/ae1c1f4051920hh/rtss_he
    platform_allow:
      - alif_e1c_dk/ae1c1f4051920hh/rtss_he
```

## tests/drivers/video/testcase.yaml
```yaml
common:
  tags:
    - drivers
    - video
    - cpi
  depends_on: video
  harness: ztest
  harness_config:
    fixture: fixture_camera
  platform_allow:
    - alif_b1_dk/ab1c1f4m51820ph0/rtss_he
    - alif_e1c_dk/ae1c1f4051920hh/rtss_he
    - alif_e8_dk/ae822fa0e5597xx0/rtss_he
    - alif_e8_dk/ae822fa0e5597xx0/rtss_hp
    - alif_e7_dk/ae722f80f55d5xx/rtss_he
    - alif_e7_dk/ae722f80f55d5xx/rtss_hp
  integration_platforms:
    - alif_b1_dk/ab1c1f4m51820ph0/rtss_he
    - alif_e1c_dk/ae1c1f4051920hh/rtss_he
    - alif_e8_dk/ae822fa0e5597xx0/rtss_he
    - alif_e8_dk/ae822fa0e5597xx0/rtss_hp
    - alif_e7_dk/ae722f80f55d5xx/rtss_he
    - alif_e7_dk/ae722f80f55d5xx/rtss_hp

tests:
  # Default test: relies on the auto-picked per-board overlay
  # (boards/<board>.overlay). Used for Balletto targets (B1-DK, E1C-DK)
  # whose LPCPI wiring differs from the Ensemble CPI overlays below.
  drivers.video.cpi:
    filter: dt_compat_enabled("alif,cam") and dt_compat_enabled("aptina,mt9m114")
    platform_allow:
      - alif_b1_dk/ab1c1f4m51820ph0/rtss_he
      - alif_e1c_dk/ae1c1f4051920hh/rtss_he

  # Ensemble CPI (&cam + &i2c1). Forces cpi_mt9m114.overlay, which
  # references node labels that exist only on Ensemble targets (E8, E7).
  drivers.video.cpi.mt9m114:
    extra_args:
      - "DTC_OVERLAY_FILE=boards/cpi_mt9m114.overlay"
    filter: dt_compat_enabled("alif,cam") and dt_compat_enabled("aptina,mt9m114")
    platform_allow:
      - alif_e8_dk/ae822fa0e5597xx0/rtss_hp
      - alif_e8_dk/ae822fa0e5597xx0/rtss_he
      - alif_e7_dk/ae722f80f55d5xx/rtss_hp
      - alif_e7_dk/ae722f80f55d5xx/rtss_he

  # Ensemble LPCPI (&lpcam + &i2c1). Same SoC-family restriction as above.
  drivers.video.cpi.lpcpi_mt9m114:
    extra_args:
      - "DTC_OVERLAY_FILE=boards/lpcpi_mt9m114.overlay"
    filter: dt_compat_enabled("alif,cam") and dt_compat_enabled("aptina,mt9m114")
    platform_allow:
      - alif_e8_dk/ae822fa0e5597xx0/rtss_he
      - alif_e7_dk/ae722f80f55d5xx/rtss_he

  drivers.video.cpi.arx3a0_isp:
    extra_args:
      - "DTC_OVERLAY_FILE=boards/serial_camera_arx3a0_selfie.overlay"
      - "EXTRA_CONF_FILE=boards/isp.conf"
    filter: dt_compat_enabled("alif,cam") and dt_compat_enabled("onnn,arx3a0")
      and dt_compat_enabled("vsi,isp-pico")
    tags:
      - drivers
      - video
      - cpi
      - isp
      - csi2
```

## west.yml
```yaml
# The west manifest file (west.yml) for the Alif SDK.
#
# The per-installation west configuration file, .west/config, sets the
# path to the project containing this file in the [manifest] section's
# "path" variable.
#
# See the west documentation for more information:
# https://docs.zephyrproject.org/latest/develop/west/index.html

manifest:
  version: "0.13"

  defaults:
    remote: alif

  remotes:
    - name: alif
      url-base: https://github.com/alifsemi
    # Other repository sources:
    - name: zephyrproject
      url-base: https://github.com/zephyrproject-rtos
    - name: armmbed
      url-base: https://github.com/ARMmbed

  #
  # Please add items below based on alphabetical order
  projects:

    - name: zephyr
      repo-path: zephyr_alif
      revision: 15d452902c416ff6590e3820264b98ba174388e2
      import:
        # In addition to the zephyr repository itself,
        # Alif SDK fetches the needed projects
        #
        # Please keep this list sorted alphabetically.
        name-allowlist:
          - canopennode
          - chre
          - edtt
          - executorch
          - fatfs
          - hal_alif
          - hal_ethos_u
          - liblc3
          - libmetal
          - littlefs
          - lvgl
          - lz4
          - mbedtls
          - mipi-sys-t
          - nanopb
          - net-tools
          - openthread
          - picolibc
          - psa-arch-tests
          - segger
          - tinycrypt
          - tf-m-tests
          - tflite-micro
          - TraceRecorderSource
          - uoscore-uedhoc
          - zcbor
          - zscilib
          - cmsis-dsp
    - name: matter
      repo-path: matter_alif
      revision: main
      path: modules/lib/matter

    - name: mcuboot_alif
      repo-path: mcuboot_alif
      path: bootloader/mcuboot
      revision: 346f7374ff4467e40b5594658f8ac67a5e9813c9

    - name: cmsis_alif
      revision: 85f6b92af0f6ac72594d391f895c45cc30847e41
      path: modules/hal/cmsis
      groups:
         - hal

    - name: dave2d
      repo-path: alif_dave2d-driver
      revision: d667a8e47f13e2f39bc724d66def5230827b2808
      path: modules/drivers/dave2d

    - name: aipl
      repo-path: alif_image-processing-lib
      revision: b4444c0504be3a1eed4a0655c9a95fe343706dcb
      path: modules/lib/aipl

  self:
    path: alif
    west-commands: scripts/west-commands.yml
    import: submanifests
```
