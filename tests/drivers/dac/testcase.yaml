## tests/drivers/dac/testcase.yaml
```yaml
common:
  tags: drivers dac
  harness: ztest
  timeout: 600
  platform_allow:
    - alif_b1_dk/ab1c1f4m51820ph0/rtss_he
    - alif_e1c_dk/ae1c1f4051920hh/rtss_he
    - alif_e8_dk/ae822fa0e5597xx0/rtss_he
    - alif_e8_dk/ae822fa0e5597xx0/rtss_hp
    - alif_e7_dk/ae722f80f55d5xx/rtss_he
    - alif_e7_dk/ae722f80f55d5xx/rtss_hp
  integration_platforms:
    - alif_e8_dk/ae822fa0e5597xx0/rtss_he

tests:
  drivers.dac.dac0:
    extra_dtc_overlay_files:
      - alif_dac0.overlay

  drivers.dac.dac0_twoscomp:
    extra_dtc_overlay_files:
      - alif_dac0_twoscomp.overlay

  drivers.dac.dac1:
    extra_dtc_overlay_files:
      - alif_dac1.overlay

  drivers.dac.dual:
    extra_dtc_overlay_files:
      - alif_dac_dual.overlay

  drivers.dac.dac0_max_current:
    extra_dtc_overlay_files:
      - alif_dac0_max_current.overlay

  drivers.dac.dac0_min_current:
    extra_dtc_overlay_files:
      - alif_dac0_min_current.overlay
```

## tests/drivers/gpio/testcase.yaml
```yaml
sample:
  name: Blinky Sample
tests:
  sample.basic.blinky:
    tags: LED gpio
    platform_allow:
      - alif_b1_dk/ab1c1f4m51820hh/rtss_he
      - alif_e8_dk/ae822fa0e5597xx0/rtss_he
      - alif_e8_dk/ae822fa0e5597xx0/rtss_hp
      - alif_e7_dk/ae722f80f55d5xx/rtss_he
      - alif_e7_dk/ae722f80f55d5xx/rtss_hp
    harness: ztest
    integration_platforms:
      - alif_b1_dk/ab1c1f4m51820hh/rtss_he
      - alif_e8_dk/ae822fa0e5597xx0/rtss_he
      - alif_e8_dk/ae822fa0e5597xx0/rtss_hp
      - alif_e7_dk/ae722f80f55d5xx/rtss_he
      - alif_e7_dk/ae722f80f55d5xx/rtss_hp
```

## tests/drivers/hwsem/testcase.yaml
```yaml
tests:
  drivers.hwsem:
    tags: HWSEM
    platform_allow:
      - alif_e8_dk/ae822fa0e5597xx0/rtss_he
      - alif_e8_dk/ae822fa0e5597xx0/rtss_hp
      - alif_e7_dk/ae722f80f55d5xx/rtss_he
      - alif_e7_dk/ae722f80f55d5xx/rtss_hp
      - alif_e4_dk/ae402fa0e5597xx0/rtss_he
      - alif_e4_dk/ae402fa0e5597xx0/rtss_hp
      - alif_e3_dk/ae302f80f55d5xx/rtss_he
      - alif_e3_dk/ae302f80f55d5xx/rtss_hp
    harness: ztest
    integration_platforms:
      - alif_e8_dk/ae822fa0e5597xx0/rtss_he
      - alif_e8_dk/ae822fa0e5597xx0/rtss_hp
      - alif_e7_dk/ae722f80f55d5xx/rtss_he
      - alif_e7_dk/ae722f80f55d5xx/rtss_hp
      - alif_e4_dk/ae402fa0e5597xx0/rtss_he
      - alif_e4_dk/ae402fa0e5597xx0/rtss_hp
      - alif_e3_dk/ae302f80f55d5xx/rtss_he
      - alif_e3_dk/ae302f80f55d5xx/rtss_hp
```

## tests/drivers/i2c/testcase.yaml
```yaml
common:
  tags:
    - drivers
    - i2c
  extra_conf_files:
    - prj.conf
  platform_allow:
    - alif_e7_dk/ae722f80f55d5xx/rtss_hp
    - alif_e7_dk/ae722f80f55d5xx/rtss_he
    - alif_e8_dk/ae822fa0e5597xx0/rtss_hp
    - alif_e8_dk/ae822fa0e5597xx0/rtss_he
    - alif_e1c_dk/ae1c1f4051920hh/rtss_he
    - alif_b1_dk/ab1c1f4m51820hh0/rtss_he
    - alif_b1_dk/ab1c1f4m51820ph0/rtss_he
  integration_platforms:
    - alif_e8_dk/ae822fa0e5597xx0/rtss_he
  depends_on: i2c
  harness: ztest
  filter: dt_alias_exists("i2c_controller") and \
          dt_alias_exists("i2c_target")
  extra_dtc_overlay_files:
    - boards/i2c.overlay

tests:
  drivers.i2c.api:
    timeout: 60

  drivers.i2c.smoke:
    timeout: 120
    extra_configs:
      - CONFIG_I2C_TEST_FREQ_FAST=n
      - CONFIG_I2C_TEST_FREQ_FAST_PLUS=n
      - CONFIG_I2C_TEST_FREQ_HIGH=n

  drivers.i2c.all:
    timeout: 600
    extra_configs:
      - CONFIG_I2C_ALL_TESTS=y

  drivers.i2c.all.buffer:
    timeout: 600
    extra_configs:
      - CONFIG_I2C_ALL_TESTS=y
      - CONFIG_I2C_TARGET_BUFFER_MODE=y

  drivers.i2c.performance:
    timeout: 180
    extra_configs:
      - CONFIG_I2C_PERFORMANCE_TESTS=y

  drivers.i2c.stress.basic:
    timeout: 300
    extra_configs:
      - CONFIG_I2C_STRESS_TESTS=y

  drivers.i2c.stress:
    timeout: 300
    extra_configs:
      - CONFIG_I2C_ENHANCED_STRESS=y

  drivers.i2c.stress.buffer:
    timeout: 300
    extra_configs:
      - CONFIG_I2C_TARGET_BUFFER_MODE=y
      - CONFIG_I2C_STRESS_TESTS=y

  drivers.i2c.stress.restart:
    timeout: 300
    extra_configs:
      - CONFIG_I2C_STRESS_TESTS=y
    testcases:
      - i2c_stress.test_wr_restart_integrity

  drivers.i2c.stress.restart.buffer:
    timeout: 300
    extra_configs:
      - CONFIG_I2C_TARGET_BUFFER_MODE=y
      - CONFIG_I2C_STRESS_TESTS=y
    testcases:
      - i2c_stress.test_wr_restart_integrity

  drivers.i2c.boundary:
    timeout: 300
    extra_configs:
      - CONFIG_I2C_BOUNDARY_TESTS=y

  drivers.i2c.boundary.buffer:
    timeout: 300
    extra_configs:
      - CONFIG_I2C_BOUNDARY_TESTS=y
      - CONFIG_I2C_TARGET_BUFFER_MODE=y

  drivers.i2c.fault:
    timeout: 300
    extra_configs:
      - CONFIG_I2C_FAULT_INJECTION_TESTS=y

  drivers.i2c.fault.buffer:
    timeout: 300
    extra_configs:
      - CONFIG_I2C_FAULT_INJECTION_TESTS=y
      - CONFIG_I2C_TARGET_BUFFER_MODE=y

  drivers.i2c.hardware:
    timeout: 400
    extra_configs:
      - CONFIG_I2C_HARDWARE_AWARE_TESTS=y

  drivers.i2c.hardware.buffer:
    timeout: 400
    extra_configs:
      - CONFIG_I2C_HARDWARE_AWARE_TESTS=y
      - CONFIG_I2C_TARGET_BUFFER_MODE=y

  drivers.i2c.bme680:
    tags:
      - drivers
      - i2c
      - sensor
    depends_on:
      - i2c
      - sensor
    filter: dt_alias_exists("i2c_controller")
    extra_dtc_overlay_files:
      - boards/i2c.overlay
      - boards/i2c_bme680.overlay
    extra_configs:
      - CONFIG_I2C_BME680_TESTS=y
```

## tests/drivers/i3c/testcase.yaml
```yaml
common:
  tags:
    - drivers
    - i3c
  extra_conf_files:
    - prj.conf
  platform_allow:
    - alif_e7_dk/ae722f80f55d5xx/rtss_he
    - alif_e7_dk/ae722f80f55d5xx/rtss_hp
    - alif_e8_dk/ae822fa0e5597xx0/rtss_he
    - alif_e8_dk/ae822fa0e5597xx0/rtss_hp
    - alif_e1c_dk/ae1c1f4051920hh/rtss_he
    - alif_b1_dk/ab1c1f4m51820hh0/rtss_he

tests:
  # =====================================================================
  # All I3C tests combined
  # =====================================================================
  drivers.i3c.all:
    extra_dtc_overlay_files:
      - boards/i3c_test.overlay
    extra_configs:
      - CONFIG_I3C_ALL_TESTS=y
    integration_platforms:
      - alif_e7_dk/ae722f80f55d5xx/rtss_he

  # =====================================================================
  # Individual test suites
  # =====================================================================
  drivers.i3c.discovery:
    extra_dtc_overlay_files:
      - boards/i3c_test.overlay
    extra_configs:
      - CONFIG_I3C_DISCOVERY_TESTS=y
    integration_platforms:
      - alif_e7_dk/ae722f80f55d5xx/rtss_he

  drivers.i3c.ccc:
    extra_dtc_overlay_files:
      - boards/i3c_test.overlay
    extra_configs:
      - CONFIG_I3C_CCC_TESTS=y
    integration_platforms:
      - alif_e7_dk/ae722f80f55d5xx/rtss_he

  drivers.i3c.ibi:
    extra_dtc_overlay_files:
      - boards/i3c_test.overlay
    extra_configs:
      - CONFIG_I3C_IBI_TESTS=y
    integration_platforms:
      - alif_e7_dk/ae722f80f55d5xx/rtss_he

  drivers.i3c.negative:
    extra_dtc_overlay_files:
      - boards/i3c_test.overlay
    extra_configs:
      - CONFIG_I3C_NEGATIVE_TESTS=y
    integration_platforms:
      - alif_e7_dk/ae722f80f55d5xx/rtss_he

  drivers.i3c.stress:
    extra_dtc_overlay_files:
      - boards/i3c_test.overlay
    extra_configs:
      - CONFIG_I3C_STRESS_TESTS=y
    integration_platforms:
      - alif_e7_dk/ae722f80f55d5xx/rtss_he

  drivers.i3c.sensor:
    tags:
      - drivers
      - i3c
      - sensor
    depends_on:
      - i3c
      - sensor
    extra_dtc_overlay_files:
      - boards/i3c_test.overlay
    extra_configs:
      - CONFIG_I3C_SENSOR_TESTS=y
    integration_platforms:
      - alif_e7_dk/ae722f80f55d5xx/rtss_he
```

## tests/drivers/jpeg/testcase.yaml
```yaml
common:
  tags:
    - drivers
    - video
    - jpeg
  depends_on: video
  harness: ztest
  harness_config:
    fixture: fixture_jpeg
  platform_allow:
    - alif_e8_dk/ae822fa0e5597xx0/rtss_hp
    - alif_e8_dk/ae822fa0e5597xx0/rtss_he
  integration_platforms:
    - alif_e8_dk/ae822fa0e5597xx0/rtss_hp

tests:
  drivers.video.jpeg.hantro_vc9000e:
    filter: dt_compat_enabled("verisilicon,hantro-vc9000e-jpeg")
```

## tests/drivers/lptimer/testcase.yaml
```yaml
tests:
  drivers.counter.basic_api:
    tags: drivers counter
    depends_on: counter
    min_ram: 16
    platform_allow:
      - alif_b1_dk/ab1c1f4m51820ph0/rtss_he
      - alif_e1c_dk/ae1c1f4051920hh/rtss_he
      - alif_e8_dk/ae822fa0e5597xx0/rtss_he
      - alif_e8_dk/ae822fa0e5597xx0/rtss_hp
      - alif_e7_dk/ae722f80f55d5xx/rtss_he
      - alif_e7_dk/ae722f80f55d5xx/rtss_hp
      - alif_ensemble/ae722f80f55d5as0/rtss_he
      - alif_ensemble/ae722f80f55d5as0/rtss_hp
      - alif_spark/ae722f80f55d5as0/rtss_he
      - alif_spark/ae722f80f55d5as0/rtss_hp
    timeout: 600
    harness: ztest
    integration_platforms:
      - alif_e8_dk/ae822fa0e5597xx0/rtss_he
      - alif_e7_dk/ae722f80f55d5xx/rtss_he
  drivers.counter.basic_api.zli:
    tags: drivers counter
    depends_on: counter
    platform_allow:
      - alif_e8_dk/ae822fa0e5597xx0/rtss_he
      - alif_e7_dk/ae722f80f55d5xx/rtss_he
    timeout: 400
    harness: ztest
    extra_args: OVERLAY_CONFIG="zli.conf"
```

## tests/drivers/rtc/testcase.yaml
```yaml
tests:
  drivers.rtc:
    tags: drivers counter
    depends_on: counter
    min_ram: 16
    timeout: 600
    platform_allow:
      - alif_b1_dk/ab1c1f4m51820hh/rtss_he
      - alif_e1c_dk/ae1c1f4051920hh/rtss_he
      - alif_e8_dk/ae822fa0e5597xx0/rtss_he
      - alif_e8_dk/ae822fa0e5597xx0/rtss_hp
      - alif_e7_dk/ae722f80f55d5xx/rtss_he
      - alif_e7_dk/ae722f80f55d5xx/rtss_hp
      - alif_e4_dk/ae402fa0e5597xx0/rtss_he
      - alif_e4_dk/ae402fa0e5597xx0/rtss_hp
      - alif_e3_dk/ae302f80f55d5xx/rtss_he
      - alif_e3_dk/ae302f80f55d5xx/rtss_hp
    harness: ztest
    integration_platforms:
      - alif_b1_dk/ab1c1f4m51820hh/rtss_he
      - alif_e1c_dk/ae1c1f4051920hh/rtss_he
      - alif_e8_dk/ae822fa0e5597xx0/rtss_he
      - alif_e8_dk/ae822fa0e5597xx0/rtss_hp
      - alif_e7_dk/ae722f80f55d5xx/rtss_he
      - alif_e7_dk/ae722f80f55d5xx/rtss_hp
      - alif_e4_dk/ae402fa0e5597xx0/rtss_he
      - alif_e4_dk/ae402fa0e5597xx0/rtss_hp
      - alif_e3_dk/ae302f80f55d5xx/rtss_he
      - alif_e3_dk/ae302f80f55d5xx/rtss_hp
```

## tests/drivers/spi/testcase.yaml
```yaml
common:
  tags:
    - drivers
    - spi
    - gpio
  extra_conf_files:
    - prj.conf
  platform_allow:
    - alif_e7_dk/ae722f80f55d5xx/rtss_he
    - alif_e7_dk/ae722f80f55d5xx/rtss_hp
    - alif_e8_dk/ae822fa0e5597xx0/rtss_he
    - alif_e8_dk/ae822fa0e5597xx0/rtss_hp
    - alif_e1c_dk/ae1c1f4051920hh/rtss_he
    - alif_b1_dk/ab1c1f4m51820hh0/rtss_he

tests:
  drivers.spi.alif.loopback:
    extra_dtc_overlay_files:
      - boards/spi.overlay
    extra_configs:
      - CONFIG_TEST_SPI_LOOPBACK=y

  drivers.spi.alif.loopback.explicit:
    extra_dtc_overlay_files:
      - boards/spi.overlay
    extra_configs:
      - CONFIG_TEST_SPI_LOOPBACK=y

  drivers.spi.alif.perf:
    extra_dtc_overlay_files:
      - boards/spi.overlay
    extra_configs:
      - CONFIG_TEST_SPI_PERFORMANCE=y

  drivers.spi.alif.perf.dma:
    extra_dtc_overlay_files:
      - boards/spi.overlay
      - boards/spi_DMA.overlay
    extra_configs:
      - CONFIG_TEST_SPI_PERFORMANCE=y
      - CONFIG_TEST_SPI_USE_DMA=y

  drivers.spi.alif.perf.dma.evtrtr:
    extra_dtc_overlay_files:
      - boards/spi.overlay
      - boards/spi_DMA_evtrtr.overlay
    extra_configs:
      - CONFIG_TEST_SPI_PERFORMANCE=y
      - CONFIG_TEST_SPI_USE_DMA=y

  drivers.spi.alif.negative:
    extra_dtc_overlay_files:
      - boards/spi.overlay
    extra_configs:
      - CONFIG_TEST_SPI_NEGATIVE=y

  drivers.spi.alif.loopback.ext:
    extra_dtc_overlay_files:
      - boards/spi.overlay
    extra_configs:
      - CONFIG_TEST_SPI_LOOPBACK=y
      - CONFIG_TEST_SPI_INTERNAL_LOOPBACK=n

  drivers.spi.alif.boundary:
    extra_dtc_overlay_files:
      - boards/spi.overlay
    extra_configs:
      - CONFIG_TEST_SPI_BOUNDARY=y

  drivers.spi.alif.boundary.ext:
    extra_dtc_overlay_files:
      - boards/spi.overlay
    extra_configs:
      - CONFIG_TEST_SPI_BOUNDARY=y
      - CONFIG_TEST_SPI_INTERNAL_LOOPBACK=n

  drivers.spi.alif.stress:
    extra_dtc_overlay_files:
      - boards/spi.overlay
    extra_configs:
      - CONFIG_TEST_SPI_STRESS=y

  drivers.spi.alif.stress.dma:
    extra_dtc_overlay_files:
      - boards/spi.overlay
      - boards/spi_DMA.overlay
    extra_configs:
      - CONFIG_TEST_SPI_STRESS=y
      - CONFIG_TEST_SPI_USE_DMA=y

  drivers.spi.alif.stress.dma.evtrtr:
    extra_dtc_overlay_files:
      - boards/spi.overlay
      - boards/spi_DMA_evtrtr.overlay
    extra_configs:
      - CONFIG_TEST_SPI_STRESS=y
      - CONFIG_TEST_SPI_USE_DMA=y

  drivers.spi.alif.lpspi.loopback:
    extra_dtc_overlay_files:
      - boards/lpspi.overlay
    extra_configs:
      - CONFIG_TEST_SPI_LOOPBACK=y

  drivers.spi.alif.lpspi.perf:
    extra_dtc_overlay_files:
      - boards/lpspi.overlay
    extra_configs:
      - CONFIG_TEST_SPI_PERFORMANCE=y

  drivers.spi.alif.lpspi.perf.dma:
    extra_dtc_overlay_files:
      - boards/lpspi.overlay
      - boards/lpspi_DMA.overlay
    extra_configs:
      - CONFIG_TEST_SPI_PERFORMANCE=y
      - CONFIG_TEST_SPI_USE_DMA=y

  drivers.spi.alif.lpspi.perf.dma.evtrtr:
    extra_dtc_overlay_files:
      - boards/lpspi.overlay
      - boards/lpspi_DMA_evtrtr.overlay
    extra_configs:
      - CONFIG_TEST_SPI_PERFORMANCE=y
      - CONFIG_TEST_SPI_USE_DMA=y

  drivers.spi.alif.lpspi.stress:
    extra_dtc_overlay_files:
      - boards/lpspi.overlay
    extra_configs:
      - CONFIG_TEST_SPI_STRESS=y

  drivers.spi.alif.lpspi.stress.dma:
    extra_dtc_overlay_files:
      - boards/lpspi.overlay
      - boards/lpspi_DMA.overlay
    extra_configs:
      - CONFIG_TEST_SPI_STRESS=y
      - CONFIG_TEST_SPI_USE_DMA=y

  drivers.spi.alif.lpspi.stress.dma.evtrtr:
    extra_dtc_overlay_files:
      - boards/lpspi.overlay
      - boards/lpspi_DMA_evtrtr.overlay
    extra_configs:
      - CONFIG_TEST_SPI_STRESS=y
      - CONFIG_TEST_SPI_USE_DMA=y
```

## tests/drivers/spi_flash/basic_tests/testcase.yaml
```yaml
tests:
  drivers.spi_flash.basic_tests:
    tags: OSPI
    platform_allow:
	- alif_b1_dk/ab1c1f4m51820hh/rtss_he
	- alif_e8_dk/ae822fa0e5597xx0/rtss_he
	- alif_e8_dk/ae822fa0e5597xx0/rtss_hp
	- alif_e7_dk/ae722f80f55d5xx/rtss_he
	- alif_e7_dk/ae722f80f55d5xx/rtss_hp
    harness: ztest
    integration_platforms:
	- alif_b1_dk/ab1c1f4m51820hh/rtss_he
	- alif_e8_dk/ae822fa0e5597xx0/rtss_he
	- alif_e8_dk/ae822fa0e5597xx0/rtss_hp
	- alif_e7_dk/ae722f80f55d5xx/rtss_he
	- alif_e7_dk/ae722f80f55d5xx/rtss_hp
```

## tests/drivers/utimer/testcase.yaml
```yaml
common:
  tags:
    - drivers
    - counter
    - alif
  depends_on: counter
  harness: ztest
  timeout: 600

tests:
  drivers.counter.alif_utimer:
    extra_args:
      - DTC_OVERLAY_FILE=boards/alif_utimer.overlay
    integration_platforms:
      - alif_e8_dk/ae822fa0e5597xx0/rtss_he
      - alif_e8_dk/ae822fa0e5597xx0/rtss_hp
      - alif_e7_dk/ae722f80f55d5xx/rtss_he
      - alif_e7_dk/ae722f80f55d5xx/rtss_hp
    platform_allow:
      - alif_e8_dk/ae822fa0e5597xx0/rtss_he
      - alif_e8_dk/ae822fa0e5597xx0/rtss_hp
      - alif_e7_dk/ae722f80f55d5xx/rtss_he
      - alif_e7_dk/ae722f80f55d5xx/rtss_hp

  drivers.counter.alif_lputimer:
    extra_args:
      - DTC_OVERLAY_FILE=boards/alif_lputimer.overlay
    integration_platforms:
      - alif_b1_dk/ab1c1f4m51820ph0/rtss_he
    platform_allow:
      - alif_b1_dk/ab1c1f4m51820ph0/rtss_he
```
