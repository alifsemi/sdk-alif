## CMakeLists.txt
```
cmake_minimum_required(VERSION 3.20.0)
find_package(Zephyr REQUIRED HINTS $ENV{ZEPHYR_BASE})
project(alif_dac)

target_sources(app PRIVATE
  src/main.c
  src/test_dac_basic.c
  src/test_dac_boundary.c
  src/test_dac_capacitance.c
  src/test_dac_continuous.c
  src/test_dac_data_format.c
)
```

## prj.conf
```kconfig
CONFIG_DAC=y
CONFIG_USE_ALIF_HAL_ANALOG=y
CONFIG_ZTEST=y
CONFIG_LOG=y
```

## alif_dac0.overlay
```dts
/* Copyright (C) 2026 Alif Semiconductor - All Rights Reserved.
 * Use, distribution and modification of this code is permitted under the
 * terms stated in the Alif Semiconductor Software License Agreement
 *
 * You should have received a copy of the Alif Semiconductor Software
 * License Agreement with this file. If not, please write to:
 * contact@alifsemi.com, or visit: https://alifsemi.com/license
 *
 */

/ {
	aliases {
		dac = &dac0;
	};
};

&dac0 {
	status = "okay";
	/* Load capacitance compensation: 4pF */
	capacitance = "DAC_4PF_CAPACITANCE";
	/* Output current: 800 uA */
	output_current = "DAC_800UA_OUT_CUR";
};
```

## alif_dac1.overlay
```dts
/* Copyright (C) 2026 Alif Semiconductor - All Rights Reserved.
 * Use, distribution and modification of this code is permitted under the
 * terms stated in the Alif Semiconductor Software License Agreement
 *
 * You should have received a copy of the Alif Semiconductor Software
 * License Agreement with this file. If not, please write to:
 * contact@alifsemi.com, or visit: https://alifsemi.com/license
 *
 */


/ {
	aliases {
		dac = &dac1;
	};
};

&dac1 {
	status = "okay";
	/* Load capacitance compensation: 4pF */
	capacitance = "DAC_4PF_CAPACITANCE";
	/* Output current: 800 uA */
	output_current = "DAC_800UA_OUT_CUR";
};
```

## boards/alif_dac0_max_current.overlay
```dts
/* Copyright (C) 2026 Alif Semiconductor - All Rights Reserved.
 * Use, distribution and modification of this code is permitted under the
 * terms stated in the Alif Semiconductor Software License Agreement
 *
 * You should have received a copy of the Alif Semiconductor Software
 * License Agreement with this file. If not, please write to:
 * contact@alifsemi.com, or visit: https://alifsemi.com/license
 *
 */

/ {
	aliases {
		dac = &dac0;
	};
};

&dac0 {
	status = "okay";
	/* Two's complement mode disabled (property omitted) */
	/* Load capacitance compensation: 4pF */
	capacitance = "DAC_4PF_CAPACITANCE";
	/* Output current: MAXIMUM 1500 uA (1.5 mA) - HRM maximum */
	output_current = "DAC_1500UA_OUT_CUR";
};
```

## boards/alif_dac0_min_current.overlay
```dts
/* Copyright (C) 2026 Alif Semiconductor - All Rights Reserved.
 * Use, distribution and modification of this code is permitted under the
 * terms stated in the Alif Semiconductor Software License Agreement
 *
 * You should have received a copy of the Alif Semiconductor Software
 * License Agreement with this file. If not, please write to:
 * contact@alifsemi.com, or visit: https://alifsemi.com/license
 *
 */

/ {
	aliases {
		dac = &dac0;
	};
};

&dac0 {
	status = "okay";
	/* Two's complement mode disabled (property omitted) */
	/* Load capacitance compensation: 4pF */
	capacitance = "DAC_4PF_CAPACITANCE";
	/* Output current: MINIMUM 0 uA - for light load testing */
	output_current = "DAC_0UA_OUT_CUR";
};
```

## boards/alif_dac0_twoscomp.overlay
```dts
/* Copyright (C) 2026 Alif Semiconductor - All Rights Reserved.
 * Use, distribution and modification of this code is permitted under the
 * terms stated in the Alif Semiconductor Software License Agreement
 *
 * You should have received a copy of the Alif Semiconductor Software
 * License Agreement with this file. If not, please write to:
 * contact@alifsemi.com, or visit: https://alifsemi.com/license
 *
 */

/ {
	aliases {
		dac = &dac0;
	};
};

&dac0 {
	status = "okay";
	/* Two's complement mode enabled */
	twoscomp_enabled;
	/* Load capacitance compensation: 4pF */
	capacitance = "DAC_4PF_CAPACITANCE";
	/* Output current: 800 uA */
	output_current = "DAC_800UA_OUT_CUR";
};
```

## boards/alif_dac_dual.overlay
```dts
/* Copyright (C) 2026 Alif Semiconductor - All Rights Reserved.
 * Use, distribution and modification of this code is permitted under the
 * terms stated in the Alif Semiconductor Software License Agreement
 *
 * You should have received a copy of the Alif Semiconductor Software
 * License Agreement with this file. If not, please write to:
 * contact@alifsemi.com, or visit: https://alifsemi.com/license
 *
 */

/ {
	aliases {
		dac = &dac1;
	};
};

&dac0 {
	status = "okay";
	/* Two's complement mode disabled (property omitted) */
	/* Load capacitance compensation: 4pF */
	capacitance = "DAC_4PF_CAPACITANCE";
	/* Output current: 800 uA */
	output_current = "DAC_800UA_OUT_CUR";
};

&dac1 {
	status = "okay";
	/* Two's complement mode enabled (for testing R-32_2) */
	twoscomp_enabled;
	/* Load capacitance compensation: 6pF (different from DAC0) */
	capacitance = "DAC_6PF_CAPACITANCE";
	/* Output current: 1000 uA (higher current for testing) */
	output_current = "DAC_1000UA_OUT_CUR";
};
```

## src/main.c
```c
/* Copyright (C) 2026 Alif Semiconductor - All Rights Reserved.
 * Use, distribution and modification of this code is permitted under the
 * terms stated in the Alif Semiconductor Software License Agreement
 *
 * You should have received a copy of the Alif Semiconductor Software
 * License Agreement with this file. If not, please write to:
 * contact@alifsemi.com, or visit: https://alifsemi.com/license
 */

#include "test_dac.h"

LOG_MODULE_REGISTER(dac_test, LOG_LEVEL_INF);

/* Global device pointer */
const struct device *dac_dev;

/* Default channel configuration: 12-bit, channel 0, unbuffered */
const struct dac_channel_cfg dac_ch_cfg = {
	.channel_id = DAC_CHANNEL_ID,
	.resolution = DAC_RESOLUTION,
	.buffered = 0
};

void *init_dac_device(void)
{
	int ret;
	const struct device *dev = DEVICE_DT_GET(DAC_NODE);

	zassert_not_null(dev, "DAC device handle is NULL");
	zassert_true(device_is_ready(dev), "DAC device is not ready");

	ret = dac_channel_setup(dev, &dac_ch_cfg);
	zassert_equal(ret, 0, "DAC channel setup failed [%d]", ret);

	return (void *)dev;
}

#if DT_NODE_HAS_STATUS(DAC0_NODE, okay) && DT_NODE_HAS_STATUS(DAC1_NODE, okay)
struct dac_dual_devs init_dac_dual_devices(void)
{
	int ret;
	struct dac_dual_devs d = {
		.dac0 = DEVICE_DT_GET(DAC0_NODE),
		.dac1 = DEVICE_DT_GET(DAC1_NODE),
	};

	zassert_not_null(d.dac0, "DAC0 device handle is NULL");
	zassert_not_null(d.dac1, "DAC1 device handle is NULL");
	zassert_true(device_is_ready(d.dac0), "DAC0 not ready");
	zassert_true(device_is_ready(d.dac1), "DAC1 not ready");

	ret = dac_channel_setup(d.dac0, &dac_ch_cfg);
	zassert_equal(ret, 0, "DAC0 channel setup failed [%d]", ret);

	ret = dac_channel_setup(d.dac1, &dac_ch_cfg);
	zassert_equal(ret, 0, "DAC1 channel setup failed [%d]", ret);

	return d;
}
#endif
```

## src/test_dac.h
```c
/* Copyright (C) 2026 Alif Semiconductor - All Rights Reserved.
 * Use, distribution and modification of this code is permitted under the
 * terms stated in the Alif Semiconductor Software License Agreement
 *
 * You should have received a copy of the Alif Semiconductor Software
 * License Agreement with this file. If not, please write to:
 * contact@alifsemi.com, or visit: https://alifsemi.com/license
 *
 */

#ifndef TEST_DAC_H
#define TEST_DAC_H

#include <stddef.h>
#include <stdint.h>
#include <zephyr/device.h>
#include <zephyr/devicetree.h>
#include <zephyr/drivers/dac.h>
#include <zephyr/kernel.h>
#include <zephyr/logging/log.h>
#include <zephyr/ztest.h>

/* Device Tree nodes */
#define DAC0_NODE		DT_NODELABEL(dac0)
#define DAC1_NODE		DT_NODELABEL(dac1)

#if DT_HAS_ALIAS(dac)
#define DAC_NODE		DT_ALIAS(dac)
#elif DT_NODE_EXISTS(DAC0_NODE)
#define DAC_NODE		DAC0_NODE
#else
#error "No DAC node found. Provide an overlay with: " \
	"/ { aliases { dac = &dacX; }; }; or enable dac0."
#endif

#define DAC_TWOSCOMP_ENABLED	DT_PROP_OR(DAC_NODE, twoscomp_enabled, 0)

/* DAC configuration */
#define DAC_RESOLUTION		12
#define DAC_CHANNEL_ID		0
#define DAC_MAX_INPUT		(0xFFFU)  /* 12-bit max: 4095 */
#define DAC_MIN_INPUT		(0x0U)
#define DAC_MID_INPUT		(0x800U)  /* Mid-scale: 2048 */
#define DAC_QUARTER_INPUT	(0x400U)  /* Quarter-scale: 1024 */

/* Voltage reference (internal 1.8V) */
#define DAC_VREF_MV		1800

/* Conversion rate */
#define DAC_MAX_CONV_RATE_HZ	1000  /* Up to 1 kHz at 12-bit */

/* Continuous test parameters */
#define DAC_RAMP_STEP		100   /* Step size for ramp tests */
#define DAC_CONT_ITERATIONS	100   /* Iterations for continuous tests */

/* Global device pointer */
extern const struct device *dac_dev;

/* Default channel configuration */
extern const struct dac_channel_cfg dac_ch_cfg;

struct dac_dual_devs {
	const struct device *dac0;
	const struct device *dac1;
};

/**
 * @brief Initialize and return DAC device, asserting readiness and channel setup.
 * @return Fixture pointer to initialized DAC device.
 */
void *init_dac_device(void);

#if DT_NODE_HAS_STATUS(DAC0_NODE, okay) && DT_NODE_HAS_STATUS(DAC1_NODE, okay)
struct dac_dual_devs init_dac_dual_devices(void);
#endif

#endif /* TEST_DAC_H */
```

## src/test_dac_basic.c
```c
/* Copyright (C) 2026 Alif Semiconductor - All Rights Reserved.
 * Use, distribution and modification of this code is permitted under the
 * terms stated in the Alif Semiconductor Software License Agreement
 *
 * You should have received a copy of the Alif Semiconductor Software
 * License Agreement with this file. If not, please write to:
 * contact@alifsemi.com, or visit: https://alifsemi.com/license
 */

/**
 * @file test_dac_basic.c
 * @brief DAC Basic Functionality and Dual Channel Tests
 *
 * Requirement Coverage:
 *   R-32_1: Driver should support Dual channel DAC control independently
 *
 * HRM Coverage:
 *   - The device includes two DAC12 modules
 *   - 12-bit resolution
 *   - Internal 1.8V voltage reference
 */

#include "test_dac.h"

LOG_MODULE_DECLARE(dac_test, LOG_LEVEL_INF);

#if DT_NODE_HAS_STATUS(DAC0_NODE, okay) && DT_NODE_HAS_STATUS(DAC1_NODE, okay)
static struct dac_dual_devs dac_dual_devs;
#endif

/* -------- Test: DAC channel setup with invalid resolution -------- */
static void dac_channel_setup_invalid_resolution_test(void)
{
	int ret;
	const struct device *dev = DEVICE_DT_GET(DAC_NODE);

	TC_PRINT("=== DAC Invalid Resolution Test ===\n");

	zassert_true(device_is_ready(dev), "DAC device is not ready");

	/* Test 8-bit resolution (unsupported - DAC12 only supports 12-bit) */
	struct dac_channel_cfg cfg_8bit = {
		.channel_id = DAC_CHANNEL_ID,
		.resolution = 8,
		.buffered = 0
	};

	ret = dac_channel_setup(dev, &cfg_8bit);
	zassert_equal(ret, -ENOTSUP,
		      "Expected -ENOTSUP for 8-bit resolution, got [%d]", ret);

	/* Test 10-bit resolution (unsupported) */
	struct dac_channel_cfg cfg_10bit = {
		.channel_id = DAC_CHANNEL_ID,
		.resolution = 10,
		.buffered = 0
	};

	ret = dac_channel_setup(dev, &cfg_10bit);
	zassert_equal(ret, -ENOTSUP,
		      "Expected -ENOTSUP for 10-bit resolution, got [%d]", ret);

	/* Test 16-bit resolution (unsupported) */
	struct dac_channel_cfg cfg_16bit = {
		.channel_id = DAC_CHANNEL_ID,
		.resolution = 16,
		.buffered = 0
	};

	ret = dac_channel_setup(dev, &cfg_16bit);
	zassert_equal(ret, -ENOTSUP,
		      "Expected -ENOTSUP for 16-bit resolution, got [%d]", ret);

	TC_PRINT("DAC invalid resolution test PASSED\n");
}

/* -------- Test: Basic DAC write value -------- */
static void dac_basic_write_test(void)
{
	int ret;

	TC_PRINT("=== DAC Basic Write Test ===\n");

	/* Write mid-scale value */
	ret = dac_write_value(dac_dev, DAC_CHANNEL_ID, DAC_MID_INPUT);
	zassert_equal(ret, 0, "DAC write mid-scale failed [%d]", ret);
	k_sleep(K_MSEC(100));

	/* Write minimum value */
	ret = dac_write_value(dac_dev, DAC_CHANNEL_ID, DAC_MIN_INPUT);
	zassert_equal(ret, 0, "DAC write min failed [%d]", ret);
	k_sleep(K_MSEC(100));

	/* Write maximum value */
	ret = dac_write_value(dac_dev, DAC_CHANNEL_ID, DAC_MAX_INPUT);
	zassert_equal(ret, 0, "DAC write max failed [%d]", ret);
	k_sleep(K_MSEC(100));

	TC_PRINT("DAC basic write test PASSED\n");
}

/* -------- Test: DAC0 independent initialization (R-32_1) -------- */
static void dac0_independent_init_test(void)
{
	int ret;

	TC_PRINT("=== DAC0 Independent Init Test ===\n");

#if DT_NODE_HAS_STATUS(DAC0_NODE, okay)
	const struct device *dac0 = DEVICE_DT_GET(DAC0_NODE);

	zassert_not_null(dac0, "DAC0 device handle is NULL");
	zassert_true(device_is_ready(dac0), "DAC0 device is not ready");

	const struct dac_channel_cfg cfg = {
		.channel_id = DAC_CHANNEL_ID,
		.resolution = DAC_RESOLUTION,
		.buffered = 0
	};

	ret = dac_channel_setup(dac0, &cfg);
	zassert_equal(ret, 0, "DAC0 channel setup failed [%d]", ret);

	/* Write a known value to DAC0 */
	ret = dac_write_value(dac0, DAC_CHANNEL_ID, 1000);
	zassert_equal(ret, 0, "DAC0 write failed [%d]", ret);
	k_sleep(K_MSEC(100));

	TC_PRINT("DAC0 independent init test PASSED\n");
#else
	ztest_test_skip();
#endif
}

/* -------- Test: DAC1 independent initialization (R-32_1) -------- */
static void dac1_independent_init_test(void)
{
	int ret;

	TC_PRINT("=== DAC1 Independent Init Test ===\n");

#if DT_NODE_HAS_STATUS(DAC1_NODE, okay)
	const struct device *dac1 = DEVICE_DT_GET(DAC1_NODE);

	zassert_not_null(dac1, "DAC1 device handle is NULL");
	zassert_true(device_is_ready(dac1), "DAC1 device is not ready");

	const struct dac_channel_cfg cfg = {
		.channel_id = DAC_CHANNEL_ID,
		.resolution = DAC_RESOLUTION,
		.buffered = 0
	};

	ret = dac_channel_setup(dac1, &cfg);
	zassert_equal(ret, 0, "DAC1 channel setup failed [%d]", ret);

	/* Write a known value to DAC1 */
	ret = dac_write_value(dac1, DAC_CHANNEL_ID, 2000);
	zassert_equal(ret, 0, "DAC1 write failed [%d]", ret);
	k_sleep(K_MSEC(100));

	TC_PRINT("DAC1 independent init test PASSED\n");
#else
	LOG_WRN("DAC1 not enabled in device tree");
	LOG_WRN("To enable DAC1, use: alif_dac_dual.overlay or alif_dac1.overlay");
	ztest_test_skip();
#endif
}

/* -------- Test: Dual DAC independent write (R-32_1) -------- */
static void dac_dual_channel_independent_write_test(void)
{
	int ret;

	TC_PRINT("=== DAC Dual Channel Independent Write Test ===\n");

#if DT_NODE_HAS_STATUS(DAC0_NODE, okay) && DT_NODE_HAS_STATUS(DAC1_NODE, okay)
	/* Write different values to each DAC independently */
	uint32_t dac0_values[] = {0, 1024, 2048, 3072, 4095};
	uint32_t dac1_values[] = {4095, 3072, 2048, 1024, 0};

	for (int i = 0; i < ARRAY_SIZE(dac0_values); i++) {
		ret = dac_write_value(dac_dual_devs.dac0, DAC_CHANNEL_ID,
				      dac0_values[i]);
		zassert_equal(ret, 0, "DAC0 write %u failed [%d]",
			      dac0_values[i], ret);

		ret = dac_write_value(dac_dual_devs.dac1, DAC_CHANNEL_ID,
				      dac1_values[i]);
		zassert_equal(ret, 0, "DAC1 write %u failed [%d]",
			      dac1_values[i], ret);

		LOG_INF("DAC0=%u DAC1=%u written successfully",
			dac0_values[i], dac1_values[i]);
		k_sleep(K_MSEC(100));
	}

	TC_PRINT("DAC dual channel independent write test PASSED\n");
#else
	LOG_WRN("Both DAC0 and DAC1 must be enabled for dual channel test");
#if !DT_NODE_HAS_STATUS(DAC0_NODE, okay)
	LOG_WRN("  -> DAC0 is disabled. Use: alif_dac0.overlay");
#endif
#if !DT_NODE_HAS_STATUS(DAC1_NODE, okay)
	LOG_WRN("  -> DAC1 is disabled. Use: alif_dac1.overlay or alif_dac_dual.overlay");
#endif
	LOG_WRN("  -> For both DACs together: alif_dac_dual.overlay");
	ztest_test_skip();
#endif
}

/* -------- Test: Dual DAC simultaneous operation (R-32_1) -------- */
static void dac_dual_channel_simultaneous_test(void)
{
	int ret;

	TC_PRINT("=== DAC Dual Channel Simultaneous Test ===\n");

#if DT_NODE_HAS_STATUS(DAC0_NODE, okay) && DT_NODE_HAS_STATUS(DAC1_NODE, okay)
	/* Ramp DAC0 up while ramping DAC1 down simultaneously */
	for (uint32_t val = 0; val <= DAC_MAX_INPUT; val += DAC_RAMP_STEP) {
		uint32_t val_inv = DAC_MAX_INPUT - val;

		ret = dac_write_value(dac_dual_devs.dac0, DAC_CHANNEL_ID, val);
		zassert_equal(ret, 0, "DAC0 write %u failed [%d]", val, ret);

		ret = dac_write_value(dac_dual_devs.dac1, DAC_CHANNEL_ID, val_inv);
		zassert_equal(ret, 0, "DAC1 write %u failed [%d]", val_inv, ret);

		k_sleep(K_MSEC(50));
	}

	TC_PRINT("DAC dual channel simultaneous test PASSED\n");
#else
	LOG_WRN("Both DAC0 and DAC1 must be enabled for simultaneous test");
#if !DT_NODE_HAS_STATUS(DAC0_NODE, okay)
	LOG_WRN("  -> DAC0 is disabled. Use: alif_dac0.overlay");
#endif
#if !DT_NODE_HAS_STATUS(DAC1_NODE, okay)
	LOG_WRN("  -> DAC1 is disabled. Use: alif_dac1.overlay or alif_dac_dual.overlay");
#endif
	LOG_WRN("  -> For both DACs together: alif_dac_dual.overlay");
	ztest_test_skip();
#endif
}


/* -------- Test: Invalid channel_id rejection -------- */
static void dac_invalid_channel_id_test(void)
{
	int ret;
	const struct device *dev = DEVICE_DT_GET(DAC_NODE);

	TC_PRINT("=== DAC Invalid Channel ID Test ===\n");

	zassert_true(device_is_ready(dev), "DAC device is not ready");

	/* Test channel_id = 1 (invalid - Alif DAC has only channel 0) */
	struct dac_channel_cfg cfg_ch1 = {
		.channel_id = 1,
		.resolution = DAC_RESOLUTION,
		.buffered = 0
	};

	ret = dac_channel_setup(dev, &cfg_ch1);
	zassert_equal(ret, -EINVAL,
			  "Expected -EINVAL for channel_id=1, got [%d]", ret);

	/* Test channel_id = 255 (invalid - max uint8) */
	struct dac_channel_cfg cfg_ch255 = {
		.channel_id = 255,
		.resolution = DAC_RESOLUTION,
		.buffered = 0
	};

	ret = dac_channel_setup(dev, &cfg_ch255);
	zassert_equal(ret, -EINVAL,
			  "Expected -EINVAL for channel_id=255, got [%d]", ret);

	TC_PRINT("DAC invalid channel_id rejection test PASSED\n");
}

/* -------- Test: Two's complement input range validation -------- */
static void dac_twoscomp_input_range_test(void)
{
	int ret_1;
	int ret_2;

	TC_PRINT("=== DAC Two's Complement Input Range Test ===\n");

	/* Only run when twoscomp mode is enabled */
	if (!DAC_TWOSCOMP_ENABLED) {
		LOG_INF("Skipping: twoscomp mode not enabled");
		ztest_test_skip();
	}

	/* Over-range values must be rejected in twoscomp mode */
	ret_1 = dac_write_value(dac_dev, DAC_CHANNEL_ID, 0x1FFF);
	zassert_equal(ret_1, -EINVAL,
		      "Expected -EINVAL for 0x1FFF in twoscomp mode, got [%d]", ret_1);

	ret_2 = dac_write_value(dac_dev, DAC_CHANNEL_ID, 0xFFFF);
	zassert_equal(ret_2, -EINVAL,
		      "Expected -EINVAL for 0xFFFF in twoscomp mode, got [%d]", ret_2);

	TC_PRINT("DAC two's complement input range test PASSED\n");
}

/* -------- Test: Rapid write stress test -------- */
static void dac_rapid_write_stress_test(void)
{
	int ret;
	uint32_t errors = 0;
	const int iterations = 100;

	TC_PRINT("=== DAC Rapid Write Stress Test ===\n");

	for (int i = 0; i < iterations; i++) {
		ret = dac_write_value(dac_dev, DAC_CHANNEL_ID, DAC_MIN_INPUT);
		if (ret != 0) {
			errors++;
		}

		ret = dac_write_value(dac_dev, DAC_CHANNEL_ID, DAC_MAX_INPUT);
		if (ret != 0) {
			errors++;
		}
	}

	zassert_equal(errors, 0, "Rapid write stress test had %u errors out of %d writes",
		      errors, iterations * 2);

	TC_PRINT("DAC rapid write stress test PASSED (%d alternating writes)\n",
		iterations * 2);
}

/* -------- Test: Repeated channel setup -------- */
static void dac_repeated_setup_test(void)
{
	int ret;
	const struct device *dev = DEVICE_DT_GET(DAC_NODE);

	TC_PRINT("=== DAC Repeated Channel Setup Test ===\n");

	zassert_true(device_is_ready(dev), "DAC device is not ready");

	/* Setup channel multiple times - driver should handle re-configuration */
	struct dac_channel_cfg cfg = {
		.channel_id = DAC_CHANNEL_ID,
		.resolution = DAC_RESOLUTION,
		.buffered = 0
	};

	for (int i = 0; i < 10; i++) {
		ret = dac_channel_setup(dev, &cfg);
		zassert_equal(ret, 0, "Channel setup iteration %d failed [%d]", i, ret);

		ret = dac_write_value(dev, DAC_CHANNEL_ID, DAC_MID_INPUT);
		zassert_equal(ret, 0, "Write after setup %d failed [%d]", i, ret);
	}

	TC_PRINT("DAC repeated setup test PASSED (10 iterations)\n");
}

/* -------- Test: Write value max+1 edge case -------- */
static void dac_write_max_plus_one_test(void)
{
	int ret;

	TC_PRINT("=== DAC Write Max+1 Edge Case Test ===\n");

	/* Skip if twoscomp mode - different behavior expected */
	if (DAC_TWOSCOMP_ENABLED) {
		LOG_INF("Skipping: twoscomp mode has different range handling");
		ztest_test_skip();
	}

	/* Test exactly DAC_MAX_INPUT + 1 (0x1000) - should be rejected in unsigned mode */
	ret = dac_write_value(dac_dev, DAC_CHANNEL_ID, DAC_MAX_INPUT + 1);
	zassert_equal(ret, -EINVAL,
		      "Expected -EINVAL for DAC_MAX_INPUT+1, got [%d]", ret);

	/* Test boundary: DAC_MAX_INPUT should succeed */
	ret = dac_write_value(dac_dev, DAC_CHANNEL_ID, DAC_MAX_INPUT);
	zassert_equal(ret, 0, "Write DAC_MAX_INPUT should succeed [%d]", ret);

	TC_PRINT("DAC write max+1 edge case test PASSED\n");
}

/* ======== Test Suite Lifecycle ======== */

static void *test_dac_basic_setup(void)
{
	TC_PRINT("=== DAC Basic Test Suite Setup ===\n");
	dac_dev = init_dac_device();
	zassert_not_null(dac_dev, "init_dac_device() returned NULL");

#if DT_NODE_HAS_STATUS(DAC0_NODE, okay) && DT_NODE_HAS_STATUS(DAC1_NODE, okay)
	dac_dual_devs = init_dac_dual_devices();
#endif

	return NULL;
}

static void test_dac_basic_before(void *fixture)
{
	ARG_UNUSED(fixture);
}

static void test_dac_basic_after(void *fixture)
{
	ARG_UNUSED(fixture);
}

static void test_dac_basic_teardown(void *fixture)
{
	ARG_UNUSED(fixture);
}


/* ======== Basic Test Suite ======== */

/* R-32_1: Channel setup with invalid resolution */
ZTEST(test_dac_basic, test_dac_channel_setup_invalid_resolution)
{
	dac_channel_setup_invalid_resolution_test();
}

/* R-32_1: Basic write value */
ZTEST(test_dac_basic, test_dac_basic_write)
{
	dac_basic_write_test();
}

/* R-32_1: DAC0 independent init */
ZTEST(test_dac_basic, test_dac0_independent_init)
{
	dac0_independent_init_test();
}

/* R-32_1: DAC1 independent init */
ZTEST(test_dac_basic, test_dac1_independent_init)
{
	dac1_independent_init_test();
}

/* R-32_1: Dual channel independent write */
ZTEST(test_dac_basic, test_dac_dual_channel_independent_write)
{
	dac_dual_channel_independent_write_test();
}

/* R-32_1: Dual channel simultaneous operation */
ZTEST(test_dac_basic, test_dac_dual_channel_simultaneous)
{
	dac_dual_channel_simultaneous_test();
}

/* Invalid channel_id rejection test */
ZTEST(test_dac_basic, test_dac_invalid_channel_id)
{
	dac_invalid_channel_id_test();
}

/* Two's complement input range validation test */
ZTEST(test_dac_basic, test_dac_twoscomp_input_range)
{
	dac_twoscomp_input_range_test();
}

/* Rapid write stress test */
ZTEST(test_dac_basic, test_dac_rapid_write_stress)
{
	dac_rapid_write_stress_test();
}

/* Repeated channel setup test */
ZTEST(test_dac_basic, test_dac_repeated_setup)
{
	dac_repeated_setup_test();
}

/* Write max+1 edge case test */
ZTEST(test_dac_basic, test_dac_write_max_plus_one)
{
	dac_write_max_plus_one_test();
}

ZTEST_SUITE(test_dac_basic, NULL, test_dac_basic_setup,
	    test_dac_basic_before, test_dac_basic_after,
	    test_dac_basic_teardown);
```

## src/test_dac_boundary.c
```c
/* Copyright (C) 2026 Alif Semiconductor - All Rights Reserved.
 * Use, distribution and modification of this code is permitted under the
 * terms stated in the Alif Semiconductor Software License Agreement
 *
 * You should have received a copy of the Alif Semiconductor Software
 * License Agreement with this file. If not, please write to:
 * contact@alifsemi.com, or visit: https://alifsemi.com/license
 */

/**
 * @file test_dac_boundary.c
 * @brief DAC Boundary and Edge Case Tests
 *
 * HRM Coverage:
 *   - 12-bit resolution boundary values
 *   - Analog output range 0V to 1.8V
 *   - Error handling for out-of-range inputs
 */

#include "test_dac.h"

LOG_MODULE_DECLARE(dac_test, LOG_LEVEL_INF);

/* -------- Test: Valid boundary values (0x000, 0x001, 0xFFE, 0xFFF) -------- */
static void dac_boundary_valid_values_test(void)
{
	int ret;
	uint32_t valid_boundaries[] = {0x000, 0x001, 0xFFE, 0xFFF};

	TC_PRINT("=== DAC Boundary Valid Values Test ===\n");

	for (int i = 0; i < ARRAY_SIZE(valid_boundaries); i++) {
		ret = dac_write_value(dac_dev, DAC_CHANNEL_ID,
				      valid_boundaries[i]);
		zassert_equal(ret, 0, "DAC write 0x%03x failed [%d]",
			      valid_boundaries[i], ret);
		k_sleep(K_MSEC(100));
	}

	TC_PRINT("DAC boundary valid values test PASSED\n");
}

/* -------- Test: Out-of-range values (0x1000, 0xFFFF, 0xFFFFFFFF) -------- */
static void dac_boundary_out_of_range_test(void)
{
	int ret;
	uint32_t invalid_values[] = {0x1000, 0xFFFF, 0xFFFFFFFF};

	TC_PRINT("=== DAC Boundary Out-of-Range Test ===\n");

	for (int i = 0; i < ARRAY_SIZE(invalid_values); i++) {
		ret = dac_write_value(dac_dev, DAC_CHANNEL_ID,
				      invalid_values[i]);
		zassert_equal(ret, -EINVAL,
			      "Expected -EINVAL for 0x%x, got [%d]",
			      invalid_values[i], ret);
	}

	TC_PRINT("DAC boundary out-of-range test PASSED\n");
}

/* -------- Test: Alternating min/max writes -------- */
static void dac_boundary_alternating_test(void)
{
	int ret;
	uint32_t errors = 0;

	TC_PRINT("=== DAC Boundary Alternating Min/Max Test ===\n");

	for (int i = 0; i < 10; i++) {  /* Reduced for LA visibility */
		ret = dac_write_value(dac_dev, DAC_CHANNEL_ID, DAC_MIN_INPUT);
		if (ret != 0) {
			errors++;
		}
		k_sleep(K_MSEC(100));

		ret = dac_write_value(dac_dev, DAC_CHANNEL_ID, DAC_MAX_INPUT);
		if (ret != 0) {
			errors++;
		}
		k_sleep(K_MSEC(100));
	}

	zassert_equal(errors, 0,
		      "Alternating min/max had %u errors out of %d writes",
		      errors, 20);

	TC_PRINT("DAC boundary alternating min/max test PASSED (10 cycles with 100ms delay)\n");
}

/* -------- Test: Power-of-two boundary values -------- */
static void dac_boundary_power_of_two_test(void)
{
	int ret;
	uint32_t errors = 0;

	TC_PRINT("=== DAC Boundary Power-of-Two Test ===\n");

	/* Test all power-of-2 values within 12-bit range */
	uint32_t pow2_values[] = {
		1, 2, 4, 8, 16, 32, 64, 128, 256, 512, 1024, 2048
	};

	for (int i = 0; i < ARRAY_SIZE(pow2_values); i++) {
		ret = dac_write_value(dac_dev, DAC_CHANNEL_ID, pow2_values[i]);
		if (ret != 0) {
			errors++;
			LOG_ERR("Write %u failed [%d]", pow2_values[i], ret);
		}
		k_sleep(K_MSEC(100));

		/* Also test (power_of_2 - 1) */
		uint32_t val_minus_1 = pow2_values[i] - 1;

		ret = dac_write_value(dac_dev, DAC_CHANNEL_ID, val_minus_1);
		if (ret != 0) {
			errors++;
			LOG_ERR("Write %u failed [%d]", val_minus_1, ret);
		}
		k_sleep(K_MSEC(100));
	}

	zassert_equal(errors, 0, "Power-of-two test had %u errors", errors);

	TC_PRINT("DAC boundary power-of-two test PASSED\n");
}

/* -------- Test: Repeated setup/write cycles -------- */
static void dac_boundary_repeated_setup_test(void)
{
	int ret;
	int cycles = 10;

	TC_PRINT("=== DAC Boundary Repeated Setup/Write Test ===\n");

	const struct device *dev = DEVICE_DT_GET(DAC_NODE);

	zassert_true(device_is_ready(dev), "DAC device not ready");

	for (int i = 0; i < cycles; i++) {
		const struct dac_channel_cfg cfg = {
			.channel_id = DAC_CHANNEL_ID,
			.resolution = DAC_RESOLUTION,
			.buffered = 0
		};

		ret = dac_channel_setup(dev, &cfg);
		zassert_equal(ret, 0, "Setup cycle %d failed [%d]", i, ret);

		ret = dac_write_value(dev, DAC_CHANNEL_ID,
				      (i * 400) & DAC_MAX_INPUT);
		zassert_equal(ret, 0, "Write cycle %d failed [%d]", i, ret);
		k_sleep(K_MSEC(100));
	}

	TC_PRINT("DAC boundary repeated setup/write test PASSED\n");
}

/* -------- Test: Zero resolution setup (invalid) -------- */
static void dac_boundary_zero_resolution_test(void)
{
	int ret;

	TC_PRINT("=== DAC Boundary Zero Resolution Test ===\n");

	const struct device *dev = DEVICE_DT_GET(DAC_NODE);

	zassert_true(device_is_ready(dev), "DAC device not ready");

	struct dac_channel_cfg cfg = {
		.channel_id = DAC_CHANNEL_ID,
		.resolution = 0,
		.buffered = 0
	};

	ret = dac_channel_setup(dev, &cfg);
	zassert_equal(ret, -ENOTSUP,
		      "Expected -ENOTSUP for resolution 0, got [%d]", ret);

	TC_PRINT("DAC boundary zero resolution test PASSED\n");
}

/* -------- Test: Sequential boundary transitions -------- */
static void dac_boundary_sequential_transitions_test(void)
{
	int ret;

	TC_PRINT("=== DAC Boundary Sequential Transitions Test ===\n");

	/* Test transitions between boundary values */
	uint32_t boundary_values[] = {
		0x000, 0x001, 0x002,           /* near minimum */
		0x7FE, 0x7FF, 0x800, 0x801,   /* around mid-point */
		0xFFD, 0xFFE, 0xFFF            /* near maximum */
	};

	for (int i = 0; i < ARRAY_SIZE(boundary_values); i++) {
		ret = dac_write_value(dac_dev, DAC_CHANNEL_ID,
				      boundary_values[i]);
		zassert_equal(ret, 0, "Write 0x%03x failed [%d]",
			      boundary_values[i], ret);
		LOG_INF("  Written 0x%03x OK", boundary_values[i]);
		k_sleep(K_MSEC(100));
	}

	TC_PRINT("DAC boundary sequential transitions test PASSED\n");
}

/* ======== Boundary Test Suite ======== */

ZTEST(test_dac_boundary, test_dac_boundary_valid_values)
{
	dac_boundary_valid_values_test();
}

ZTEST(test_dac_boundary, test_dac_boundary_out_of_range)
{
	if (DAC_TWOSCOMP_ENABLED) {
		ztest_test_skip();
	}

	dac_boundary_out_of_range_test();
}

ZTEST(test_dac_boundary, test_dac_boundary_alternating)
{
	dac_boundary_alternating_test();
}

ZTEST(test_dac_boundary, test_dac_boundary_power_of_two)
{
	dac_boundary_power_of_two_test();
}

ZTEST(test_dac_boundary, test_dac_boundary_repeated_setup)
{
	dac_boundary_repeated_setup_test();
}

ZTEST(test_dac_boundary, test_dac_boundary_zero_resolution)
{
	dac_boundary_zero_resolution_test();
}

ZTEST(test_dac_boundary, test_dac_boundary_sequential_transitions)
{
	dac_boundary_sequential_transitions_test();
}

/* ======== Test Suite Lifecycle ======== */

static void *test_dac_boundary_setup(void)
{
	TC_PRINT("=== DAC Boundary Test Suite Setup ===\n");
	dac_dev = init_dac_device();
	zassert_not_null(dac_dev, "init_dac_device() returned NULL");
	return NULL;
}

static void test_dac_boundary_before(void *fixture)
{
	ARG_UNUSED(fixture);
	LOG_INF("--- Before boundary test ---");
}

static void test_dac_boundary_after(void *fixture)
{
	ARG_UNUSED(fixture);
	LOG_INF("--- After boundary test ---");
}

static void test_dac_boundary_teardown(void *fixture)
{
	ARG_UNUSED(fixture);
	TC_PRINT("=== DAC Boundary Test Suite Teardown ===\n");
}

ZTEST_SUITE(test_dac_boundary, NULL, test_dac_boundary_setup,
	    test_dac_boundary_before, test_dac_boundary_after,
	    test_dac_boundary_teardown);
```

## src/test_dac_capacitance.c
```c
/* Copyright (C) 2026 Alif Semiconductor - All Rights Reserved.
 * Use, distribution and modification of this code is permitted under the
 * terms stated in the Alif Semiconductor Software License Agreement
 *
 * You should have received a copy of the Alif Semiconductor Software
 * License Agreement with this file. If not, please write to:
 * contact@alifsemi.com, or visit: https://alifsemi.com/license
 */

#include "test_dac.h"

LOG_MODULE_DECLARE(dac_test, LOG_LEVEL_INF);

/* -------- Test: DAC init with capacitance config -------- */
static void dac_init_with_capacitance_test(void)
{
	int ret;

	TC_PRINT("=== DAC Init With Capacitance Config Test ===\n");

	/* DAC initializes with capacitance from device tree.
	 * Verify that initialization succeeds with the configured
	 * capacitance compensation setting.
	 */
	const struct device *dev = DEVICE_DT_GET(DAC_NODE);

	zassert_not_null(dev, "DAC device handle is NULL");
	zassert_true(device_is_ready(dev),
		     "DAC device not ready (capacitance config may be invalid)");

	const struct dac_channel_cfg cfg = {
		.channel_id = DAC_CHANNEL_ID,
		.resolution = DAC_RESOLUTION,
		.buffered = 0
	};

	ret = dac_channel_setup(dev, &cfg);
	zassert_equal(ret, 0, "Channel setup failed with capacitance config [%d]",
		      ret);

	TC_PRINT("DAC init with capacitance config test PASSED\n");
}

/* -------- Test: Write values with capacitance compensation -------- */
static void dac_write_with_capacitance_test(void)
{
	int ret;
	uint32_t errors = 0;

	TC_PRINT("=== DAC Write With Capacitance Compensation Test ===\n");

	/* Write various values across the full range with configured
	 * capacitance compensation active
	 */
	uint32_t test_values[] = {
		DAC_MIN_INPUT,     /* 0V */
		DAC_QUARTER_INPUT, /* ~0.45V */
		DAC_MID_INPUT,     /* ~0.9V */
		(DAC_MAX_INPUT * 3) / 4, /* ~1.35V */
		DAC_MAX_INPUT      /* ~1.8V */
	};

	for (int i = 0; i < ARRAY_SIZE(test_values); i++) {
		ret = dac_write_value(dac_dev, DAC_CHANNEL_ID, test_values[i]);
		if (ret != 0) {
			errors++;
			LOG_ERR("Write 0x%x with capacitance failed [%d]",
				test_values[i], ret);
		} else {
			LOG_INF("  Written 0x%03x with capacitance OK",
				test_values[i]);
		}
		/* Allow settling time with load capacitance - LA visibility delay */
		k_sleep(K_MSEC(100));
	}

	zassert_equal(errors, 0, "Capacitance write had %u errors", errors);

	TC_PRINT("DAC write with capacitance compensation test PASSED\n");
}

/* -------- Test: Output stability with capacitance compensation -------- */
static void dac_capacitance_stability_test(void)
{
	int ret;
	uint32_t errors = 0;

	TC_PRINT("=== DAC Capacitance Stability Test ===\n");

	/* Write mid-scale value repeatedly to verify stable output
	 * with capacitance compensation active
	 */
	for (int i = 0; i < 20; i++) {  /* Reduced for LA visibility */
		ret = dac_write_value(dac_dev, DAC_CHANNEL_ID, DAC_MID_INPUT);
		if (ret != 0) {
			errors++;
		}
		k_sleep(K_MSEC(100));
	}

	zassert_equal(errors, 0, "Stability test had %u errors out of %d",
		      errors, 20);

	TC_PRINT("DAC capacitance stability test PASSED (20 writes with 100ms delay)\n");
}

/* -------- Test: Step response with capacitance compensation -------- */
static void dac_capacitance_step_response_test(void)
{
	int ret;

	TC_PRINT("=== DAC Capacitance Step Response Test ===\n");

	/* Large step from min to max - tests settling with capacitance comp */
	ret = dac_write_value(dac_dev, DAC_CHANNEL_ID, DAC_MIN_INPUT);
	zassert_equal(ret, 0, "Write min failed [%d]", ret);
	k_sleep(K_MSEC(100));

	ret = dac_write_value(dac_dev, DAC_CHANNEL_ID, DAC_MAX_INPUT);
	zassert_equal(ret, 0, "Write max (step up) failed [%d]", ret);
	k_sleep(K_MSEC(100));

	/* Large step from max to min */
	ret = dac_write_value(dac_dev, DAC_CHANNEL_ID, DAC_MIN_INPUT);
	zassert_equal(ret, 0, "Write min (step down) failed [%d]", ret);
	k_sleep(K_MSEC(100));

	/* Medium steps */
	ret = dac_write_value(dac_dev, DAC_CHANNEL_ID, DAC_QUARTER_INPUT);
	zassert_equal(ret, 0, "Write quarter failed [%d]", ret);
	k_sleep(K_MSEC(100));

	ret = dac_write_value(dac_dev, DAC_CHANNEL_ID, DAC_MID_INPUT);
	zassert_equal(ret, 0, "Write mid failed [%d]", ret);
	k_sleep(K_MSEC(100));

	ret = dac_write_value(dac_dev, DAC_CHANNEL_ID,
			      (DAC_MAX_INPUT * 3) / 4);
	zassert_equal(ret, 0, "Write three-quarter failed [%d]", ret);
	k_sleep(K_MSEC(100));

	ret = dac_write_value(dac_dev, DAC_CHANNEL_ID, DAC_MAX_INPUT);
	zassert_equal(ret, 0, "Write max failed [%d]", ret);

	TC_PRINT("DAC capacitance step response test PASSED\n");
}

/* -------- Test: Ramp with capacitance at settling intervals -------- */
static void dac_capacitance_ramp_with_settling_test(void)
{
	int ret;
	uint32_t errors = 0;
	uint32_t step = 256; /* coarse steps to allow settling */

	TC_PRINT("=== DAC Capacitance Ramp With Settling Test ===\n");

	/* Ramp with settling delay between steps */
	for (uint32_t val = DAC_MIN_INPUT; val <= DAC_MAX_INPUT; val += step) {
		ret = dac_write_value(dac_dev, DAC_CHANNEL_ID, val);
		if (ret != 0) {
			errors++;
			LOG_ERR("Ramp write %u failed [%d]", val, ret);
		}
		/* Allow output to settle with load capacitance - LA visibility */
		k_sleep(K_MSEC(50));
	}

	/* Final max value */
	ret = dac_write_value(dac_dev, DAC_CHANNEL_ID, DAC_MAX_INPUT);
	zassert_equal(ret, 0, "Final max write failed [%d]", ret);

	zassert_equal(errors, 0, "Ramp with settling had %u errors", errors);

	TC_PRINT("DAC capacitance ramp with settling test PASSED\n");
}

/* -------- Test: DAC output current configuration -------- */
static void dac_output_current_config_test(void)
{
	int ret;

	TC_PRINT("=== DAC Output Current Configuration Test ===\n");

	/* Output current is configured via DT property 'output_current'.
	 * This test verifies the DAC operates correctly with the
	 * configured output current (0-1500 uA).
	 *
	 * HRM: Programmable output current up to 1.5 mA
	 * Supported values: 0, 100, 200, 300, 400, 500, 600, 700, 800,
	 *                   900, 1000, 1100, 1200, 1300, 1400, 1500 uA
	 */

	/* Log the configured output current from device tree for verification */
#if DT_NODE_HAS_PROP(DAC_NODE, output_current)
	const char *output_current_str = DT_PROP(DAC_NODE, output_current);

	LOG_INF("Configured output_current: %s", output_current_str);
#else
	LOG_WRN("No output_current property in device tree");
#endif

	/* Write values at key points to verify operation with
	 * the configured output current. Even at maximum current (1.5mA),
	 * the DAC should handle min/mid/max digital values correctly.
	 */
	ret = dac_write_value(dac_dev, DAC_CHANNEL_ID, DAC_MIN_INPUT);
	zassert_equal(ret, 0, "Write min with output current config failed [%d]",
		      ret);
	k_sleep(K_MSEC(100));

	ret = dac_write_value(dac_dev, DAC_CHANNEL_ID, DAC_MID_INPUT);
	zassert_equal(ret, 0, "Write mid with output current config failed [%d]",
		      ret);
	k_sleep(K_MSEC(100));

	ret = dac_write_value(dac_dev, DAC_CHANNEL_ID, DAC_MAX_INPUT);
	zassert_equal(ret, 0, "Write max with output current config failed [%d]",
		      ret);
	k_sleep(K_MSEC(100));

	TC_PRINT("DAC output current configuration test PASSED\n");
}

/* -------- Test: LP mode operation -------- */
static void dac_lp_mode_operation_test(void)
{
	int ret;
	uint32_t errors = 0;

	TC_PRINT("=== DAC LP Mode Operation Test ===\n");

	/* Write at slow rate (LP mode: slow sample rate) (suitable for LP mode) */
	for (uint32_t val = 0; val <= DAC_MAX_INPUT; val += 512) {
		ret = dac_write_value(dac_dev, DAC_CHANNEL_ID, val);
		if (ret != 0) {
			errors++;
		}
		/* LP mode: slow sample rate - LA visibility delay */
		k_sleep(K_MSEC(100));
	}

	zassert_equal(errors, 0, "LP mode operation had %u errors", errors);

	TC_PRINT("DAC LP mode operation test PASSED\n");
}

/* ======== Capacitance Test Suite ======== */

/* R-32_4: Init with capacitance config */
ZTEST(test_dac_capacitance, test_dac_init_with_capacitance)
{
	dac_init_with_capacitance_test();
}

/* R-32_4: Write values with capacitance compensation */
ZTEST(test_dac_capacitance, test_dac_write_with_capacitance)
{
	dac_write_with_capacitance_test();
}

/* R-32_4: Output stability with capacitance */
ZTEST(test_dac_capacitance, test_dac_capacitance_stability)
{
	dac_capacitance_stability_test();
}

/* R-32_4: Step response with capacitance */
ZTEST(test_dac_capacitance, test_dac_capacitance_step_response)
{
	dac_capacitance_step_response_test();
}

/* R-32_4: Ramp with settling intervals */
ZTEST(test_dac_capacitance, test_dac_capacitance_ramp_with_settling)
{
	dac_capacitance_ramp_with_settling_test();
}

/* HRM: Programmable output current */
ZTEST(test_dac_capacitance, test_dac_output_current_config)
{
	dac_output_current_config_test();
}

/* HRM: LP mode operation */
ZTEST(test_dac_capacitance, test_dac_lp_mode_operation)
{
	dac_lp_mode_operation_test();
}

/* ======== Test Suite Lifecycle ======== */

static void *test_dac_capacitance_setup(void)
{
	TC_PRINT("=== DAC Capacitance Test Suite Setup ===\n");
	dac_dev = init_dac_device();
	zassert_not_null(dac_dev, "init_dac_device() returned NULL");
	return NULL;
}

static void test_dac_capacitance_before(void *fixture)
{
	ARG_UNUSED(fixture);
	LOG_INF("--- Before capacitance test ---");
}

static void test_dac_capacitance_after(void *fixture)
{
	ARG_UNUSED(fixture);
	LOG_INF("--- After capacitance test ---");
	/* Reset DAC to 0 */
	dac_write_value(dac_dev, DAC_CHANNEL_ID, DAC_MIN_INPUT);
}

static void test_dac_capacitance_teardown(void *fixture)
{
	ARG_UNUSED(fixture);
	TC_PRINT("=== DAC Capacitance Test Suite Teardown ===\n");
}


ZTEST_SUITE(test_dac_capacitance, NULL, test_dac_capacitance_setup,
	    test_dac_capacitance_before, test_dac_capacitance_after,
	    test_dac_capacitance_teardown);
```

## src/test_dac_continuous.c
```c
/* Copyright (C) 2026 Alif Semiconductor - All Rights Reserved.
 * Use, distribution and modification of this code is permitted under the
 * terms stated in the Alif Semiconductor Software License Agreement
 *
 * You should have received a copy of the Alif Semiconductor Software
 * License Agreement with this file. If not, please write to:
 * contact@alifsemi.com, or visit: https://alifsemi.com/license
 */

#include "test_dac.h"

LOG_MODULE_DECLARE(dac_test, LOG_LEVEL_INF);

/* -------- Test: Continuous ramp-up from 0 to MAX -------- */
static void dac_continuous_ramp_up_test(void)
{
	int ret;
	uint32_t errors = 0;

	TC_PRINT("=== DAC Continuous Ramp-Up Test ===\n");

	for (uint32_t val = DAC_MIN_INPUT; val <= DAC_MAX_INPUT;
	     val += DAC_RAMP_STEP) {
		ret = dac_write_value(dac_dev, DAC_CHANNEL_ID, val);
		if (ret != 0) {
			errors++;
			LOG_ERR("Ramp-up write %u failed [%d]", val, ret);
		}
		k_sleep(K_MSEC(50));
	}

	/* Write final max value */
	ret = dac_write_value(dac_dev, DAC_CHANNEL_ID, DAC_MAX_INPUT);
	zassert_equal(ret, 0, "Final max write failed [%d]", ret);
	k_sleep(K_MSEC(50));

	zassert_equal(errors, 0, "Ramp-up had %u write errors", errors);

	TC_PRINT("DAC continuous ramp-up test PASSED\n");
}

/* -------- Test: Continuous ramp-down from MAX to 0 -------- */
static void dac_continuous_ramp_down_test(void)
{
	int ret;
	uint32_t errors = 0;

	TC_PRINT("=== DAC Continuous Ramp-Down Test ===\n");

	for (int32_t val = DAC_MAX_INPUT; val >= (int32_t)DAC_MIN_INPUT;
	     val -= DAC_RAMP_STEP) {
		ret = dac_write_value(dac_dev, DAC_CHANNEL_ID, (uint32_t)val);
		if (ret != 0) {
			errors++;
			LOG_ERR("Ramp-down write %d failed [%d]", val, ret);
		}
		k_sleep(K_MSEC(50));
	}

	/* Write final min value */
	ret = dac_write_value(dac_dev, DAC_CHANNEL_ID, DAC_MIN_INPUT);
	zassert_equal(ret, 0, "Final min write failed [%d]", ret);
	k_sleep(K_MSEC(50));

	zassert_equal(errors, 0, "Ramp-down had %u write errors", errors);

	TC_PRINT("DAC continuous ramp-down test PASSED\n");
}

/* -------- Test: Sawtooth waveform pattern -------- */
static void dac_continuous_sawtooth_test(void)
{
	int ret;
	uint32_t errors = 0;
	int cycles = 5;

	TC_PRINT("=== DAC Continuous Sawtooth Test (%d cycles) ===\n", cycles);

	for (int c = 0; c < cycles; c++) {
		/* Ramp up */
		for (uint32_t val = DAC_MIN_INPUT; val <= DAC_MAX_INPUT;
		     val += DAC_RAMP_STEP) {
			ret = dac_write_value(dac_dev, DAC_CHANNEL_ID, val);
			if (ret != 0) {
				errors++;
			}
			k_sleep(K_MSEC(50));
		}
		/* Reset to min (sawtooth drop) */
		ret = dac_write_value(dac_dev, DAC_CHANNEL_ID, DAC_MIN_INPUT);
		if (ret != 0) {
			errors++;
		}
		k_sleep(K_MSEC(100));
	}

	zassert_equal(errors, 0, "Sawtooth had %u write errors", errors);

	TC_PRINT("DAC continuous sawtooth test PASSED\n");
}

/* -------- Test: Triangle waveform pattern -------- */
static void dac_continuous_triangle_test(void)
{
	int ret;
	uint32_t errors = 0;
	int cycles = 5;

	TC_PRINT("=== DAC Continuous Triangle Test (%d cycles) ===\n", cycles);

	for (int c = 0; c < cycles; c++) {
		/* Ramp up */
		for (uint32_t val = DAC_MIN_INPUT; val <= DAC_MAX_INPUT;
		     val += DAC_RAMP_STEP) {
			ret = dac_write_value(dac_dev, DAC_CHANNEL_ID, val);
			if (ret != 0) {
				errors++;
			}
			k_sleep(K_MSEC(50));
		}
		/* Ramp down */
		for (int32_t val = DAC_MAX_INPUT; val >= (int32_t)DAC_MIN_INPUT;
		     val -= DAC_RAMP_STEP) {
			ret = dac_write_value(dac_dev, DAC_CHANNEL_ID,
					      (uint32_t)val);
			if (ret != 0) {
				errors++;
			}
			k_sleep(K_MSEC(50));
		}
	}

	zassert_equal(errors, 0, "Triangle had %u write errors", errors);

	TC_PRINT("DAC continuous triangle test PASSED\n");
}

/* -------- Test: Square wave pattern (toggle min/max) -------- */
static void dac_continuous_square_wave_test(void)
{
	int ret;
	uint32_t errors = 0;

	TC_PRINT("=== DAC Continuous Square Wave Test ===\n");

	for (int i = 0; i < 10; i++) {  /* Reduced for LA visibility */
		/* High */
		ret = dac_write_value(dac_dev, DAC_CHANNEL_ID, DAC_MAX_INPUT);
		if (ret != 0) {
			errors++;
		}
		k_sleep(K_MSEC(100));

		/* Low */
		ret = dac_write_value(dac_dev, DAC_CHANNEL_ID, DAC_MIN_INPUT);
		if (ret != 0) {
			errors++;
		}
		k_sleep(K_MSEC(100));
	}

	zassert_equal(errors, 0, "Square wave had %u write errors", errors);

	TC_PRINT("DAC continuous square wave test PASSED (10 toggles with 100ms delay)\n");
}

/* -------- Test: Rapid consecutive writes (stress) -------- */
static void dac_continuous_rapid_writes_test(void)
{
	int ret;
	uint32_t errors = 0;

	TC_PRINT("=== DAC Continuous Rapid Writes Test ===\n");

	for (int i = 0; i < 200; i++) {
		uint32_t val = (i * 7) & DAC_MAX_INPUT;

		ret = dac_write_value(dac_dev, DAC_CHANNEL_ID, val);
		if (ret != 0) {
			errors++;
		}
	}

	zassert_equal(errors, 0, "Rapid writes had %u errors out of %d",
		      errors, 200);

	TC_PRINT("DAC continuous rapid writes test PASSED (200 writes)\n");
}

/* -------- Test: 1 kHz conversion rate timing -------- */
static void dac_continuous_1khz_rate_test(void)
{
	int ret;
	uint32_t errors = 0;
	int num_samples = 100;
	uint32_t start_time, end_time, elapsed_ms;

	TC_PRINT("=== DAC 1 kHz Conversion Rate Test ===\n");

	/* Write num_samples values at 1ms intervals (1 kHz rate) */
	start_time = k_uptime_get_32();

	for (int i = 0; i < num_samples; i++) {
		uint32_t val = (i * DAC_MAX_INPUT) / num_samples;

		ret = dac_write_value(dac_dev, DAC_CHANNEL_ID, val);
		if (ret != 0) {
			errors++;
		}
		/* 1ms delay for 1 kHz rate */
		k_msleep(1);
	}

	end_time = k_uptime_get_32();
	elapsed_ms = end_time - start_time;

	zassert_equal(errors, 0, "1 kHz rate test had %u write errors", errors);

	LOG_INF("1 kHz test: %d samples in %u ms (expected ~%d ms)",
		num_samples, elapsed_ms, num_samples);

	/* Verify timing is reasonable (allow 20% tolerance) */
	zassert_true(elapsed_ms >= (uint32_t)(num_samples * 0.8),
		     "Timing too fast: %u ms", elapsed_ms);

	TC_PRINT("DAC 1 kHz conversion rate test PASSED\n");
}

/* -------- Test: Continuous conversion with varying step sizes -------- */
static void dac_continuous_variable_step_test(void)
{
	int ret;
	uint32_t errors = 0;

	TC_PRINT("=== DAC Continuous Variable Step Test ===\n");

	/* Test with different step sizes to ensure all transitions work */
	uint32_t steps[] = {1, 2, 4, 8, 16, 32, 64, 128, 256, 512, 1024};

	for (int s = 0; s < ARRAY_SIZE(steps); s++) {
		uint32_t step = steps[s];
		uint32_t write_count = 0;
		uint32_t delay_ms = (step >= 64U) ? 20U :
				    (step >= 16U) ? 5U : 0U;
		uint32_t limited_sweep = (step <= 8U);

		for (uint32_t val = 0; val <= DAC_MAX_INPUT; val += step) {
			if (limited_sweep && write_count >= 256U) {
				break;
			}

			ret = dac_write_value(dac_dev, DAC_CHANNEL_ID, val);
			if (ret != 0) {
				errors++;
			}
			write_count++;

			if (delay_ms > 0U) {
				k_sleep(K_MSEC(delay_ms));
			}
		}

		if (limited_sweep) {
			ret = dac_write_value(dac_dev, DAC_CHANNEL_ID, DAC_MAX_INPUT);
			if (ret != 0) {
				errors++;
			}
			write_count++;
		}

		LOG_INF("  Step %u: %u writes OK%s", step, write_count,
			limited_sweep ? " (limited sweep)" : "");
		k_sleep(K_MSEC(100));
	}

	zassert_equal(errors, 0, "Variable step had %u errors", errors);

	TC_PRINT("DAC continuous variable step test PASSED\n");
}

/* -------- Test: Repeated same-value writes (stability) -------- */
static void dac_continuous_repeated_value_test(void)
{
	int ret;
	uint32_t errors = 0;
	uint32_t test_value = DAC_MID_INPUT;

	TC_PRINT("=== DAC Continuous Repeated Value Test ===\n");

	/* Write the same value repeatedly to ensure stability */
	for (int i = 0; i < 50; i++) {  /* Reduced for LA visibility */
		ret = dac_write_value(dac_dev, DAC_CHANNEL_ID, test_value);
		if (ret != 0) {
			errors++;
		}
		k_sleep(K_MSEC(100));
	}

	zassert_equal(errors, 0, "Repeated value had %u errors out of %d",
		      errors, 50);

	TC_PRINT("DAC continuous repeated value test PASSED (50 writes of 0x%x with 100ms delay)\n",
		test_value);
}

/* ======== Continuous Test Suite ======== */

/* R-32_3: Continuous ramp-up */
ZTEST(test_dac_continuous, test_dac_continuous_ramp_up)
{
	dac_continuous_ramp_up_test();
}

/* R-32_3: Continuous ramp-down */
ZTEST(test_dac_continuous, test_dac_continuous_ramp_down)
{
	dac_continuous_ramp_down_test();
}

/* R-32_3: Sawtooth waveform */
ZTEST(test_dac_continuous, test_dac_continuous_sawtooth)
{
	dac_continuous_sawtooth_test();
}

/* R-32_3: Triangle waveform */
ZTEST(test_dac_continuous, test_dac_continuous_triangle)
{
	dac_continuous_triangle_test();
}

/* R-32_3: Square wave */
ZTEST(test_dac_continuous, test_dac_continuous_square_wave)
{
	dac_continuous_square_wave_test();
}

/* R-32_3: Rapid consecutive writes */
ZTEST(test_dac_continuous, test_dac_continuous_rapid_writes)
{
	dac_continuous_rapid_writes_test();
}

/* R-32_3: 1 kHz conversion rate */
ZTEST(test_dac_continuous, test_dac_continuous_1khz_rate)
{
	dac_continuous_1khz_rate_test();
}

/* R-32_3: Variable step sizes */
ZTEST(test_dac_continuous, test_dac_continuous_variable_step)
{
	dac_continuous_variable_step_test();
}

/* R-32_3: Repeated same value (stability) */
ZTEST(test_dac_continuous, test_dac_continuous_repeated_value)
{
	dac_continuous_repeated_value_test();
}

/* ======== Test Suite Lifecycle ======== */

static void *test_dac_continuous_setup(void)
{
	TC_PRINT("=== DAC Continuous Test Suite Setup ===\n");
	dac_dev = init_dac_device();
	zassert_not_null(dac_dev, "init_dac_device() returned NULL");
	return NULL;
}

static void test_dac_continuous_before(void *fixture)
{
	ARG_UNUSED(fixture);
	LOG_INF("--- Before continuous test ---");
}

static void test_dac_continuous_after(void *fixture)
{
	ARG_UNUSED(fixture);
	LOG_INF("--- After continuous test ---");
	/* Reset DAC output to 0 after each test */
	dac_write_value(dac_dev, DAC_CHANNEL_ID, DAC_MIN_INPUT);
}

static void test_dac_continuous_teardown(void *fixture)
{
	ARG_UNUSED(fixture);
	TC_PRINT("=== DAC Continuous Test Suite Teardown ===\n");
}


ZTEST_SUITE(test_dac_continuous, NULL, test_dac_continuous_setup,
	    test_dac_continuous_before, test_dac_continuous_after,
	    test_dac_continuous_teardown);
```
