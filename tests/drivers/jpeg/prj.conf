## CMakeLists.txt
```
cmake_minimum_required(VERSION 3.20.0)

find_package(Zephyr REQUIRED HINTS $ENV{ZEPHYR_BASE})
project(jpeg_hantro_vc9000e_test)

target_sources(app PRIVATE
	src/main.c
	src/jpeg_common.c
	src/incbin.c
	src/jpeg_perf.c
)
target_compile_definitions(app PRIVATE INCBIN_BASE_DIR="${CMAKE_CURRENT_SOURCE_DIR}")
```

## prj.conf
```kconfig
CONFIG_ZTEST=y
CONFIG_ZTEST_STACK_SIZE=8192
CONFIG_MAIN_STACK_SIZE=4096

# Video subsystem + JPEG encoder
CONFIG_VIDEO=y
CONFIG_VIDEO_JPEG_HANTRO_VC9000E=y
CONFIG_USE_ALIF_JPEG_SW_LIB=y

# Two pool entries are enough: one input (raw YUV420) + one output (JPEG).
CONFIG_VIDEO_BUFFER_POOL_NUM_MAX=2
# Sized to fit the 1280x720 NV12 reference image (1382400 B) plus the
# JPEG header (CONFIG_VIDEO_JPEG_HANTRO_VC9000E_HEADER_SIZE, 623 B by
# default). Total pool footprint: NUM_MAX * SZ_MAX ~= 2.8 MB which
# fits in SRAM0 on alif_e8_dk RTSS-HP.
#
# The 1920x1080 stress test (test_jpeg_encode_large_1920x1080) needs
# ~3.2 MB per slot (6.4 MB total) which overflows SRAM0 on this
# target. With the value below the FHD test will auto-skip via
# ztest_test_skip(). To run it on a target with more RAM (e.g. DDR
# enabled), bump this to 3200000.
CONFIG_VIDEO_BUFFER_POOL_SZ_MAX=1400000
CONFIG_SYS_HEAP_AUTO=y

# Logging
CONFIG_LOG=y
CONFIG_PRINTK=y
CONFIG_STDOUT_CONSOLE=y
CONFIG_VIDEO_LOG_LEVEL_INF=y
```

## app.overlay
```dts
/*
 * Copyright (C) Alif Semiconductor - All Rights Reserved.
 * Use, distribution and modification of this code is permitted under the
 * terms stated in the Alif Semiconductor Software License Agreement
 *
 * You should have received a copy of the Alif Semiconductor Software
 * License Agreement with this file. If not, please write to:
 * contact@alifsemi.com, or visit: https://alifsemi.com/license
 *
 */

&jpeg0 {
	status = "okay";
	quality-factor = <75>;
	max-burst-length = <64>;
};

/* JPEG run profile: ensure SRAM0 + MRAM available for buffer pool. */
&aipm_run_default {
	memory-blocks = < (ALIF_SRAM0_MASK | ALIF_MRAM_MASK) >;
};
```

## src/incbin.c
```c
/* Copyright (C) Alif Semiconductor - All Rights Reserved.
 * Use, distribution and modification of this code is permitted under the
 * terms stated in the Alif Semiconductor Software License Agreement
 *
 * You should have received a copy of the Alif Semiconductor Software
 * License Agreement with this file. If not, please write to:
 * contact@alifsemi.com, or visit: https://alifsemi.com/license
 *
 */

#include <stdint.h>

#define INCBIN_DEF(name, path) \
	__asm__( \
	".global "#name"_start\n" \
	".global "#name"_end\n" \
	".section \".rodata\"\n" \
	""#name"_start:\n" \
	".incbin \"" INCBIN_BASE_DIR "/" path "\"\n" \
	""#name"_end:\n" \
	".previous\n" \
	);

INCBIN_DEF(testimg, "../../../samples/drivers/jpeg/src/testing_images/1280x720.bin");
```

## src/jpeg_common.c
```c
/* Copyright (C) Alif Semiconductor - All Rights Reserved.
 * Use, distribution and modification of this code is permitted under the
 * terms stated in the Alif Semiconductor Software License Agreement
 *
 * You should have received a copy of the Alif Semiconductor Software
 * License Agreement with this file. If not, please write to:
 * contact@alifsemi.com, or visit: https://alifsemi.com/license
 */

#include <string.h>

#include "jpeg_common.h"

const struct device *jpeg_dev;

void jpeg_suite_before(void *fixture)
{
	ARG_UNUSED(fixture);

	jpeg_dev = DEVICE_DT_GET(JPEG_DEVICE_NODE);
	zassert_not_null(jpeg_dev, "JPEG device handle is NULL");
	zassert_true(device_is_ready(jpeg_dev),
		     "JPEG device %s not ready", jpeg_dev->name);
}

size_t jpeg_ref_image_size(void)
{
	return (size_t)(testimg_end - testimg_start);
}

void jpeg_copy_ref_image(uint8_t *dest)
{
	memcpy(dest, testimg_start, jpeg_ref_image_size());
}

void jpeg_fill_nv12_gradient(uint8_t *dest, uint32_t width, uint32_t height,
			     uint32_t pitch)
{
	uint8_t *y_plane  = dest;
	uint8_t *uv_plane = dest + (pitch * height);

	for (uint32_t row = 0; row < height; row++) {
		for (uint32_t col = 0; col < width; col++) {
			y_plane[row * pitch + col] = (uint8_t)((row + col) & 0xFF);
		}
	}
	for (uint32_t row = 0; row < (height / 2); row++) {
		for (uint32_t col = 0; col < width; col += 2) {
			uv_plane[row * pitch + col]     = (uint8_t)(0x80 + (col & 0x3F));
			uv_plane[row * pitch + col + 1] = (uint8_t)(0x80 + (row & 0x3F));
		}
	}
}

bool jpeg_validate_markers(const uint8_t *buf, size_t size)
{
	if (size < 4) {
		return false;
	}
	if (buf[0] != JPEG_MARKER_SOI_HI || buf[1] != JPEG_MARKER_SOI_LO) {
		return false;
	}
	if (buf[size - 2] != JPEG_MARKER_EOI_HI ||
	    buf[size - 1] != JPEG_MARKER_EOI_LO) {
		return false;
	}
	return true;
}

bool jpeg_validate_jfif_structure(const uint8_t *buf, size_t size)
{
	bool have_app0_jfif = false;
	bool have_dqt = false;
	bool have_sof0 = false;
	bool have_dht = false;
	bool have_sos = false;
	bool have_eoi = false;
	size_t i;

	if (size < 4 || buf[0] != 0xFF || buf[1] != 0xD8) {
		return false;
	}

	i = 2;
	while (i + 1 < size) {
		uint8_t marker;
		uint16_t seg_len;

		/* Skip 0xFF fill bytes. */
		while (i < size && buf[i] == 0xFF) {
			i++;
		}
		if (i >= size) {
			return false;
		}
		marker = buf[i++];

		if (marker == 0xD9) { /* EOI */
			have_eoi = true;
			break;
		}
		/* Standalone markers carry no length. */
		if (marker == 0x00 || marker == 0x01 ||
		    (marker >= 0xD0 && marker <= 0xD7)) {
			continue;
		}

		if (i + 2 > size) {
			return false;
		}
		seg_len = ((uint16_t)buf[i] << 8) | buf[i + 1];
		if (seg_len < 2 || i + seg_len > size) {
			return false;
		}

		switch (marker) {
		case 0xE0: /* APP0 */
			if (seg_len >= 7 &&
			    memcmp(&buf[i + 2], "JFIF\0", 5) == 0) {
				have_app0_jfif = true;
			}
			break;
		case 0xDB: /* DQT */
			have_dqt = true;
			break;
		case 0xC0: /* SOF0 (baseline) */
			have_sof0 = true;
			break;
		case 0xC4: /* DHT */
			have_dht = true;
			break;
		case 0xDA: /* SOS - entropy-coded data follows; scan for EOI */
			have_sos = true;
			i += seg_len;
			while (i + 1 < size) {
				if (buf[i] == 0xFF && buf[i + 1] != 0x00) {
					if (buf[i + 1] == 0xD9) {
						have_eoi = true;
					}
					/* Restart markers (D0-D7) keep going,
					 * but for our minimal validation it is
					 * sufficient to stop here.
					 */
					goto done;
				}
				i++;
			}
			goto done;
		default:
			break;
		}
		i += seg_len;
	}
done:
	return have_app0_jfif && have_dqt && have_sof0 &&
	       have_dht && have_sos && have_eoi;
}

bool jpeg_extract_sof0_dimensions(const uint8_t *buf, size_t size,
				  uint16_t *width, uint16_t *height)
{
	size_t i;

	if (buf == NULL || size < 4 || width == NULL || height == NULL) {
		return false;
	}
	if (buf[0] != 0xFF || buf[1] != 0xD8) {
		return false;
	}

	i = 2;
	while (i + 1 < size) {
		uint8_t marker;
		uint16_t seg_len;

		while (i < size && buf[i] == 0xFF) {
			i++;
		}
		if (i >= size) {
			return false;
		}
		marker = buf[i++];

		if (marker == 0xD9) { /* EOI */
			return false;
		}
		if (marker == 0x00 || marker == 0x01 ||
		    (marker >= 0xD0 && marker <= 0xD7)) {
			continue;
		}

		if (i + 2 > size) {
			return false;
		}
		seg_len = ((uint16_t)buf[i] << 8) | buf[i + 1];
		if (seg_len < 2 || i + seg_len > size) {
			return false;
		}

		if (marker == 0xC0) { /* SOF0 baseline */
			/* Need at least: len(2) + precision(1) + h(2) + w(2) */
			if (seg_len < 7) {
				return false;
			}
			*height = ((uint16_t)buf[i + 3] << 8) | buf[i + 4];
			*width  = ((uint16_t)buf[i + 5] << 8) | buf[i + 6];
			return true;
		}
		i += seg_len;
	}
	return false;
}

bool alloc_pair_or_skip(size_t in_sz, size_t out_sz,
			struct video_buffer **in, struct video_buffer **out,
			const char *test_name)
{
	*in = video_buffer_alloc(in_sz, K_NO_WAIT);
	*out = video_buffer_alloc(out_sz, K_NO_WAIT);

	if (!*in || !*out) {
		if (*in) {
			video_buffer_release(*in);
			*in = NULL;
		}
		if (*out) {
			video_buffer_release(*out);
			*out = NULL;
		}
		TC_PRINT("Skipping %s: buffer pool too small\n", test_name);
		ztest_test_skip();
		return false;
	}

	return true;
}
```

## src/jpeg_common.h
```c
/* Copyright (C) Alif Semiconductor - All Rights Reserved.
 * Use, distribution and modification of this code is permitted under the
 * terms stated in the Alif Semiconductor Software License Agreement
 *
 * You should have received a copy of the Alif Semiconductor Software
 * License Agreement with this file. If not, please write to:
 * contact@alifsemi.com, or visit: https://alifsemi.com/license
 */

#ifndef ALIF_JPEG_TEST_COMMON_H_
#define ALIF_JPEG_TEST_COMMON_H_

#include <zephyr/kernel.h>
#include <zephyr/device.h>
#include <zephyr/drivers/video.h>
#include <zephyr/drivers/video/video_alif.h>
#include <zephyr/drivers/video-controls.h>
#include <zephyr/logging/log.h>
#include <zephyr/ztest.h>
#include <stdint.h>
#include <stddef.h>

#define JPEG_DEVICE_NODE	DT_NODELABEL(jpeg0)

/* Reference image embedded via incbin (NV12 / YUV420SP, 1280x720). */
#define REF_IMG_WIDTH		1280
#define REF_IMG_HEIGHT		720
#define REF_IMG_PITCH		1280
#define REF_IMG_NV12_SIZE	(REF_IMG_WIDTH * REF_IMG_HEIGHT * 3 / 2)

#define JPEG_HEADER_SIZE	CONFIG_VIDEO_JPEG_HANTRO_VC9000E_HEADER_SIZE

/* Output buffer sized for the 1280x720 reference image. Generous to absorb
 * worst-case (low compression) high-quality output.
 */
#define DEFAULT_OUT_BUF_SIZE	(REF_IMG_NV12_SIZE + JPEG_HEADER_SIZE)

/* JPEG markers */
#define JPEG_MARKER_SOI_HI	0xFF
#define JPEG_MARKER_SOI_LO	0xD8
#define JPEG_MARKER_EOI_HI	0xFF
#define JPEG_MARKER_EOI_LO	0xD9

/* Embedded reference image (raw NV12 bytes). */
extern uint8_t testimg_start[];
extern uint8_t testimg_end[];

/* Shared device handle. */
extern const struct device *jpeg_dev;

/* Suite hook: acquires + validates the JPEG device. */
void jpeg_suite_before(void *fixture);

/* Helpers shared across tests. */
size_t jpeg_ref_image_size(void);
void jpeg_copy_ref_image(uint8_t *dest);

/* Fill a buffer with a deterministic NV12 gradient pattern of the given
 * dimensions. Buffer must be at least (pitch * height * 3 / 2) bytes.
 */
void jpeg_fill_nv12_gradient(uint8_t *dest, uint32_t width, uint32_t height,
			     uint32_t pitch);

/* Validate that buf[0..size) contains an SOI marker at offset 0 and an
 * EOI marker at the very end. Returns true if both checks pass.
 */
bool jpeg_validate_markers(const uint8_t *buf, size_t size);

/* Deep JFIF structural validation: walks the marker chain and checks
 * that all of the following are present in order:
 *   SOI (FFD8) -> APP0 with "JFIF\0" identifier (FFE0) ->
 *   at least one DQT (FFDB) -> SOF0 (FFC0) ->
 *   at least one DHT (FFC4) -> SOS (FFDA) -> EOI (FFD9).
 * Returns true on a structurally complete JFIF stream.
 */
bool jpeg_validate_jfif_structure(const uint8_t *buf, size_t size);

/* Extract width and height from the SOF0 (baseline) marker of an
 * encoded JPEG stream. SOF0 payload layout (after FFC0):
 *   [len_hi][len_lo][precision][height_hi][height_lo][width_hi][width_lo][nf]...
 * Returns true if SOF0 was found and width*height were populated.
 */
bool jpeg_extract_sof0_dimensions(const uint8_t *buf, size_t size,
				  uint16_t *width, uint16_t *height);

/* Encode helpers (shared across test files). */
void alloc_ref_buffers(struct video_buffer **in, struct video_buffer **out);
void release_buffers(struct video_buffer *in, struct video_buffer *out);
int do_single_encode(struct video_buffer *in, struct video_buffer *out,
		     uint16_t quality, uint32_t width, uint32_t height,
		     uint32_t pitch, struct video_buffer **deq);

/* Allocate a pair of video buffers (input and output). On allocation failure,
 * releases any partial allocations, prints a message, calls ztest_test_skip(),
 * and returns false. On success, returns true.
 */
bool alloc_pair_or_skip(size_t in_sz, size_t out_sz,
			struct video_buffer **in, struct video_buffer **out,
			const char *test_name);

#endif /* ALIF_JPEG_TEST_COMMON_H_ */
```

## src/jpeg_perf.c
```c
/* Copyright (C) Alif Semiconductor - All Rights Reserved.
 * Use, distribution and modification of this code is permitted under the
 * terms stated in the Alif Semiconductor Software License Agreement.
 *
 * You should have received a copy of the Alif Semiconductor Software
 * License Agreement with this file. If not, please write to:
 * contact@alifsemi.com, or visit: https://alifsemi.com/license
 */

/*
 * JPEG encoder performance benchmark suite.
 *
 * This suite measures encode latency and throughput at various resolutions.
 * Tests are informational (no hard pass/fail thresholds) but will fail if
 * encode time goes to zero (clock not running) or any encode errors out.
 */

#include "jpeg_common.h"
#include <zephyr/ztest.h>
#include <zephyr/kernel.h>

/*
 * Performance benchmark helper: runs warm-up encode, timed iterations,
 * metrics calculation, and prints results. Takes pre-allocated buffers
 * and dimensions as parameters, and a label for output identification.
 */
static void run_perf(uint32_t width, uint32_t height, uint32_t pitch,
		     struct video_buffer *in, struct video_buffer *out,
		     const char *label)
{
	struct video_buffer *deq = NULL;
	const int iterations = 10;
	uint32_t cyc_min = UINT32_MAX, cyc_max = 0;
	uint64_t cyc_sum = 0;
	int i, ret;

	TC_PRINT("Performance test: %ux%u NV12, quality=75, iterations=%d\n",
		 width, height, iterations);

	/* Warm-up encode (not measured) to exclude one-time HW init costs. */
	TC_PRINT("Step 1: Warm-up encode (excludes HW init costs)\n");
	ret = do_single_encode(in, out, 75, width, height, pitch, &deq);
	zassert_equal(ret, 0, "warm-up encode failed: %d", ret);
	TC_PRINT("Warm-up complete: %u bytes encoded\n", deq->bytesused);

	TC_PRINT("Step 2: Timed iterations (n=%d)\n", iterations);
	for (i = 0; i < iterations; i++) {
		uint32_t t0 = k_cycle_get_32();

		ret = do_single_encode(in, out, 75, width, height, pitch, &deq);
		uint32_t dt = k_cycle_get_32() - t0;

		zassert_equal(ret, 0, "iter %d encode failed: %d", i, ret);
		zassert_true(jpeg_validate_markers((uint8_t *)deq->buffer,
						   deq->bytesused),
			     "iter %d: SOI/EOI missing", i);

		cyc_sum += dt;
		if (dt < cyc_min) {
			cyc_min = dt;
		}
		if (dt > cyc_max) {
			cyc_max = dt;
		}

		uint32_t hz = sys_clock_hw_cycles_per_sec();
		uint32_t us = (uint32_t)((uint64_t)dt * 1000000U / hz);

		TC_PRINT("  Iter %2d: %u cycles (%u us), %u bytes\n",
			 i, dt, us, deq->bytesused);
	}

	zassert_true(cyc_sum > 0, "cycle counter not running");

	TC_PRINT("Step 3: Metrics calculation\n");
	uint32_t cyc_mean = (uint32_t)(cyc_sum / iterations);
	uint32_t hz       = sys_clock_hw_cycles_per_sec();
	uint32_t us_mean  = (uint32_t)((uint64_t)cyc_mean * 1000000U / hz);
	uint32_t us_min   = (uint32_t)((uint64_t)cyc_min  * 1000000U / hz);
	uint32_t us_max   = (uint32_t)((uint64_t)cyc_max  * 1000000U / hz);
	/* NV12 input bytes per frame = w*h*3/2 */
	const uint64_t in_bytes = (uint64_t)width * height * 3U / 2U;
	/* MB/s = bytes / sec / 1e6 = bytes * hz / cycles / 1e6 */
	uint32_t mb_per_s = (uint32_t)((in_bytes * hz)
				       / ((uint64_t)cyc_mean * 1000000U));

	TC_PRINT("Step 4: Results\n");
	TC_PRINT("  Clock frequency: %u Hz\n", hz);
	TC_PRINT("  Input size: %llu bytes (%.2f MB)\n",
		 (unsigned long long)in_bytes, (double)in_bytes / (1024.0 * 1024.0));
	TC_PRINT("  Cycle statistics: mean=%u, min=%u, max=%u\n",
		 cyc_mean, cyc_min, cyc_max);
	TC_PRINT("  Latency statistics: mean=%u us, min=%u us, max=%u us\n",
		 us_mean, us_min, us_max);
	TC_PRINT("  Throughput: %u MB/s, %u FPS\n", mb_per_s,
		 (us_mean > 0) ? (1000000U / us_mean) : 0);
	TC_PRINT("Perf %s NV12 (q=75, n=%d): "
		 "mean=%u us, min=%u us, max=%u us, throughput=%u MB/s, %u FPS\n",
		 label, iterations, us_mean, us_min, us_max, mb_per_s,
		 (us_mean > 0) ? (1000000U / us_mean) : 0);
}

/*
 * Performance benchmark: measures encode latency and throughput at the
 * reference 1280x720 resolution. Uses the shared run_perf helper.
 */
ZTEST(jpeg_perf, test_jpeg_encode_performance_1280x720)
{
	struct video_buffer *in = NULL, *out = NULL;

	alloc_ref_buffers(&in, &out);
	run_perf(REF_IMG_WIDTH, REF_IMG_HEIGHT, REF_IMG_PITCH, in, out,
		 "1280x720");
	release_buffers(in, out);
}

/*
 * Performance benchmark at 2MP (1920x1080 FHD) resolution. Measures
 * encode latency and throughput similar to the 1280x720 test but at
 * a higher resolution to assess performance scaling. Auto-skipped if
 * the buffer pool cannot accommodate the larger buffers. Uses the
 * shared run_perf helper.
 */
ZTEST(jpeg_perf, test_jpeg_encode_performance_1920x1080)
{
	const uint32_t width  = 1920;
	const uint32_t height = 1080;
	const size_t   nv12_sz = (size_t)width * height * 3 / 2;
	struct video_buffer *in = NULL, *out = NULL;

	if (!alloc_pair_or_skip(nv12_sz, nv12_sz + JPEG_HEADER_SIZE,
				&in, &out, "1920x1080_perf")) {
		return;
	}

	jpeg_fill_nv12_gradient((uint8_t *)in->buffer, width, height, width);
	out->bytesused = nv12_sz + JPEG_HEADER_SIZE;

	run_perf(width, height, width, in, out, "1920x1080");
	release_buffers(in, out);
}

ZTEST_SUITE(jpeg_perf, NULL, NULL, jpeg_suite_before, NULL, NULL);
```
