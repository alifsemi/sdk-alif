## CMakeLists.txt
```
cmake_minimum_required(VERSION 3.20.0)

find_package(Zephyr REQUIRED HINTS $ENV{ZEPHYR_BASE})
project(pdm)

target_sources(app PRIVATE src/alif_test_pdm.c)
```

## Kconfig
```
choice TEST_PDM_CHANNEL_GROUP
	prompt "PDM channel group under test"
	optional
	help
	  Select exactly one group with a build flag.
	  Pass exactly one of CONFIG_TEST_PDM_MONO_CH,
	  CONFIG_TEST_PDM_STEREO_CH, or CONFIG_TEST_PDM_MULTI_CH.
	  Also enable matching CONFIG_TEST_PDM_CHx (1 / 2 / 3..8).
	  There is no default; a build without these flags is invalid.

config TEST_PDM_MONO_CH
	bool "Test PDM mono channel (1 channel)"

config TEST_PDM_STEREO_CH
	bool "Test PDM stereo channel (2 channels)"

config TEST_PDM_MULTI_CH
	bool "Test PDM multi channel (3..8 channels)"

endchoice

config TEST_PDM_CH0
	bool "To Test pdm channel 0"
	default n
config TEST_PDM_CH1
	bool "To Test pdm channel 1"
	default n
config TEST_PDM_CH2
	bool "To Test pdm channel 2"
	default n
config TEST_PDM_CH3
	bool "To Test pdm channel 3"
	default n
config TEST_PDM_CH4
	bool "To Test pdm channel 4"
	default n
config TEST_PDM_CH5
	bool "To Test pdm channel 5"
	default n
config TEST_PDM_CH6
	bool "To Test pdm channel 6"
	default n
config TEST_PDM_CH7
	bool "To Test pdm channel 7"
	default n

choice TEST_PDM_MODE
	prompt "PDM clock/sampling mode"
	optional
	help
	  Select exactly one mode with -DCONFIG_TEST_PDM_MODEx=y
	  (x = 1..9).

config TEST_PDM_MODE1
	bool "Mode 1: standard voice 512 kHz"
config TEST_PDM_MODE2
	bool "Mode 2: high quality 512 kHz"
config TEST_PDM_MODE3
	bool "Mode 3: high quality 768 kHz"
config TEST_PDM_MODE4
	bool "Mode 4: high quality 1024 kHz"
config TEST_PDM_MODE5
	bool "Mode 5: wide bandwidth 1536 kHz"
config TEST_PDM_MODE6
	bool "Mode 6: full bandwidth 2400 kHz"
config TEST_PDM_MODE7
	bool "Mode 7: full bandwidth 3071 kHz"
config TEST_PDM_MODE8
	bool "Mode 8: ultrasound 4800 kHz"
config TEST_PDM_MODE9
	bool "Mode 9: ultrasound 96 kHz sampling"

endchoice

source "Kconfig.zephyr"
```

## prj.conf
```kconfig
CONFIG_ZTEST=y
CONFIG_AUDIO=y
CONFIG_AUDIO_DMIC=y
CONFIG_LOG=y
```

## boards/alif_pdm_multi.conf
```kconfig
CONFIG_TEST_PDM_CH4=y
CONFIG_TEST_PDM_CH5=y
CONFIG_TEST_PDM_CH6=y
CONFIG_TEST_PDM_CH7=y
```

## boards/alif_lppdm.overlay
```dts
/ {
	aliases {
		test-pdm = &lppdm;
	};
};
&lppdm {
	status = "okay";
};
```

## src/alif_test_pdm.c
```c
/* Copyright Alif Semiconductor - All Rights Reserved.
 * Use, distribution and modification of this code is permitted under the
 * terms stated in the Alif Semiconductor Software License Agreement
 *
 * You should have received a copy of the Alif Semiconductor Software
 * License Agreement with this file. If not, please write to:
 * contact@alifsemi.com, or visit: https://alifsemi.com/license
 */
#include "alif_test_pdm.h"
#include <zephyr/kernel.h>
#include <zephyr/device.h>
#include <zephyr/logging/log.h>
#include <zephyr/ztest.h>
#include <errno.h>
#include <string.h>
#include <zephyr/sys/sys_io.h>

LOG_MODULE_REGISTER(alif_test_pdm, LOG_LEVEL_INF);

#define PDM_BASE           DT_REG_ADDR(PDM)
#define PDM_CONFIG_OFF     0x00U
#define PDM_CH_FIR_OFF     0x40U
#define PDM_CH_IIR_OFF     0xC0U
#define PDM_CH_PHASE_OFF   0xC4U
#define PDM_CH_GAIN_OFF    0xC8U
#define PDM_CH_PKDET_TH    0xCCU
#define PDM_CH_PKDET_ITV   0xD0U
#define PDM_CH_STRIDE      0x100U
#define PDM_CLK_MODE_SHIFT 16U
#define PDM_CLK_MODE_MASK  0xFU

#define DEFAULT_IIR_COEF   0x00000004U
#define PRINT_BYTES        80U

static struct pdm_ch_config pdm_coef_reg;

/*
 * Channels 0,2,5,7 share one FIR set; channels 1,3,4,6 share the other.
 */
static const uint32_t fir_ch_0257[PDM_MAX_FIR_COEFFICIENT] = {
	0x00000000, 0x000007FF, 0x00000000, 0x00000004,
	0x00000004, 0x000007FC, 0x00000000, 0x000007FB,
	0x000007E4,
	0x00000000, 0x0000002B, 0x00000009, 0x00000016,
	0x00000049, 0x00000793, 0x000006F8, 0x00000045,
	0x00000178,
};
static const uint32_t fir_ch_1346[PDM_MAX_FIR_COEFFICIENT] = {
	0x00000001, 0x00000003, 0x00000003, 0x000007F4,
	0x00000004, 0x000007ED, 0x000007F5, 0x000007F4,
	0x000007D3,
	0x000007FE, 0x000007BC, 0x000007E5, 0x000007D9,
	0x00000793, 0x00000029, 0x0000072C, 0x00000072,
	0x000002FD,
};

static const uint32_t * const fir_table[8] = {
	fir_ch_0257, fir_ch_1346, fir_ch_0257, fir_ch_1346,
	fir_ch_1346, fir_ch_0257, fir_ch_1346, fir_ch_0257
};

#if NUM_CHANNELS == 0
#error "Enable at least one CONFIG_TEST_PDM_CHx"
#endif

/* Build enabled channel array via preprocessor */
static const int enabled_channels[] = {
#if IS_ENABLED(CONFIG_TEST_PDM_CH0)
	0,
#endif
#if IS_ENABLED(CONFIG_TEST_PDM_CH1)
	1,
#endif
#if IS_ENABLED(CONFIG_TEST_PDM_CH2)
	2,
#endif
#if IS_ENABLED(CONFIG_TEST_PDM_CH3)
	3,
#endif
#if IS_ENABLED(CONFIG_TEST_PDM_CH4)
	4,
#endif
#if IS_ENABLED(CONFIG_TEST_PDM_CH5)
	5,
#endif
#if IS_ENABLED(CONFIG_TEST_PDM_CH6)
	6,
#endif
#if IS_ENABLED(CONFIG_TEST_PDM_CH7)
	7,
#endif
};

BUILD_ASSERT(ARRAY_SIZE(enabled_channels) == NUM_CHANNELS,
	     "enabled_channels[] disagrees with NUM_CHANNELS");

/* Enforce that the enabled channel count matches the selected group */
#if IS_ENABLED(CONFIG_TEST_PDM_MONO_CH)
BUILD_ASSERT(NUM_CHANNELS == 1, "Mono group requires exactly 1 CONFIG_TEST_PDM_CHx");
#elif IS_ENABLED(CONFIG_TEST_PDM_STEREO_CH)
BUILD_ASSERT(NUM_CHANNELS == 2, "Stereo group requires exactly 2 CONFIG_TEST_PDM_CHx");
BUILD_ASSERT(
	(PDM_CHANNELS == (PDM_MASK_CHANNEL_0 | PDM_MASK_CHANNEL_1)) ||
	(PDM_CHANNELS == (PDM_MASK_CHANNEL_2 | PDM_MASK_CHANNEL_3)) ||
	(PDM_CHANNELS == (PDM_MASK_CHANNEL_4 | PDM_MASK_CHANNEL_5)) ||
	(PDM_CHANNELS == (PDM_MASK_CHANNEL_6 | PDM_MASK_CHANNEL_7)),
	"Stereo must be a hardware pair (0,1) (2,3) (4,5) (6,7)");
#elif IS_ENABLED(CONFIG_TEST_PDM_MULTI_CH)
BUILD_ASSERT(NUM_CHANNELS >= 3 && NUM_CHANNELS <= 8,
	     "Multi group requires 3..8 CONFIG_TEST_PDM_CHx");
#endif

static const struct pdm_ch_hw_params ch_hw_params[8] = {
	{ CH0_PHASE, CH0_GAIN, CH0_PEAK_DETECT_TH, CH0_PEAK_DETECT_ITV },
	{ CH1_PHASE, CH1_GAIN, CH1_PEAK_DETECT_TH, CH1_PEAK_DETECT_ITV },
	{ CH2_PHASE, CH2_GAIN, CH2_PEAK_DETECT_TH, CH2_PEAK_DETECT_ITV },
	{ CH3_PHASE, CH3_GAIN, CH3_PEAK_DETECT_TH, CH3_PEAK_DETECT_ITV },
	{ CH4_PHASE, CH4_GAIN, CH4_PEAK_DETECT_TH, CH4_PEAK_DETECT_ITV },
	{ CH5_PHASE, CH5_GAIN, CH5_PEAK_DETECT_TH, CH5_PEAK_DETECT_ITV },
	{ CH6_PHASE, CH6_GAIN, CH6_PEAK_DETECT_TH, CH6_PEAK_DETECT_ITV },
	{ CH7_PHASE, CH7_GAIN, CH7_PEAK_DETECT_TH, CH7_PEAK_DETECT_ITV },
};

/* Helper to set channel parameters (phase, gain, peak thresholds).
 */
static int set_channel_hw_params(const struct device *dev, uint8_t ch)
{
	const struct pdm_ch_hw_params *p;
	uintptr_t b;

	if (ch >= ARRAY_SIZE(ch_hw_params)) {
		LOG_ERR("Unsupported channel %d in %s", ch, __func__);
		return -EINVAL;
	}
	p = &ch_hw_params[ch];

	pdm_set_ch_phase(dev, ch, p->phase);
	pdm_set_ch_gain(dev, ch, p->gain);
	pdm_set_peak_detect_th(dev, ch, p->peak_th);
	pdm_set_peak_detect_itv(dev, ch, p->peak_itv);

	b = PDM_BASE + ((uintptr_t)ch * PDM_CH_STRIDE);
	zassert_equal(sys_read32(b + PDM_CH_PHASE_OFF), p->phase,
		      "CH%u phase not latched", ch);
	zassert_equal(sys_read32(b + PDM_CH_GAIN_OFF), p->gain,
		      "CH%u gain not latched", ch);
	zassert_equal(sys_read32(b + PDM_CH_PKDET_TH), p->peak_th,
		      "CH%u peak_th not latched", ch);
	zassert_equal(sys_read32(b + PDM_CH_PKDET_ITV), p->peak_itv,
		      "CH%u peak_itv not latched", ch);

	return 0;
}

/* Configure a single channel: set HW params, copy FIR/IIR, call pdm_channel_config */
static int pdm_configure_channel(const struct device *dev, uint8_t ch,
		const uint32_t *fir, uint32_t iir)
{
	int rc;
	uintptr_t b;

	if (!dev) {
		LOG_ERR("%s: device is NULL", __func__);
		return -EINVAL;
	}

	rc = set_channel_hw_params(dev, ch);

	if (rc) {
		return rc;
	}

	pdm_coef_reg.ch_num = ch;
	memcpy(pdm_coef_reg.ch_fir_coef, fir, sizeof(pdm_coef_reg.ch_fir_coef));
	pdm_coef_reg.ch_iir_coef = iir;
	pdm_channel_config(dev, &pdm_coef_reg);

	b = PDM_BASE + ((uintptr_t)ch * PDM_CH_STRIDE);
	zassert_equal(sys_read32(b + PDM_CH_IIR_OFF), iir,
		      "CH%u IIR not latched", ch);
	zassert_equal(sys_read32(b + PDM_CH_FIR_OFF), fir[0],
		      "CH%u FIR[0] not latched", ch);
	LOG_DBG("Configured PDM channel %u", ch);
	return 0;
}

/* Configure channels depending on mono/stereo/multi selection */
static int pdm_configure_selected_channels(const struct device *dev)
{
	size_t idx;
	const size_t num_enabled = ARRAY_SIZE(enabled_channels);

	if (num_enabled == 0) {
		LOG_ERR("No CONFIG_TEST_PDM_CHx enabled; nothing to configure");
		return -EINVAL;
	}

	for (idx = 0; idx < num_enabled; ++idx) {
		int ch = enabled_channels[idx];
		int rc;

		if (ch < 0 || ch > 7) {
			LOG_ERR("Invalid channel entry: %d", ch);
			return -EINVAL;
		}
		rc = pdm_configure_channel(dev, (uint8_t)ch, fir_table[ch], DEFAULT_IIR_COEF);

		if (rc) {
			LOG_ERR("Failed to configure channel %d: %d", ch, rc);
			return rc;
		}
	}
	return 0;
}

/* PDM mode selection helper -- picks the first enabled mode from compile-time macros */
static void pdm_select_mode(const struct device *dev)
{
#if IS_ENABLED(CONFIG_TEST_PDM_MODE9)
	pdm_mode(dev, PDM_MODE_ULTRASOUND_96_SAMPLING_RATE);
	LOG_INF("Configured MODE9: PDM_MODE_ULTRASOUND_96_SAMPLING_RATE");
#elif IS_ENABLED(CONFIG_TEST_PDM_MODE8)
	pdm_mode(dev, PDM_MODE_ULTRASOUND_4800_CLOCK_FRQ);
	LOG_INF("Configured MODE8: PDM_MODE_ULTRASOUND_4800_CLOCK_FRQ");
#elif IS_ENABLED(CONFIG_TEST_PDM_MODE7)
	pdm_mode(dev, PDM_MODE_FULL_BANDWIDTH_AUDIO_3071_CLK_FRQ);
	LOG_INF("Configured MODE7: PDM_MODE_FULL_BANDWIDTH_AUDIO_3071_CLK_FRQ");
#elif IS_ENABLED(CONFIG_TEST_PDM_MODE6)
	pdm_mode(dev, PDM_MODE_FULL_BANDWIDTH_AUDIO_2400_CLK_FRQ);
	LOG_INF("Configured MODE6: PDM_MODE_FULL_BANDWIDTH_AUDIO_2400_CLK_FRQ");
#elif IS_ENABLED(CONFIG_TEST_PDM_MODE5)
	pdm_mode(dev, PDM_MODE_WIDE_BANDWIDTH_AUDIO_1536_CLK_FRQ);
	LOG_INF("Configured MODE5: PDM_MODE_WIDE_BANDWIDTH_AUDIO_1536_CLK_FRQ");
#elif IS_ENABLED(CONFIG_TEST_PDM_MODE4)
	pdm_mode(dev, PDM_MODE_HIGH_QUALITY_1024_CLK_FRQ);
	LOG_INF("Configured MODE4: PDM_MODE_HIGH_QUALITY_1024_CLK_FRQ");
#elif IS_ENABLED(CONFIG_TEST_PDM_MODE3)
	pdm_mode(dev, PDM_MODE_HIGH_QUALITY_768_CLK_FRQ);
	LOG_INF("Configured MODE3: PDM_MODE_HIGH_QUALITY_768_CLK_FRQ");
#elif IS_ENABLED(CONFIG_TEST_PDM_MODE2)
	pdm_mode(dev, PDM_MODE_HIGH_QUALITY_512_CLK_FRQ);
	LOG_INF("Configured MODE2: PDM_MODE_HIGH_QUALITY_512_CLK_FRQ");
#elif IS_ENABLED(CONFIG_TEST_PDM_MODE1)
	pdm_mode(dev, PDM_MODE_STANDARD_VOICE_512_CLK_FRQ);
	LOG_INF("Configured MODE1: PDM_MODE_STANDARD_VOICE_512_CLK_FRQ");
#endif
}

/* Configure the selected channels and PDM clock mode */
static int pdm_setup_channels_and_mode(void)
{
	const struct device *dev = DEVICE_DT_GET(PDM);
	int rc;
	uint32_t cfg;
	uint8_t mode;

	rc = pdm_configure_selected_channels(dev);
	if (rc) {
		LOG_ERR("%s: channel configuration failed: %d", __func__, rc);
		return rc;
	}

	pdm_select_mode(dev);
	cfg = sys_read32(PDM_BASE + PDM_CONFIG_OFF);
	mode = (cfg >> PDM_CLK_MODE_SHIFT) & PDM_CLK_MODE_MASK;
	zassert_equal(mode, (uint8_t)PDM_MODE_HW, "PDM mode bits");
	return 0;
}

/* Memory slab for the PDM capture test */
K_MEM_SLAB_DEFINE(mem_slab, PCMJ_BLOCK_SIZE, MEM_SLAB_NUM_BLOCKS, 4);

BUILD_ASSERT(SAMPLE_BIT_WIDTH == 16, "stats assume 16-bit PCM");
BUILD_ASSERT((DATA_SIZE % sizeof(int16_t)) == 0, "DATA_SIZE not 16-bit aligned");

static int16_t pcmj_data[DATA_SIZE / sizeof(int16_t)];

/* Number of valid bytes stored in pcmj_data after the last capture */
static size_t captured_bytes;

static void set_config(struct dmic_cfg *cfg, struct pcm_stream_cfg *stream)
{
	uint32_t channel_map = 0;

	stream->pcm_width = SAMPLE_BIT_WIDTH;
	cfg->streams = stream;
	cfg->streams[0].mem_slab = &mem_slab;
	cfg->channel.req_num_streams = 1;
	cfg->channel.req_num_chan = NUM_CHANNELS;
	cfg->streams[0].block_size = PCMJ_BLOCK_SIZE;

	channel_map = PDM_CHANNELS;

	cfg->channel.req_chan_map_lo = channel_map;

	LOG_INF("memslab: %p", cfg->streams[0].mem_slab);
	LOG_INF("channel_map 0x%x block size: 0x%x", channel_map, PCMJ_BLOCK_SIZE);
}

/* Core capture routine */
static int config_channel(const struct device *dmic_dev,
			  struct dmic_cfg *cfg, uint8_t block_count)
{
	int rc;
	uint8_t i;
	void *buffer = NULL;
	size_t data = 0;
	size_t k = 0;
	const size_t expected = (size_t)block_count * PCMJ_BLOCK_SIZE;

	zassert_not_null(dmic_dev, "%s: dmic_dev is NULL", __func__);
	zassert_not_null(cfg, "%s: cfg is NULL", __func__);
	zassert_true(expected <= (size_t)DATA_SIZE,
		     "capture %zu bytes exceeds pcmj_data %zu",
		     expected, (size_t)DATA_SIZE);
/*
 * dmic_configure() stores slab, block_size and the channel map.
 * It does not program PDM clock/mode (pcm_rate is unused).
 * pdm_setup_channels_and_mode() then writes FIR/IIR and pdm_mode();
 * PDM_CONFIG[19:16] is checked by MMIO read-back.
 */
	rc = dmic_configure(dmic_dev, cfg);
	if (rc) {
		LOG_ERR("dmic_configure failed: %d", rc);
		return rc;
	}

	rc = pdm_setup_channels_and_mode();
	if (rc) {
		return rc;
	}

	LOG_INF("Start Speaking or Play some Audio!");

	rc = dmic_trigger(dmic_dev, DMIC_TRIGGER_START);
	if (rc) {
		LOG_ERR("dmic_trigger START failed: %d", rc);
		return rc;
	}

	/*
	 * Discard the first block: FIR/IIR needs time to settle.
	 * If this read fails, later blocks are not a valid capture.
	 */
	rc = dmic_read(dmic_dev, 0, &buffer, &data, TIMEOUT);
	if (rc || buffer == NULL || data == 0U) {
		LOG_ERR("Settling block read failed: rc=%d data=%zu", rc, data);
		if (buffer != NULL) {
			k_mem_slab_free(&mem_slab, buffer);
		}
		(void)dmic_trigger(dmic_dev, DMIC_TRIGGER_STOP);
		return rc ? rc : -EIO;
	}
	k_mem_slab_free(&mem_slab, buffer);
	LOG_INF("Discarded settling block (%zu bytes)", data);

	for (i = 0; i < block_count; ++i) {
		rc = dmic_read(dmic_dev, 0, &buffer, &data, TIMEOUT);
		if (rc < 0 || buffer == NULL || data == 0U) {
			LOG_ERR("dmic_read block %u failed: rc=%d data=%zu",
				i, rc, data);
			if (buffer != NULL) {
				k_mem_slab_free(&mem_slab, buffer);
			}
			(void)dmic_trigger(dmic_dev, DMIC_TRIGGER_STOP);
			return rc ? rc : -EIO;
		}

		if (data != PCMJ_BLOCK_SIZE) {
			LOG_ERR("block %u size %zu != PCMJ_BLOCK_SIZE %d",
				i, data, PCMJ_BLOCK_SIZE);
			k_mem_slab_free(&mem_slab, buffer);
			(void)dmic_trigger(dmic_dev, DMIC_TRIGGER_STOP);
			return -EIO;
		}

		if ((k + data) > (size_t)DATA_SIZE) {
			LOG_ERR("PCM buffer overflow: have %zu need %zu cap %zu",
				k, k + data, (size_t)DATA_SIZE);
			k_mem_slab_free(&mem_slab, buffer);
			(void)dmic_trigger(dmic_dev, DMIC_TRIGGER_STOP);
			return -ENOSPC;
		}

		memcpy((uint8_t *)pcmj_data + k, buffer, data);
		k += data;
		k_mem_slab_free(&mem_slab, buffer);
	}

	captured_bytes = k;

	LOG_INF("Stop recording");
	LOG_INF("PCM samples stored at %p captured_bytes: %zu",
		(void *)pcmj_data, captured_bytes);

	rc = dmic_trigger(dmic_dev, DMIC_TRIGGER_STOP);
	if (rc) {
		LOG_ERR("dmic_trigger STOP failed: %d", rc);
		return rc;
	}

	return 0;
}

/*
 * Informational signal statistics over the captured (post-settling) PCM data.
 * This NEVER fails the test: capture in true silence is valid. It helps verify
 * that real-audio playback was recorded when inspecting the logs.
 */
static void pdm_log_signal_stats(void)
{
	const int16_t *s = pcmj_data;
	size_t n = captured_bytes / sizeof(int16_t);
	int16_t mn = INT16_MAX;
	int16_t mx = INT16_MIN;
	size_t nonzero = 0;
	long first_nz = -1;

	if (n == 0) {
		LOG_INF("Signal stats: no samples captured");
		return;
	}

	for (size_t i = 0; i < n; ++i) {
		int16_t v = s[i];

		if (v < mn) {
			mn = v;
		}
		if (v > mx) {
			mx = v;
		}
		if (v != 0) {
			nonzero++;
			if (first_nz < 0) {
				first_nz = (long)i;
			}
		}
	}

	LOG_INF("Signal stats: samples=%zu nonzero=%zu min=%d max=%d first_nonzero=%ld",
		n, nonzero, mn, mx, first_nz);
}

/* Print first bytes of captured PCM data for debugging */
static void print_data(void)
{
	size_t i;
	size_t lim = MIN((size_t)PRINT_BYTES, captured_bytes);
	const uint8_t *p = (const uint8_t *)pcmj_data;

	LOG_INF("pcm data pointer: %p captured_bytes: %zu",
		(void *)pcmj_data, captured_bytes);

	for (i = 0; i + 7 < lim; i += 8) {
		LOG_INF(" %02x %02x %02x %02x %02x %02x %02x %02x",
			p[i], p[i + 1], p[i + 2], p[i + 3],
			p[i + 4], p[i + 5], p[i + 6], p[i + 7]);
	}
}

static int test_channel(void)
{
	const struct device *pcmj_device;
	struct dmic_cfg cfg = {0};
	struct pcm_stream_cfg stream = {0};
	int rc;

	LOG_INF("PDM test channel");

	pcmj_device = DEVICE_DT_GET(PDM);

	zassert_true(device_is_ready(pcmj_device), "device not ready");

	set_config(&cfg, &stream);

	rc = config_channel(pcmj_device, &cfg, MEM_SLAB_NUM_BLOCKS);
	if (rc) {
		LOG_ERR("config_channel returned %d", rc);
		return rc;
	}

	if (captured_bytes == 0U) {
		LOG_ERR("no PCM captured");
		return -EIO;
	}

	if (captured_bytes != ((size_t)MEM_SLAB_NUM_BLOCKS * PCMJ_BLOCK_SIZE)) {
		LOG_ERR("short capture: got %zu expected %zu",
			captured_bytes,
			(size_t)MEM_SLAB_NUM_BLOCKS * PCMJ_BLOCK_SIZE);
		return -EIO;
	}

	print_data();
	pdm_log_signal_stats();

	return 0;
}

static void pdm_capture_before(void *fixture)
{
	ARG_UNUSED(fixture);

	captured_bytes = 0;
	memset(pcmj_data, 0, sizeof(pcmj_data));
	zassert_equal(k_mem_slab_num_used_get(&mem_slab), 0U,
		      "slab leak before test");
}

static void pdm_capture_after(void *fixture)
{
	ARG_UNUSED(fixture);

	(void)dmic_trigger(DEVICE_DT_GET(PDM), DMIC_TRIGGER_STOP);
	zassert_equal(k_mem_slab_num_used_get(&mem_slab), 0U,
		      "slab leak after test");
}

/*
 * Single ZTEST whose suite is test_pdm (HP) / test_lppdm (HE) and whose case
 * name is generated at compile time from the active group + mode + channels
 * (see PDM_SUITE_NAME / PDM_TEST_NAME), e.g. test_pdm_multi_mode6_ch_0_1_4_5.
 * The extra indirection forces those macros to expand before ZTEST token-pastes
 * them, yielding a unique, deterministic name per build for TestLink mapping.
 */
#define PDM_ZTEST(suite, name) ZTEST(suite, name)
#define PDM_ZTEST_SUITE(suite) \
	ZTEST_SUITE(suite, NULL, NULL, pdm_capture_before, \
		    pdm_capture_after, NULL)

PDM_ZTEST(PDM_SUITE_NAME, PDM_TEST_NAME)
{
	zassert_ok(test_channel(), "PDM capture failed");
}

PDM_ZTEST_SUITE(PDM_SUITE_NAME);
```

## src/alif_test_pdm.h
```c
/* Copyright Alif Semiconductor - All Rights Reserved.
 * Use, distribution and modification of this code is permitted under the
 * terms stated in the Alif Semiconductor Software License Agreement
 *
 * You should have received a copy of the Alif Semiconductor Software
 * License Agreement with this file. If not, please write to:
 * contact@alifsemi.com, or visit: https://alifsemi.com/license
 */

#ifndef ALIF_TEST_PDM_H_
#define ALIF_TEST_PDM_H_

#include <zephyr/kernel.h>
#include <zephyr/device.h>
#include <zephyr/audio/dmic.h>
#include <zephyr/drivers/pdm/pdm_alif.h>
#include <string.h>
#include <zephyr/ztest.h>
#include <zephyr/logging/log.h>
#define PDM	DT_ALIAS(test_pdm)
/*
 * Per-channel enable flags (1 if selected via Kconfig, else 0).
 * These are the single source of truth for the channel count and mask.
 */
#define PDM_CH0_EN IS_ENABLED(CONFIG_TEST_PDM_CH0)
#define PDM_CH1_EN IS_ENABLED(CONFIG_TEST_PDM_CH1)
#define PDM_CH2_EN IS_ENABLED(CONFIG_TEST_PDM_CH2)
#define PDM_CH3_EN IS_ENABLED(CONFIG_TEST_PDM_CH3)
#define PDM_CH4_EN IS_ENABLED(CONFIG_TEST_PDM_CH4)
#define PDM_CH5_EN IS_ENABLED(CONFIG_TEST_PDM_CH5)
#define PDM_CH6_EN IS_ENABLED(CONFIG_TEST_PDM_CH6)
#define PDM_CH7_EN IS_ENABLED(CONFIG_TEST_PDM_CH7)

/* Number of channels under test = count of enabled channels */
#define NUM_CHANNELS (PDM_CH0_EN + PDM_CH1_EN + PDM_CH2_EN + PDM_CH3_EN + \
		      PDM_CH4_EN + PDM_CH5_EN + PDM_CH6_EN + PDM_CH7_EN)

/* Channel bitmask derived from the enabled channels (req_chan_map_lo) */
#define PDM_CHANNELS ( \
	(PDM_CH0_EN ? PDM_MASK_CHANNEL_0 : 0) | \
	(PDM_CH1_EN ? PDM_MASK_CHANNEL_1 : 0) | \
	(PDM_CH2_EN ? PDM_MASK_CHANNEL_2 : 0) | \
	(PDM_CH3_EN ? PDM_MASK_CHANNEL_3 : 0) | \
	(PDM_CH4_EN ? PDM_MASK_CHANNEL_4 : 0) | \
	(PDM_CH5_EN ? PDM_MASK_CHANNEL_5 : 0) | \
	(PDM_CH6_EN ? PDM_MASK_CHANNEL_6 : 0) | \
	(PDM_CH7_EN ? PDM_MASK_CHANNEL_7 : 0))

/*
 * -------- Compile-time unique ZTEST name --------
 * Suite: &pdm → test_pdm, &lppdm → test_lppdm.
 * Case:   <suite>_<group>_mode<N>_ch[_<n>...]
 * Examples: test_pdm_multi_mode6_ch_0_1_4_5, test_lppdm_mono_mode1_ch_3
 */
#define PDM_CAT_(a, b) a##b
#define PDM_CAT(a, b) PDM_CAT_(a, b)

#if DT_NODE_EXISTS(DT_NODELABEL(lppdm)) && \
	DT_SAME_NODE(DT_ALIAS(test_pdm), DT_NODELABEL(lppdm))
#define PDM_SUITE_NAME test_lppdm
#elif DT_NODE_EXISTS(DT_NODELABEL(pdm)) && \
	DT_SAME_NODE(DT_ALIAS(test_pdm), DT_NODELABEL(pdm))
#define PDM_SUITE_NAME test_pdm
#else
#error "test-pdm alias must point to pdm or lppdm (use -S pdm or -S lppdm)"
#endif

#if IS_ENABLED(CONFIG_TEST_PDM_MONO_CH)
#define PDM_GROUP_TAG mono
#elif IS_ENABLED(CONFIG_TEST_PDM_STEREO_CH)
#define PDM_GROUP_TAG stereo
#elif IS_ENABLED(CONFIG_TEST_PDM_MULTI_CH)
#define PDM_GROUP_TAG multi
#else
#error "No PDM channel group selected (TEST_PDM_MONO_CH/STEREO_CH/MULTI_CH)"
#endif

#if IS_ENABLED(CONFIG_TEST_PDM_MODE9)
#define PDM_MODE_TAG mode9
#elif IS_ENABLED(CONFIG_TEST_PDM_MODE8)
#define PDM_MODE_TAG mode8
#elif IS_ENABLED(CONFIG_TEST_PDM_MODE7)
#define PDM_MODE_TAG mode7
#elif IS_ENABLED(CONFIG_TEST_PDM_MODE6)
#define PDM_MODE_TAG mode6
#elif IS_ENABLED(CONFIG_TEST_PDM_MODE5)
#define PDM_MODE_TAG mode5
#elif IS_ENABLED(CONFIG_TEST_PDM_MODE4)
#define PDM_MODE_TAG mode4
#elif IS_ENABLED(CONFIG_TEST_PDM_MODE3)
#define PDM_MODE_TAG mode3
#elif IS_ENABLED(CONFIG_TEST_PDM_MODE2)
#define PDM_MODE_TAG mode2
#elif IS_ENABLED(CONFIG_TEST_PDM_MODE1)
#define PDM_MODE_TAG mode1
#else
#error "No PDM mode selected (pass -DCONFIG_TEST_PDM_MODE1=y .. MODE9=y)"
#endif

#if IS_ENABLED(CONFIG_TEST_PDM_MODE9)
#define PDM_MODE_HW PDM_MODE_ULTRASOUND_96_SAMPLING_RATE
#elif IS_ENABLED(CONFIG_TEST_PDM_MODE8)
#define PDM_MODE_HW PDM_MODE_ULTRASOUND_4800_CLOCK_FRQ
#elif IS_ENABLED(CONFIG_TEST_PDM_MODE7)
#define PDM_MODE_HW PDM_MODE_FULL_BANDWIDTH_AUDIO_3071_CLK_FRQ
#elif IS_ENABLED(CONFIG_TEST_PDM_MODE6)
#define PDM_MODE_HW PDM_MODE_FULL_BANDWIDTH_AUDIO_2400_CLK_FRQ
#elif IS_ENABLED(CONFIG_TEST_PDM_MODE5)
#define PDM_MODE_HW PDM_MODE_WIDE_BANDWIDTH_AUDIO_1536_CLK_FRQ
#elif IS_ENABLED(CONFIG_TEST_PDM_MODE4)
#define PDM_MODE_HW PDM_MODE_HIGH_QUALITY_1024_CLK_FRQ
#elif IS_ENABLED(CONFIG_TEST_PDM_MODE3)
#define PDM_MODE_HW PDM_MODE_HIGH_QUALITY_768_CLK_FRQ
#elif IS_ENABLED(CONFIG_TEST_PDM_MODE2)
#define PDM_MODE_HW PDM_MODE_HIGH_QUALITY_512_CLK_FRQ
#elif IS_ENABLED(CONFIG_TEST_PDM_MODE1)
#define PDM_MODE_HW PDM_MODE_STANDARD_VOICE_512_CLK_FRQ
#endif

#if IS_ENABLED(CONFIG_TEST_PDM_CH0)
#define PDM_CH0_TAG _0
#else
#define PDM_CH0_TAG
#endif
#if IS_ENABLED(CONFIG_TEST_PDM_CH1)
#define PDM_CH1_TAG _1
#else
#define PDM_CH1_TAG
#endif
#if IS_ENABLED(CONFIG_TEST_PDM_CH2)
#define PDM_CH2_TAG _2
#else
#define PDM_CH2_TAG
#endif
#if IS_ENABLED(CONFIG_TEST_PDM_CH3)
#define PDM_CH3_TAG _3
#else
#define PDM_CH3_TAG
#endif
#if IS_ENABLED(CONFIG_TEST_PDM_CH4)
#define PDM_CH4_TAG _4
#else
#define PDM_CH4_TAG
#endif
#if IS_ENABLED(CONFIG_TEST_PDM_CH5)
#define PDM_CH5_TAG _5
#else
#define PDM_CH5_TAG
#endif
#if IS_ENABLED(CONFIG_TEST_PDM_CH6)
#define PDM_CH6_TAG _6
#else
#define PDM_CH6_TAG
#endif
#if IS_ENABLED(CONFIG_TEST_PDM_CH7)
#define PDM_CH7_TAG _7
#else
#define PDM_CH7_TAG
#endif

#define PDM_TEST_NAME \
	PDM_CAT(PDM_CAT(PDM_CAT(PDM_CAT(PDM_CAT(PDM_CAT(PDM_CAT( \
	PDM_CAT(PDM_CAT(PDM_CAT(PDM_CAT(PDM_CAT(PDM_CAT( \
	PDM_SUITE_NAME, _), PDM_GROUP_TAG), _), PDM_MODE_TAG), _ch), \
	PDM_CH0_TAG), PDM_CH1_TAG), PDM_CH2_TAG), PDM_CH3_TAG), \
	PDM_CH4_TAG), PDM_CH5_TAG), PDM_CH6_TAG), PDM_CH7_TAG)


#define PCMJ_BLOCK_SIZE   (40000)

#if IS_ENABLED(CONFIG_RTSS_HE)
#define MEM_SLAB_NUM_BLOCKS  3
#elif IS_ENABLED(CONFIG_RTSS_HP)
#define MEM_SLAB_NUM_BLOCKS  4
#else
#error "Set CONFIG_RTSS_HE or CONFIG_RTSS_HP"
#endif

/* size of buffer where the whole data is stored */
#define DATA_SIZE        (PCMJ_BLOCK_SIZE * MEM_SLAB_NUM_BLOCKS)
#define SAMPLE_BIT_WIDTH 16
#define TIMEOUT          5000	/* dmic_read timeout in milliseconds */

struct pdm_ch_hw_params {
	uint32_t phase;
	uint32_t gain;
	uint32_t peak_th;
	uint32_t peak_itv;
};

/* PDM Channel 0 configurations */
#define CH0_PHASE             0x00000003
#define CH0_GAIN              0x00000013
#define CH0_PEAK_DETECT_TH    0x00060002
#define CH0_PEAK_DETECT_ITV   0x00020027
/* PDM Channel 1 configurations */
#define CH1_PHASE             0x0000001F
#define CH1_GAIN              0x0000000D
#define CH1_PEAK_DETECT_TH    0x00060002
#define CH1_PEAK_DETECT_ITV   0x0004002D
/* PDM Channel 2 configurations */
#define CH2_PHASE             0x00000003
#define CH2_GAIN              0x00000013
#define CH2_PEAK_DETECT_TH    0x00060002
#define CH2_PEAK_DETECT_ITV   0x00020027
/* PDM Channel 3 configurations */
#define CH3_PHASE             0x0000001F
#define CH3_GAIN              0x0000000D
#define CH3_PEAK_DETECT_TH    0x00060002
#define CH3_PEAK_DETECT_ITV   0x0004002D
/* PDM Channel 4 configurations */
#define CH4_PHASE             0x0000001F
#define CH4_GAIN              0x0000000D
#define CH4_PEAK_DETECT_TH    0x00060002
#define CH4_PEAK_DETECT_ITV   0x0004002D
/* PDM Channel 5 configurations */
#define CH5_PHASE             0x00000003
#define CH5_GAIN              0x00000013
#define CH5_PEAK_DETECT_TH    0x00060002
#define CH5_PEAK_DETECT_ITV   0x00020027
/* PDM Channel 6 configurations */
#define CH6_PHASE             0x0000001F
#define CH6_GAIN              0x0000000D
#define CH6_PEAK_DETECT_TH    0x00060002
#define CH6_PEAK_DETECT_ITV   0x0004002D
/* PDM Channel 7 configurations */
#define CH7_PHASE             0x00000003
#define CH7_GAIN              0x00000013
#define CH7_PEAK_DETECT_TH    0x00060002
#define CH7_PEAK_DETECT_ITV   0x00020027

#endif /* ALIF_TEST_PDM_H_ */
```
