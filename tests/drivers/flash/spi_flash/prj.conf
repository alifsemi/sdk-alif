## CMakeLists.txt
```
cmake_minimum_required(VERSION 3.20.0)
find_package(Zephyr REQUIRED HINTS $ENV{ZEPHYR_BASE})
project(alif_ospi_flash)

target_include_directories(app PRIVATE
  ${ZEPHYR_BASE}/drivers/flash
)

if(CONFIG_ALIF_OSPI_FLASH_XIP)
  target_sources(app PRIVATE
    src/test_ospi_xip_tests.c
    src/test_ospi_xip_reg_tests.c
  )
else()
  target_sources(app PRIVATE
    src/test_ospi_main.c
    src/test_ospi_boundary_tests.c
    src/test_ospi_negative_tests.c
    src/test_ospi_ctrl_tests.c
    src/test_ospi_xip_reg_tests.c
  )

  if(CONFIG_TEST_OSPI_FLASH_PERF)
    target_sources(app PRIVATE src/test_ospi_perf_tests.c)
  endif()

  if(CONFIG_TEST_OSPI_FLASH_EXTRA)
    target_sources(app PRIVATE
      src/test_ospi_flash_dev_tests.c
      src/test_ospi_irq_tests.c
      src/test_ospi_xip_transition_tests.c
    )
  endif()
endif()
```

## Kconfig
```
config TEST_OSPI_FLASH_PERF
	bool "Enable OSPI flash performance test suite"
	default n
	help
	  Enable performance benchmarking test cases for the Alif OSPI flash
	  driver on the Zephyr test harness. When enabled, the build includes
	  the test suite defined in test_ospi_perf_tests.c, which performs
	  repeated erase/write/read operations across a bounded region of the
	  attached flash device (starting at the test region offset, never
	  offset 0). Each iteration measures elapsed time using k_uptime_get()
	  and accumulates totals so that average latency and throughput (KiB/s)
	  for erase, write, and read can be reported through LOG_INF. These
	  metrics help validate driver performance regressions and characterize
	  the OSPI bus at different clock speeds. Leave this disabled for
	  functional-only test runs as the performance suite extends execution
	  time significantly.

config TEST_OSPI_FLASH_FULL_CHIP
	bool "Enable the destructive full-chip OSPI flash perf test"
	depends on TEST_OSPI_FLASH_PERF
	default n
	help
	  Add a full-device erase/write/read case to the performance suite
	  (test_ospi_perf_full_chip). It calls flash_erase(0, total), which
	  uses the driver's chip-erase path and WIPES the entire device,
	  including offset 0 and any boot image stored there. Sized from DT
	  (num-of-sector x sector-size): 64 MiB on E7, 128 MiB on E8, so it
	  also runs for a long time. Keep this disabled in CI and only enable
	  it on a bring-up board that does not boot from this flash part.

config TEST_OSPI_FLASH_EXTRA
	bool "Enable extra OSPI flash API/DT suites"
	default n
	help
	  Build the extra flash-device, IRQ-routing, and XIP-transition suites.
	  Those tests use Zephyr flash APIs, HAL functions (prepare_transfer,
	  xip enable/disable), and user-configurable DT/Kconfig macros. They
	  do not read or write OSPI or AES registers from the testcase. If a
	  required driver or HAL API is missing or broken, the case fails.

config TEST_OSPI_XIP_LIVE
	bool "Dereference the XIP window in XIP API/transition suites"
	depends on TEST_OSPI_FLASH_EXTRA
	default y
	help
	  Allow the XIP transition and XIP API suites to read through the
	  memory-mapped XIP window after alif_hal_ospi_xip_enable(). This is
	  what turns the mapped-read, boundary-read and off-to-on cases into
	  real data comparisons.

	  A mapped read with a descriptor the attached device does not accept
	  is a bus fault rather than a failed assertion, so disable this option
	  on a board whose flash part or wiring differs from the one described
	  in devicetree. With it disabled those suites still run the HAL
	  enable/disable and flash_* half of each case and skip only the
	  window dereference.

source "Kconfig.zephyr"
```

## prj.conf
```kconfig
CONFIG_STDOUT_CONSOLE=y
CONFIG_FLASH=y
CONFIG_OSPI_FLASH_IS25WX=y
CONFIG_LOG=y
CONFIG_ARM_MPU=y
CONFIG_CPU_HAS_CUSTOM_FIXED_SOC_MPU_REGIONS=y
CONFIG_EVENTS=y
CONFIG_MAIN_STACK_SIZE=40960
CONFIG_ZTEST_STACK_SIZE=40960
CONFIG_FLASH_LOG_LEVEL_DBG=n
CONFIG_ZTEST=y
```

## boards/ospi0_80Mhz.overlay
```dts
/* Copyright (C) 2026 Alif Semiconductor - All Rights Reserved.
 * Use, distribution and modification of this code is permitted under the
 * terms stated in the Alif Semiconductor Software License Agreement
 *
 * You should have received a copy of the Alif Semiconductor Software
 * License Agreement with this file. If not, please write to:
 * contact@alifsemi.com, or visit: https://alifsemi.com/license
 */

&ospi0 {
	bus-speed = <80000000>;
};
```

## boards/ospi1_100Mhz.overlay
```dts
/* Copyright (C) 2026 Alif Semiconductor - All Rights Reserved.
 * Use, distribution and modification of this code is permitted under the
 * terms stated in the Alif Semiconductor Software License Agreement
 *
 * You should have received a copy of the Alif Semiconductor Software
 * License Agreement with this file. If not, please write to:
 * contact@alifsemi.com, or visit: https://alifsemi.com/license
 */
&ospi1 {
	bus-speed = <100000000>;
	status = "okay";
};
```

## boards/ospi1_200Mhz.overlay
```dts
/* Copyright (C) 2026 Alif Semiconductor - All Rights Reserved.
 * Use, distribution and modification of this code is permitted under the
 * terms stated in the Alif Semiconductor Software License Agreement
 *
 * You should have received a copy of the Alif Semiconductor Software
 * License Agreement with this file. If not, please write to:
 * contact@alifsemi.com, or visit: https://alifsemi.com/license
 */
&ospi1 {
	bus-speed = <200000000>;
	status = "okay";
};
```

## boards/ospi1_50Mhz.overlay
```dts
/* Copyright (C) 2026 Alif Semiconductor - All Rights Reserved.
 * Use, distribution and modification of this code is permitted under the
 * terms stated in the Alif Semiconductor Software License Agreement
 *
 * You should have received a copy of the Alif Semiconductor Software
 * License Agreement with this file. If not, please write to:
 * contact@alifsemi.com, or visit: https://alifsemi.com/license
 */

&ospi1 {
	bus-speed = <50000000>;
	status = "okay";
};
```

## src/test_ospi_boundary_tests.c
```c
/* Copyright (C) 2026 Alif Semiconductor - All Rights Reserved.
 * Use, distribution and modification of this code is permitted under the
 * terms stated in the Alif Semiconductor Software License Agreement
 *
 * You should have received a copy of the Alif Semiconductor Software
 * License Agreement with this file. If not, please write to:
 * contact@alifsemi.com, or visit: https://alifsemi.com/license
 */


#include <string.h>
#include <zephyr/device.h>
#include <zephyr/devicetree.h>
#include <zephyr/drivers/flash.h>
#include <zephyr/logging/log.h>
#include <zephyr/ztest.h>

#include "test_ospi_flash_test.h"

LOG_MODULE_REGISTER(ospi_boundary, LOG_LEVEL_INF);

/* -------- Test: cross-page boundary read/write -------- */
static void cross_page_boundary_test(void)
{
	int ret, e_count = 0;
	uint8_t w_buf[BUFF_SIZE] = {0};
	uint8_t r_buf[BUFF_SIZE] = {0};
	const size_t len = ARRAY_SIZE(w_buf);
	uint32_t cross_offset;

	LOG_INF("=== Cross-Page Boundary Test ===");

	/* Prepare test data */
	for (int i = 0; i < BUFF_SIZE; i++) {
		w_buf[i] = (i + 100) % 256;
	}

	/* This test assumes page_size >= BUFF_SIZE/2 so cross_offset
	 * stays within the erased region starting at TEST_REGION_OFFSET.
	 */
	zassert_true(flash_param->page_size >= (BUFF_SIZE / 2),
		     "page_size (%zu) too small for cross-page test",
		     flash_param->page_size);

	/* Offset that crosses a page boundary (per device page_size) */
	cross_offset = SPI_FLASH_TEST_REGION_OFFSET +
		       flash_param->page_size - (BUFF_SIZE / 2);

	/* Erase the test region sectors before the cross-page write */
	ret = flash_erase(flash_dev, SPI_FLASH_TEST_REGION_OFFSET,
			  SPI_FLASH_SECTOR_SIZE * 2);
	zassert_equal(ret, 0, "Flash erase failed [%d]", ret);

	/* Write data crossing page boundary */
	ret = flash_write(flash_dev, cross_offset, w_buf, len);
	zassert_equal(ret, 0, "Cross-page write failed [%d]", ret);

	/* Read back across page boundary */
	memset(r_buf, 0, len);
	ret = flash_read(flash_dev, cross_offset, r_buf, len);
	zassert_equal(ret, 0, "Cross-page read failed [%d]", ret);

	e_count = verify_data(w_buf, r_buf, len, "cross_page");
	zassert_equal(e_count, 0,
		     "Cross-page verify failed: %d mismatches",
		     e_count);

	LOG_INF("Cross-page boundary test PASSED");
}

/* -------- Test: address boundaries -------- */
static void address_boundary_test(void)
{
	int ret;
	uint8_t w_buf[256] = {0};
	uint8_t r_buf[256] = {0};
	const size_t len = ARRAY_SIZE(w_buf);
	uint32_t test_offsets[] = {
		SPI_FLASH_TEST_REGION_OFFSET, /* Safe region */
		SPI_FLASH_TEST_REGION_OFFSET + 0x1000,  /* 4KB offset */
		SPI_FLASH_TEST_REGION_OFFSET + 0x10000, /* 64KB offset */
		SPI_FLASH_TEST_REGION_OFFSET + 0x100000 /* 1MB offset */
	};
	size_t num_offsets = ARRAY_SIZE(test_offsets);

	LOG_INF("=== Address Boundary Test ===");

	/* Prepare test data */
	for (int i = 0; i < len; i++) {
		w_buf[i] = (i + 50) % 256;
	}

	/* Erase test region */
	ret = flash_erase(flash_dev, SPI_FLASH_TEST_REGION_OFFSET,
			  SPI_FLASH_SECTOR_SIZE * 2);
	zassert_equal(ret, 0, "Flash erase failed [%d]", ret);

	/* Test write/read at various address boundaries */
	for (size_t i = 0; i < num_offsets; i++) {
		uint32_t offset = test_offsets[i];
		int e_count;

		LOG_INF("Testing at offset 0x%x", offset);

		/* Ensure target sector is erased before write */
		ret = flash_erase(flash_dev, offset,
				  SPI_FLASH_SECTOR_SIZE);
		zassert_equal(ret, 0,
			     "Sector erase failed at 0x%x [%d]",
			     offset, ret);

		/* Write */
		ret = flash_write(flash_dev, offset,
				  w_buf, len);
		zassert_equal(ret, 0,
			     "Write failed at 0x%x [%d]",
			     offset, ret);

		/* Read */
		memset(r_buf, 0, len);
		ret = flash_read(flash_dev, offset,
				 r_buf, len);
		zassert_equal(ret, 0,
			     "Read failed at 0x%x [%d]",
			     offset, ret);

		/* Verify */
		e_count = verify_data(w_buf, r_buf, len,
				      "address_boundary");
		zassert_equal(e_count, 0,
			     "Verify failed at 0x%x: %d mismatches",
			     offset, e_count);
	}

	LOG_INF("Address boundary test PASSED");
}

/* -------- Test: boundary size operations -------- */
static void boundary_size_operations_test(void)
{
	int ret, e_count;
	uint8_t min_buf[256];
	uint8_t page_buf[4096];  /* Page size buffer */
	uint8_t r_buf[4096];
	const struct flash_parameters *params;
	size_t min_len;
	size_t page_len;
	uint32_t page_offset;

	LOG_INF("=== Boundary Size Operations Test ===");

	params = flash_get_parameters(flash_dev);
	zassert_not_null(params, "flash parameters are NULL");

	min_len = params->write_block_size;
	page_len = params->page_size;

	zassert_true(min_len > 0 && min_len <= sizeof(min_buf),
		     "Invalid/min unsupported write_block_size: %zu", min_len);
	zassert_true(page_len > 0 && page_len <= sizeof(page_buf),
		     "Invalid/unsupported page_size: %zu", page_len);
	zassert_true(page_len <= SPI_FLASH_SECTOR_SIZE,
		     "page_size (%zu) larger than sector (%d)",
		     page_len, SPI_FLASH_SECTOR_SIZE);

	/* Erase test region */
	ret = flash_erase(flash_dev, SPI_FLASH_TEST_REGION_OFFSET,
			  SPI_FLASH_SECTOR_SIZE);
	zassert_equal(ret, 0, "Erase failed [%d]", ret);

	/* Test exact minimum programmable size (write_block_size) */
	memset(min_buf, 0xAA, min_len);
	ret = flash_fill(flash_dev, 0xAA,
			 SPI_FLASH_TEST_REGION_OFFSET,
			 min_len);
	zassert_equal(ret, 0, "Minimum size fill failed [%d]", ret);

	memset(r_buf, 0, min_len);
	ret = flash_read(flash_dev, SPI_FLASH_TEST_REGION_OFFSET,
			 r_buf, min_len);
	zassert_equal(ret, 0, "Minimum size read failed [%d]", ret);

	e_count = verify_data(min_buf, r_buf, min_len,
			      "min_size");
	zassert_equal(e_count, 0,
		     "Min size verify failed: %d mismatches",
		     e_count);

	LOG_INF("Minimum write-block boundary (%zu bytes) PASSED", min_len);

	/* Test exact page-size operation near boundary */
	page_offset = SPI_FLASH_TEST_REGION_OFFSET +
		      (SPI_FLASH_SECTOR_SIZE - page_len);

	ret = flash_erase(flash_dev, SPI_FLASH_TEST_REGION_OFFSET,
			  SPI_FLASH_SECTOR_SIZE);
	zassert_equal(ret, 0, "Page sector erase failed [%d]", ret);

	memset(page_buf, 0x55, page_len);
	ret = flash_fill(flash_dev, 0x55,
			 page_offset,
			 page_len);
	zassert_equal(ret, 0, "Page size fill failed [%d]", ret);

	memset(r_buf, 0, page_len);
	ret = flash_read(flash_dev, page_offset,
			r_buf, page_len);
	zassert_equal(ret, 0, "Page size read failed [%d]", ret);

	e_count = verify_data(page_buf, r_buf, page_len,
			      "page_size");
	zassert_equal(e_count, 0,
		     "Page size verify failed: %d mismatches",
		     e_count);

	LOG_INF("Page boundary operation (%zu bytes @0x%x) PASSED",
		page_len, page_offset);
}

/* ======== Boundary Test Suite ======== */

ZTEST(test_ospi_boundary, test_ospi_address_boundaries)
{
	address_boundary_test();
}

ZTEST(test_ospi_boundary, test_ospi_cross_page_boundary)
{
	cross_page_boundary_test();
}

ZTEST(test_ospi_boundary, test_ospi_boundary_size_operations)
{
	boundary_size_operations_test();
}

/* ======== Test Suite Lifecycle Functions ======== */

static void *test_ospi_boundary_setup(void)
{
	LOG_INF("=== OSPI Boundary Test Suite Setup ===");
	ospi_flash_setup_device();
	return NULL;
}

static void test_ospi_boundary_before(void *fixture)
{
	(void)fixture;
	ospi_flash_setup_device();
}

ZTEST_SUITE(test_ospi_boundary, NULL, test_ospi_boundary_setup,
	    test_ospi_boundary_before, NULL,
	    NULL);
```

## src/test_ospi_ctrl_tests.c
```c
/* Copyright (C) 2026 Alif Semiconductor - All Rights Reserved.
 * Use, distribution and modification of this code is permitted under the
 * terms stated in the Alif Semiconductor Software License Agreement
 *
 * You should have received a copy of the Alif Semiconductor Software
 * License Agreement with this file. If not, please write to:
 * contact@alifsemi.com, or visit: https://alifsemi.com/license
 */

#include <string.h>
#include <zephyr/devicetree.h>
#include <zephyr/drivers/flash.h>
#include <zephyr/kernel.h>
#include <zephyr/logging/log.h>
#include <zephyr/ztest.h>

#include "test_ospi_flash_test.h"

LOG_MODULE_REGISTER(ospi_ctrl, LOG_LEVEL_INF);

/*
 * Controller configuration is applied at driver init from the OSPI parent
 * node (ospi0 or ospi1). Change those values with an overlay
 * (boards/ospi1_50Mhz.overlay, boards/ospi1_100Mhz.overlay, boards/ospi1_200Mhz.overlay,
 *  boards/ospi0_80Mhz.overlay) and rebuild. This
 * suite reads the compiled DT and proves the driver still serves flash_read /
 * flash_write / flash_erase. It does not poke OSPI registers.
 */
#define OSPI_CTRL_NODE      DT_PARENT(SPI_FLASH_DT_NODE)
#define OSPI_DT_BUS_SPEED   DT_PROP(OSPI_CTRL_NODE, bus_speed)
#define OSPI_DT_CORE_CLK    DT_PROP(OSPI_CTRL_NODE, clock_frequency)
#define OSPI_DT_CS_PIN      DT_PROP(OSPI_CTRL_NODE, cs_pin)
#define OSPI_DT_DDR_EDGE    DT_PROP(OSPI_CTRL_NODE, ddr_drive_edge)
#define OSPI_DT_RX_DS_DELAY DT_PROP(OSPI_CTRL_NODE, rx_ds_delay)
#define OSPI_DT_XIP_WAIT    DT_PROP(OSPI_CTRL_NODE, xip_wait_cycles)
#define OSPI_DT_BAUD2_DLY   DT_PROP(OSPI_CTRL_NODE, baud2_delay)
#define OSPI_DT_WBS         DT_PROP(SPI_FLASH_DT_NODE, write_block_size)

#define OSPI_CTRL_SCRATCH SPI_FLASH_SECTOR_12_OFFSET

static void *ospi_ctrl_setup(void)
{
	ospi_flash_setup_device();
	LOG_INF("OSPI parent %s: bus-speed %u Hz, clock-frequency %u Hz, cs-pin %u",
		flash_dev->name, OSPI_DT_BUS_SPEED, OSPI_DT_CORE_CLK, OSPI_DT_CS_PIN);
	return NULL;
}

static void ospi_ctrl_before(void *fixture)
{
	(void)fixture;

	zassert_not_null(flash_dev, "Flash device handle is NULL");
	zassert_true(device_is_ready(flash_dev), "Flash device is not ready: %s",
		     flash_dev->name);
}

static void assert_flash_readable(const char *tag)
{
	uint8_t buf[16];
	int ret;

	ret = flash_read(flash_dev, SPI_FLASH_TEST_REGION_OFFSET, buf, sizeof(buf));
	zassert_equal(ret, 0, "%s: flash_read failed [%d]", tag, ret);
}

static void assert_flash_programmable(const char *tag)
{
	uint8_t pattern[16];
	uint8_t readback[16];
	int ret;

	for (int i = 0; i < ARRAY_SIZE(pattern); i++) {
		pattern[i] = (uint8_t)(0xA0 + i);
	}

	ret = flash_erase(flash_dev, OSPI_CTRL_SCRATCH, SPI_FLASH_SECTOR_SIZE);
	zassert_equal(ret, 0, "%s: flash_erase failed [%d]", tag, ret);

	ret = flash_write(flash_dev, OSPI_CTRL_SCRATCH, pattern, sizeof(pattern));
	zassert_equal(ret, 0, "%s: flash_write failed [%d]", tag, ret);

	ret = flash_read(flash_dev, OSPI_CTRL_SCRATCH, readback, sizeof(readback));
	zassert_equal(ret, 0, "%s: flash_read failed [%d]", tag, ret);

	zassert_mem_equal(readback, pattern, sizeof(pattern),
			  "%s: programmed data does not match", tag);
}

/* -------- Test: OSPI_BusSpeed_Config -------- */
ZTEST(test_ospi_ctrl, test_ospi_bus_speed_config)
{
	/*
	 * Overlay sets bus-speed; the driver programs BAUDR = clock-frequency /
	 * bus-speed at init. Prove the compiled value is a legal even divisor
	 * and that the resulting bus still talks to the flash.
	 */
	zassert_true(OSPI_DT_BUS_SPEED > 0, "bus-speed in DT is zero");
	zassert_true(OSPI_DT_CORE_CLK >= OSPI_DT_BUS_SPEED,
		     "clock-frequency %u < bus-speed %u", OSPI_DT_CORE_CLK,
		     OSPI_DT_BUS_SPEED);
	zassert_equal(OSPI_DT_CORE_CLK % OSPI_DT_BUS_SPEED, 0,
		      "clock-frequency %u is not an integer multiple of bus-speed %u",
		      OSPI_DT_CORE_CLK, OSPI_DT_BUS_SPEED);

	assert_flash_readable("bus-speed");
	LOG_INF("overlay/DT bus-speed %u Hz (div %u) serves flash_read",
		OSPI_DT_BUS_SPEED, OSPI_DT_CORE_CLK / OSPI_DT_BUS_SPEED);
}

/* -------- Test: OSPI_DataBits_Config -------- */
ZTEST(test_ospi_ctrl, test_ospi_databits_config)
{
	const struct flash_parameters *param = flash_get_parameters(flash_dev);

	/*
	 * Frame size is not a DT property on the controller. The driver derives
	 * DFS from the flash node's write-block-size (1 -> 8, 2 -> 16, 4 -> 32).
	 * Overlay that property to change the programmed DFS.
	 */
	zassert_not_null(param, "flash_get_parameters returned NULL");
	zassert_equal(param->write_block_size, OSPI_DT_WBS,
		      "write-block-size %zu disagrees with DT %u",
		      param->write_block_size, OSPI_DT_WBS);
	zassert_true(OSPI_DT_WBS == 1 || OSPI_DT_WBS == 2 || OSPI_DT_WBS == 4,
		     "write-block-size %u is not a legal DFS source", OSPI_DT_WBS);

	assert_flash_programmable("data-bits");
	LOG_INF("write-block-size %u -> %u-bit frames, program path works",
		OSPI_DT_WBS, OSPI_DT_WBS * 8);
}

/* -------- Test: OSPI_DDR_Config -------- */
ZTEST(test_ospi_ctrl, test_ospi_ddr_config)
{
	/*
	 * Data/instruction DDR bits are not overlay properties. The board's
	 * ddr-drive-edge is, and the ISSI path always uses data-phase DDR after
	 * init. Prove the DT edge is in range and the flash still programs.
	 */
	zassert_true(OSPI_DT_DDR_EDGE <= 1, "ddr-drive-edge %u is not 0 or 1",
		     OSPI_DT_DDR_EDGE);
	assert_flash_programmable("ddr-drive-edge");
	LOG_INF("ddr-drive-edge %u from DT; flash program path works",
		OSPI_DT_DDR_EDGE);
}

/* -------- Test: OSPI_WaitCycles_Config -------- */
ZTEST(test_ospi_ctrl, test_ospi_wait_cycles_config)
{
	/* Indirect reads hard-code 16 dummy cycles; XIP uses xip-wait-cycles. */
	zassert_true(OSPI_DT_XIP_WAIT <= 31, "xip-wait-cycles %u exceeds 5-bit field",
		     OSPI_DT_XIP_WAIT);
	assert_flash_readable("xip-wait-cycles");
	LOG_INF("xip-wait-cycles %u from DT; indirect flash_read still works",
		OSPI_DT_XIP_WAIT);
}

/* -------- Test: OSPI_SlaveSelect_Config -------- */
ZTEST(test_ospi_ctrl, test_ospi_slave_select_config)
{
	zassert_true(OSPI_DT_CS_PIN <= 3, "cs-pin %u is out of SER range", OSPI_DT_CS_PIN);
	assert_flash_readable("cs-pin");
	LOG_INF("cs-pin %u from DT; flash_read asserts the select path", OSPI_DT_CS_PIN);
}

/* -------- Test: OSPI_RXSampleDelay_Config -------- */
ZTEST(test_ospi_ctrl, test_ospi_rx_sample_delay_config)
{
	/*
	 * Overlay property is rx-ds-delay (AES RXDS), not the OSPI
	 * RX_SAMPLE_DELAY register. The driver copies it at init.
	 */
	zassert_true(OSPI_DT_RX_DS_DELAY <= 255, "rx-ds-delay %u exceeds 8 bits",
		     OSPI_DT_RX_DS_DELAY);
	assert_flash_readable("rx-ds-delay");
	LOG_INF("rx-ds-delay %u from DT; flash_read works", OSPI_DT_RX_DS_DELAY);
}

/* -------- Test: OSPI_DDRDriveEdge_Config -------- */
ZTEST(test_ospi_ctrl, test_ospi_ddr_drive_edge_config)
{
	zassert_true(OSPI_DT_DDR_EDGE <= 1, "ddr-drive-edge %u is not 0 or 1",
		     OSPI_DT_DDR_EDGE);
	assert_flash_readable("ddr-drive-edge");
	LOG_INF("ddr-drive-edge %u from DT", OSPI_DT_DDR_EDGE);
}

/* -------- Test: OSPI_GetStatus_Check -------- */
ZTEST(test_ospi_ctrl, test_ospi_get_status_check)
{
	/* Idle is implied when the flash API returns without EBUSY. */
	assert_flash_readable("idle-status");
	LOG_INF("controller is idle enough for flash_read to complete");
}


/* -------- Test: OSPI_GetStatus_BusyTiming -------- */
ZTEST(test_ospi_ctrl, test_ospi_get_status_busy_timing)
{
	int64_t start, elapsed;
	int ret;

	/*
	 * flash_erase returns only after the driver has waited for the part.
	 * That is the public stand-in for polling SR.BUSY in the testcase.
	 */
	start = k_uptime_get();
	ret = flash_erase(flash_dev, OSPI_CTRL_SCRATCH, SPI_FLASH_SECTOR_SIZE);
	elapsed = k_uptime_get() - start;

	zassert_equal(ret, 0, "flash_erase failed [%d]", ret);
	zassert_true(elapsed > 0, "erase returned in under 1 ms; busy wait skipped?");
}

/* -------- Test: OSPI_CS_MinHigh_Config -------- */
ZTEST(test_ospi_ctrl, test_ospi_cs_min_high_config)
{
	/* baud2-delay is the overlay knob (0 disable, 1 enable, 2 auto). */
	zassert_true(OSPI_DT_BAUD2_DLY <= 2, "baud2-delay %u is not 0/1/2",
		     OSPI_DT_BAUD2_DLY);
	assert_flash_readable("baud2-delay");
	LOG_INF("baud2-delay %u from DT; flash_read works", OSPI_DT_BAUD2_DLY);
}

/* -------- Flash must survive all of the above -------- */
ZTEST(test_ospi_ctrl, test_ospi_ctrl_flash_still_healthy)
{
	assert_flash_readable("ctrl-suite");
	LOG_INF("flash still responds after the DT/overlay controller sweep");
}

ZTEST_SUITE(test_ospi_ctrl, NULL, ospi_ctrl_setup, ospi_ctrl_before, NULL, NULL);
```

## src/test_ospi_flash_dev_tests.c
```c
/* Copyright (C) 2026 Alif Semiconductor - All Rights Reserved.
 * Use, distribution and modification of this code is permitted under the
 * terms stated in the Alif Semiconductor Software License Agreement
 *
 * You should have received a copy of the Alif Semiconductor Software
 * License Agreement with this file. If not, please write to:
 * contact@alifsemi.com, or visit: https://alifsemi.com/license
 */

#include <string.h>
#include <zephyr/devicetree.h>
#include <zephyr/drivers/flash.h>
#include <zephyr/logging/log.h>
#include <zephyr/ztest.h>
#include <zephyr/kernel.h>
#include <flash_ospi_is25wx.h>

#include "test_ospi_flash_test.h"

LOG_MODULE_REGISTER(ospi_flashdev, LOG_LEVEL_INF);

#define FLASH_DEV_BUF 512
#define OSPI_DT_BUS_SPEED DT_PROP(DT_PARENT(SPI_FLASH_DT_NODE), bus_speed)

static void *ospi_flashdev_setup(void)
{
	ospi_flash_setup_device();
	return NULL;
}

static void ospi_flashdev_before(void *fixture)
{
	(void)fixture;

	zassert_not_null(flash_dev, "Flash device handle is NULL");
	zassert_true(device_is_ready(flash_dev), "Flash device is not ready: %s",
		     flash_dev->name);
	zassert_not_null(flash_param, "flash_get_parameters returned NULL");
}


/* -------- Test: OSPI_Flash_GetInfo_Validation -------- */
ZTEST(test_ospi_flashdev, test_ospi_flash_get_info_validation)
{
	const struct flash_parameters *param = flash_get_parameters(flash_dev);
	struct flash_pages_info page_info;
	uint32_t total;
	int ret;

	zassert_not_null(param, "flash_get_parameters returned NULL");

	zassert_equal(param->sector_size, DT_PROP(SPI_FLASH_DT_NODE, sector_size),
		      "sector_size %zu disagrees with DT", param->sector_size);
	zassert_equal(param->page_size, DT_PROP(SPI_FLASH_DT_NODE, page_size),
		      "page_size %zu disagrees with DT", param->page_size);
	zassert_equal(param->num_of_sector, DT_PROP(SPI_FLASH_DT_NODE, num_of_sector),
		      "num_of_sector %zu disagrees with DT", param->num_of_sector);
	zassert_equal(param->write_block_size, DT_PROP(SPI_FLASH_DT_NODE, write_block_size),
		      "write_block_size %zu disagrees with DT", param->write_block_size);
	zassert_equal(param->erase_value, DT_PROP(SPI_FLASH_DT_NODE, erase_value),
		      "erase_value 0x%02x disagrees with DT", param->erase_value);

	zassert_true(param->sector_size && !(param->sector_size & (param->sector_size - 1)),
		     "sector_size %zu is not a power of two", param->sector_size);
	zassert_true(param->write_block_size > 0, "write_block_size is zero");

	total = param->num_of_sector * param->sector_size;
	zassert_true(total > 0, "Total flash size computed as zero");

	ret = flash_get_page_info_by_offs(flash_dev, SPI_FLASH_TEST_REGION_OFFSET, &page_info);
	zassert_equal(ret, 0, "flash_get_page_info_by_offs failed [%d]", ret);
	zassert_equal(page_info.size, param->page_size,
		      "Page size %zu disagrees with DT page_size %zu", page_info.size,
		      param->page_size);
	zassert_equal(page_info.start_offset % param->page_size, 0,
		      "Page start 0x%lx is not page aligned",
		      (unsigned long)page_info.start_offset);

	LOG_INF("geometry: %zu sectors x %zu B = %u B, page %zu B, wbs %zu B, erase 0x%02x",
		param->num_of_sector, param->sector_size, total, param->page_size,
		param->write_block_size, param->erase_value);
}

/* -------- Test: OSPI_Flash_CrossPage_Program -------- */
ZTEST(test_ospi_flashdev, test_ospi_flash_cross_page_program)
{
	uint8_t w_buf[FLASH_DEV_BUF];
	uint8_t r_buf[FLASH_DEV_BUF];
	size_t page = flash_param->page_size;
	off_t offset;
	int ret, mismatches;

	offset = SPI_FLASH_TEST_REGION_OFFSET + page - (FLASH_DEV_BUF / 2);

	for (int i = 0; i < FLASH_DEV_BUF; i++) {
		w_buf[i] = (uint8_t)(0x40 + (i % 0x60));
	}

	ret = flash_erase(flash_dev, SPI_FLASH_TEST_REGION_OFFSET, page * 2);
	zassert_equal(ret, 0, "Erase of the two straddled pages failed [%d]", ret);

	ret = flash_write(flash_dev, offset, w_buf, FLASH_DEV_BUF);
	zassert_equal(ret, 0, "Cross-page program failed [%d]", ret);

	memset(r_buf, 0, sizeof(r_buf));
	ret = flash_read(flash_dev, offset, r_buf, FLASH_DEV_BUF);
	zassert_equal(ret, 0, "Cross-page read-back failed [%d]", ret);

	mismatches = verify_data(w_buf, r_buf, FLASH_DEV_BUF, "cross_page");
	zassert_equal(mismatches, 0, "Cross-page program lost %d bytes at the boundary",
		      mismatches);

	LOG_INF("cross-page program at 0x%lx spanning page boundary 0x%zx verified",
		(unsigned long)offset, page);
}

/* -------- Test: OSPI_Flash_Boundary_Address -------- */
ZTEST(test_ospi_flashdev, test_ospi_flash_boundary_address)
{
	uint8_t w_buf[64];
	uint8_t r_buf[64];
	uint32_t total = flash_param->num_of_sector * flash_param->sector_size;
	off_t last_sector = total - flash_param->sector_size;
	int ret, mismatches;

	for (int i = 0; i < sizeof(w_buf); i++) {
		w_buf[i] = (uint8_t)(0xC3 ^ i);
	}

	ret = flash_erase(flash_dev, last_sector, flash_param->sector_size);
	zassert_equal(ret, 0, "Erase of last sector 0x%lx failed [%d]", (unsigned long)last_sector,
		      ret);

	ret = flash_write(flash_dev, last_sector, w_buf, sizeof(w_buf));
	zassert_equal(ret, 0, "Write to last sector failed [%d]", ret);

	memset(r_buf, 0, sizeof(r_buf));
	ret = flash_read(flash_dev, last_sector, r_buf, sizeof(r_buf));
	zassert_equal(ret, 0, "Read from last sector failed [%d]", ret);

	mismatches = verify_data(w_buf, r_buf, sizeof(w_buf), "last_sector");
	zassert_equal(mismatches, 0, "Last-sector round trip lost %d bytes", mismatches);

	ret = flash_read(flash_dev, total, r_buf, sizeof(r_buf));
	zassert_not_equal(ret, 0, "Read past the end of the device unexpectedly succeeded");

	LOG_INF("last sector 0x%lx round trips; reads past 0x%x are rejected",
		(unsigned long)last_sector, total);
}

/* -------- Test: OSPI_Flash_BusyStatus_Poll -------- */
ZTEST(test_ospi_flashdev, test_ospi_flash_busy_status_poll)
{
	uint8_t buf[64];
	int64_t start, elapsed;
	int ret;

	/*
	 * flash_erase returns after the driver has polled flag-status. A
	 * successful erase that takes measurable time, then a flash_read of
	 * erase_value, is the API stand-in for SR.BUSY / RXFLR.
	 */
	start = k_uptime_get();
	ret = flash_erase(flash_dev, SPI_FLASH_TEST_REGION_OFFSET, SPI_FLASH_SECTOR_SIZE);
	elapsed = k_uptime_get() - start;

	zassert_equal(ret, 0, "Erase failed [%d]", ret);
	zassert_true(elapsed > 0, "Erase returned in under a millisecond - busy poll skipped?");


	ret = flash_read(flash_dev, SPI_FLASH_TEST_REGION_OFFSET, buf, sizeof(buf));
	zassert_equal(ret, 0, "Read straight after erase failed [%d]", ret);

	for (int i = 0; i < sizeof(buf); i++) {
		zassert_equal(buf[i], flash_param->erase_value,
			      "Byte %d not erased - busy poll returned early", i);
	}

	LOG_INF("erase took %lld ms and left the flash readable", elapsed);
}

/* -------- Test: OSPI_Flash_WriteEnableLatch -------- */
ZTEST(test_ospi_flashdev, test_ospi_flash_write_enable_latch)
{
	uint8_t pattern[32];
	uint8_t r_buf[32];
	int ret, mismatches;

	ret = flash_erase(flash_dev, SPI_FLASH_TEST_REGION_OFFSET, SPI_FLASH_SECTOR_SIZE);
	zassert_equal(ret, 0, "Erase failed [%d]", ret);

	memset(pattern, 0xF0, sizeof(pattern));
	ret = flash_write(flash_dev, SPI_FLASH_TEST_REGION_OFFSET, pattern, sizeof(pattern));
	zassert_equal(ret, 0, "First program failed - WEL not armed? [%d]", ret);

	ret = flash_read(flash_dev, SPI_FLASH_TEST_REGION_OFFSET, r_buf, sizeof(r_buf));
	zassert_equal(ret, 0, "Read-back failed [%d]", ret);
	mismatches = verify_data(pattern, r_buf, sizeof(pattern), "wel_first");
	zassert_equal(mismatches, 0, "First program did not commit (%d bytes wrong)", mismatches);

	memset(pattern, 0x0F, sizeof(pattern));
	ret = flash_write(flash_dev, SPI_FLASH_TEST_REGION_OFFSET, pattern, sizeof(pattern));
	zassert_equal(ret, 0, "Second program failed [%d]", ret);

	ret = flash_read(flash_dev, SPI_FLASH_TEST_REGION_OFFSET, r_buf, sizeof(r_buf));
	zassert_equal(ret, 0, "Second read-back failed [%d]", ret);

	for (int i = 0; i < sizeof(r_buf); i++) {
		zassert_equal(r_buf[i], 0x00,
			      "Byte %d = 0x%02x; expected 0x00 from 0xF0 AND 0x0F", i, r_buf[i]);
	}

	LOG_INF("write-enable latch armed per command; AND-only programming confirmed");
}

/* -------- Test: OSPI_Flash_OctalDDR_ReadWrite -------- */
ZTEST(test_ospi_flashdev, test_ospi_flash_octal_ddr_read_write)
{
	const struct alif_flash_ospi_dev_data *data = flash_dev->data;
	uint8_t w_buf[FLASH_DEV_BUF];
	uint8_t r_buf[FLASH_DEV_BUF];
	int ret, mismatches;

	zassert_equal(data->trans_conf.frame_format, OSPI_FRF_OCTAL,
		      "Driver transfer config is not octal (%u)", data->trans_conf.frame_format);
	zassert_true(data->trans_conf.ddr_enable, "Driver transfer config has DDR disabled");

	for (int i = 0; i < FLASH_DEV_BUF; i++) {
		w_buf[i] = (uint8_t)(i * 7 + 3);
	}

	ret = flash_erase(flash_dev, SPI_FLASH_TEST_REGION_OFFSET, SPI_FLASH_SECTOR_SIZE);
	zassert_equal(ret, 0, "Erase failed [%d]", ret);

	ret = flash_write(flash_dev, SPI_FLASH_TEST_REGION_OFFSET, w_buf, FLASH_DEV_BUF);
	zassert_equal(ret, 0, "Octal DDR write failed [%d]", ret);

	memset(r_buf, 0, sizeof(r_buf));
	ret = flash_read(flash_dev, SPI_FLASH_TEST_REGION_OFFSET, r_buf, FLASH_DEV_BUF);
	zassert_equal(ret, 0, "Octal DDR read failed [%d]", ret);

	mismatches = verify_data(w_buf, r_buf, FLASH_DEV_BUF, "octal_ddr");
	zassert_equal(mismatches, 0, "Octal DDR round trip lost %d bytes", mismatches);

	LOG_INF("octal DDR round trip of %d bytes verified at %u Hz", FLASH_DEV_BUF,
		OSPI_DT_BUS_SPEED);
}

ZTEST_SUITE(test_ospi_flashdev, NULL, ospi_flashdev_setup, ospi_flashdev_before, NULL, NULL);
```

## src/test_ospi_flash_test.h
```c
/* Copyright (C) 2026 Alif Semiconductor - All Rights Reserved.
 * Use, distribution and modification of this code is permitted under the
 * terms stated in the Alif Semiconductor Software License Agreement
 *
 * You should have received a copy of the Alif Semiconductor Software
 * License Agreement with this file. If not, please write to:
 * contact@alifsemi.com, or visit: https://alifsemi.com/license
 */


#ifndef OSPI_FLASH_TEST_H
#define OSPI_FLASH_TEST_H

#include <stddef.h>
#include <stdint.h>
#include <zephyr/device.h>
#include <zephyr/drivers/flash.h>
#include <zephyr/kernel.h>

/* Test Configuration */
#define SPI_FLASH_SECTOR_SIZE        4096
#define SPI_FLASH_TEST_REGION_OFFSET (8  * SPI_FLASH_SECTOR_SIZE)  /* 0x8000 */
#define SPI_FLASH_SECTOR_12_OFFSET   (12 * SPI_FLASH_SECTOR_SIZE)  /* 0xC000 */
#define SPI_FLASH_SECTOR_13_OFFSET   (13 * SPI_FLASH_SECTOR_SIZE)  /* 0xD000 */
#define BUFF_SIZE                    1024
#define ITER                         100

/* Device Tree Node for SPI Flash */
#define SPI_FLASH_DT_NODE            DT_ALIAS(spi_flash0)

/* Global Variables */
extern const struct flash_parameters *flash_param;
extern const struct device *flash_dev;

/* Helper Functions */
void ospi_flash_setup_device(void);
int verify_data(const uint8_t *expected, const uint8_t *actual,
		size_t len, const char *tag);

#endif /* OSPI_FLASH_TEST_H */
```

## src/test_ospi_irq_tests.c
```c
/* Copyright (C) 2026 Alif Semiconductor - All Rights Reserved.
 * Use, distribution and modification of this code is permitted under the
 * terms stated in the Alif Semiconductor Software License Agreement
 *
 * You should have received a copy of the Alif Semiconductor Software
 * License Agreement with this file. If not, please write to:
 * contact@alifsemi.com, or visit: https://alifsemi.com/license
 */

#include <zephyr/devicetree.h>
#include <zephyr/drivers/flash.h>
#include <zephyr/irq.h>
#include <zephyr/logging/log.h>
#include <zephyr/ztest.h>

#include "test_ospi_flash_test.h"

LOG_MODULE_REGISTER(ospi_irq, LOG_LEVEL_INF);

#define OSPI_CTRL_NODE DT_PARENT(SPI_FLASH_DT_NODE)

static void *ospi_irq_setup(void)
{
	ospi_flash_setup_device();
	return NULL;
}

static void ospi_irq_before(void *fixture)
{
	(void)fixture;

	zassert_not_null(flash_dev, "Flash device handle is NULL");
	zassert_true(device_is_ready(flash_dev), "Flash device is not ready: %s",
		     flash_dev->name);
}

/* -------- Test: OSPI_IRQ_Routing_PerInstance -------- */
ZTEST(test_ospi_irq, test_ospi_irq_routing_per_instance)
{
	zassert_equal(DT_NUM_IRQS(OSPI_CTRL_NODE), 1,
		      "Expected exactly one interrupt for the OSPI instance, found %d",
		      DT_NUM_IRQS(OSPI_CTRL_NODE));

	const unsigned int irqn = DT_IRQN(OSPI_CTRL_NODE);

	zassert_true(irq_is_enabled(irqn), "OSPI interrupt %u is not enabled", irqn);

	LOG_INF("OSPI instance routed to NVIC line %u at priority %u", irqn,
		DT_IRQ(OSPI_CTRL_NODE, priority));
}

/* -------- Flash must survive all of the above -------- */
ZTEST(test_ospi_irq, test_ospi_irq_flash_still_healthy)
{
	uint8_t buf[16];
	int ret;

	ret = flash_read(flash_dev, SPI_FLASH_TEST_REGION_OFFSET, buf, sizeof(buf));
	zassert_equal(ret, 0, "flash unusable after IRQ suite [%d]", ret);
	LOG_INF("flash still responds after the interrupt DT sweep");
}

ZTEST_SUITE(test_ospi_irq, NULL, ospi_irq_setup, ospi_irq_before, NULL, NULL);
```

## src/test_ospi_negative_tests.c
```c
/* Copyright (C) 2026 Alif Semiconductor - All Rights Reserved.
 * Use, distribution and modification of this code is permitted under the
 * terms stated in the Alif Semiconductor Software License Agreement
 *
 * You should have received a copy of the Alif Semiconductor Software
 * License Agreement with this file. If not, please write to:
 * contact@alifsemi.com, or visit: https://alifsemi.com/license
 */


#include <string.h>
#include <zephyr/device.h>
#include <zephyr/devicetree.h>
#include <zephyr/drivers/flash.h>
#include <zephyr/logging/log.h>
#include <zephyr/ztest.h>

#include "test_ospi_flash_test.h"

LOG_MODULE_REGISTER(ospi_negative, LOG_LEVEL_INF);

/* -------- Test: write without erase (negative scenario) -------- */
static void write_without_erase_test(void)
{
	int ret;
	uint8_t w_buf[BUFF_SIZE] = {0};
	uint8_t before_buf[BUFF_SIZE] = {0};
	uint8_t r_buf[BUFF_SIZE] = {0};
	const size_t len = ARRAY_SIZE(w_buf);
	int e_count = 0;
	int changed_bytes = 0;
	int programmable_bytes = 0;

	LOG_INF("=== Write Without Erase Test ===");
	LOG_INF("Read-before, write-without-erase, read-after validation");

	/* Prepare test data */
	for (int i = 0; i < BUFF_SIZE; i++) {
		w_buf[i] = (i + 200) % 256;
	}

	/* Read current content before writing */
	ret = flash_read(flash_dev, SPI_FLASH_TEST_REGION_OFFSET,
			 before_buf, len);
	zassert_equal(ret, 0, "Initial read failed [%d]", ret);

	/* Write to flash without erasing first */
	ret = flash_write(flash_dev, SPI_FLASH_TEST_REGION_OFFSET, w_buf, len);
	zassert_equal(ret, 0, "Write failed [%d]", ret);

	/* Read back */
	memset(r_buf, 0, len);
	ret = flash_read(flash_dev, SPI_FLASH_TEST_REGION_OFFSET, r_buf, len);
	zassert_equal(ret, 0, "Read failed [%d]", ret);

	/* NOR behavior check without erase:
	 * resulting byte must be (before & requested).
	 */
	for (size_t i = 0; i < len; i++) {
		uint8_t expected = before_buf[i] & w_buf[i];

		if (expected != before_buf[i]) {
			programmable_bytes++;
		}

		if (r_buf[i] != before_buf[i]) {
			changed_bytes++;
		}

		if (r_buf[i] != expected) {
			e_count++;
			if (e_count <= 5) {
				LOG_INF("Mismatch[%zu]: b=0x%02x req=0x%02x e=0x%02x g=0x%02x",
					i, before_buf[i], w_buf[i], expected,
					r_buf[i]);
			}
		}
	}

	zassert_equal(e_count, 0,
		     "Write-without-erase violated NOR behavior: %d mismatches",
		     e_count);

	/* If 1->0 programming is possible, data should change. */
	if (programmable_bytes > 0) {
		zassert_true(changed_bytes > 0,
			     "Expected changed data after write without erase");
	}

	LOG_INF("Before/After changed bytes: %d", changed_bytes);
	LOG_INF("Programmable bytes in request: %d", programmable_bytes);

	LOG_INF("Write without erase test completed");
}

/* -------- Test: invalid parameters -------- */
static void invalid_parameter_test(void)
{
	int ret;
	uint8_t buf[BUFF_SIZE] = {0};

	LOG_INF("=== Invalid Parameter Test ===");

	/* Validate setup */
	zassert_not_null(flash_param, "flash_param is NULL");
	zassert_not_null(flash_dev, "flash_dev is NULL");

	/* Test 1: Invalid offset (beyond flash size) */
	ret = flash_read(flash_dev,
			 flash_param->num_of_sector *
			 flash_param->sector_size + 1,
			 buf, BUFF_SIZE);
	zassert_not_equal(ret, 0, "Should fail with invalid offset");

	LOG_INF("Invalid offset test passed");

	/* Test 2: Zero length */
	ret = flash_read(flash_dev, SPI_FLASH_TEST_REGION_OFFSET, buf, 0);
	/* Zero length may or may not be valid depending on implementation */
	LOG_INF("Zero length test completed (ret=%d)", ret);

	/* Test 3: Request crosses end of flash without exceeding buf size */
	size_t flash_size = flash_param->num_of_sector *
			    flash_param->sector_size;
	ret = flash_read(flash_dev, flash_size - BUFF_SIZE + 1,
			 buf, BUFF_SIZE);
	zassert_not_equal(ret, 0,
			  "Should fail when offset + length exceeds flash size");

	LOG_INF("Invalid length test passed");

	LOG_INF("Invalid parameter test PASSED");
}

/* -------- Helper: verify unaligned read buffer -------- */
static int verify_unaligned_read(const uint8_t *r_buf,
				 const uint8_t *w_buf,
				 uint32_t offset_delta,
				 uint32_t unaligned_offset,
				 size_t read_len)
{
	int e_count = 0;

	for (size_t j = 0; j < read_len; j++) {
		uint8_t expected = w_buf[j + offset_delta];

		if (r_buf[j] == expected) {
			continue;
		}
		e_count++;
		if (e_count <= 5) {
			LOG_INF("Mismatch 0x%x: exp 0x%02x got 0x%02x",
				(unsigned int)(unaligned_offset + j),
				expected, r_buf[j]);
		}
	}
	return e_count;
}

/* -------- Test: unaligned address read/write -------- */
static void unaligned_address_test(void)
{
	int ret, i, e_count = 0;
	uint8_t w_buf[BUFF_SIZE] = {0};
	uint8_t r_buf[BUFF_SIZE] = {0};
	const size_t len = ARRAY_SIZE(w_buf);
	uint32_t aligned_offset;
	uint32_t unaligned_offsets[] = {
		1, 3, 7, 15, 31, 63, 127, 255
	};
	size_t num_unaligned_tests = ARRAY_SIZE(unaligned_offsets);
	const struct flash_parameters *params;

	LOG_INF("=== OSPI Unaligned Address Read/Write ===");

	/* Validate setup */
	zassert_not_null(flash_dev, "flash_dev is NULL");

	params = flash_get_parameters(flash_dev);
	zassert_not_null(params, "flash parameters are NULL");

	/* Prepare test data */
	for (i = 0; i < BUFF_SIZE; i++) {
		w_buf[i] = (i + 100) % 256;
	}

	/* Use an aligned base offset */
	aligned_offset = SPI_FLASH_SECTOR_SIZE * 10; /* Use sector 10 as base */

	/* Erase the test region */
	ret = flash_erase(flash_dev, aligned_offset, SPI_FLASH_SECTOR_SIZE);
	zassert_equal(ret, 0,
		     "Flash erase failed for unaligned [%d]", ret);

	/* Write aligned data first */
	ret = flash_write(flash_dev, aligned_offset, w_buf, len);
	zassert_equal(ret, 0,
		     "Flash write failed for unaligned [%d]", ret);

	/* Test reading from various unaligned offsets */
	for (i = 0; i < num_unaligned_tests; i++) {
		uint32_t unaligned_offset;
		size_t read_len = len - unaligned_offsets[i];

		unaligned_offset = aligned_offset + unaligned_offsets[i];

		if (read_len > 0) {
			memset(r_buf, 0, len);

			LOG_INF("Testing unaligned read 0x%x (+%d)",
				unaligned_offset, unaligned_offsets[i]);

			ret = flash_read(flash_dev, unaligned_offset,
					 r_buf, read_len);

			/* Alif OSPI driver does not support unaligned
			 * addresses. Should fail with -EINVAL.
			 */
			if (ret == -EINVAL) {
				LOG_INF("Unaligned read rejected at 0x%x",
					unaligned_offset);
				continue;
			}

			/* If unaligned read succeeded, verify data */
			if (ret == 0) {
				LOG_INF("Unaligned read OK at 0x%x",
					unaligned_offset);

				/* Verify data matches expected pattern */
				e_count = verify_unaligned_read(
					r_buf, w_buf,
					unaligned_offsets[i],
					unaligned_offset,
					read_len);

				if (e_count == 0) {
					LOG_INF("Unaligned read verified +%d",
						unaligned_offsets[i]);
				}
			} else {
				/* Unexpected error */
				zassert_equal(ret, 0,
					     "Unexpected err at 0x%x [%d]",
					     unaligned_offset, ret);
			}
		}
	}

	/* Test writing to unaligned addresses if supported */
	LOG_INF("Testing unaligned write operations");

	/* Erase a sector for unaligned write tests */
	ret = flash_erase(flash_dev, aligned_offset + SPI_FLASH_SECTOR_SIZE,
			  SPI_FLASH_SECTOR_SIZE);
	zassert_equal(ret, 0,
		     "Erase for unaligned write failed [%d]",
		     ret);

	for (i = 0; i < 3; i++) { /* Test a few unaligned write offsets */
		uint32_t unaligned_write_offset;
		const uint8_t *write_buf;

		unaligned_write_offset = aligned_offset +
			SPI_FLASH_SECTOR_SIZE + (i + 1) * 3;
		uint8_t test_pattern[] = {0xAA, 0x55, 0xFF, 0x00, 0x33, 0xCC};
		uint8_t fallback_pattern[64];
		size_t pattern_len = ARRAY_SIZE(test_pattern);
		uint8_t read_back[sizeof(fallback_pattern)];

		write_buf = test_pattern;

		/* Align pattern_len to write_block_size */
		flash_param = flash_get_parameters(flash_dev);
		if (flash_param->write_block_size > 1) {
			size_t wb = flash_param->write_block_size;

			pattern_len = (pattern_len / wb) * wb;
		}

		if (pattern_len == 0U) {
			size_t wb = flash_param->write_block_size;
			size_t pattern_sz = ARRAY_SIZE(test_pattern);

			if (wb > sizeof(fallback_pattern)) {
				LOG_INF("Skip unaligned write 0x%x: wb %zu > fb %zu",
					unaligned_write_offset, wb,
					sizeof(fallback_pattern));
				continue;
			}

			for (size_t j = 0; j < wb; j++) {
				fallback_pattern[j] = test_pattern[j % pattern_sz];
			}

			write_buf = fallback_pattern;
			pattern_len = wb;
			LOG_INF("Using fallback pattern (%zu bytes) at 0x%x",
				pattern_len, unaligned_write_offset);
		}

		memset(read_back, 0, pattern_len);

		LOG_INF("Testing unaligned write to offset 0x%x (%zu bytes)",
			unaligned_write_offset, pattern_len);

		ret = flash_write(flash_dev, unaligned_write_offset,
				  write_buf, pattern_len);

		/* Alif OSPI driver does not support unaligned
		 * addresses. Should fail with -EINVAL.
		 */
		if (ret == -EINVAL) {
			LOG_INF("Unaligned write rejected at 0x%x",
				unaligned_write_offset);
		} else if (ret == 0) {
			/* If unaligned write succeeded, verify it */
			LOG_INF("Unaligned write OK at 0x%x",
				unaligned_write_offset);

			/* Read back and verify */
			ret = flash_read(flash_dev,
					 unaligned_write_offset,
					 read_back, pattern_len);
			zassert_equal(ret, 0,
				     "Read failed after unaligned write [%d]",
				     ret);

			e_count = 0;
			for (size_t j = 0; j < pattern_len; j++) {
				if (read_back[j] != write_buf[j]) {
					e_count++;
				}
			}

			if (e_count == 0) {
				LOG_INF("Unaligned write passed at 0x%x",
					unaligned_write_offset);
			} else {
				LOG_INF("Unaligned write fail 0x%x: %d err",
					unaligned_write_offset, e_count);
			}
		} else {
			/* Unexpected error */
			zassert_equal(ret, 0,
				     "Unexpected err at write 0x%x [%d]",
				     unaligned_write_offset, ret);
		}
	}

	LOG_INF("Unaligned address test PASSED");
}

/* ======== Negative Test Suite ======== */

ZTEST(test_ospi_negative, test_ospi_write_without_erase)
{
	write_without_erase_test();
}

ZTEST(test_ospi_negative, test_ospi_invalid_parameters)
{
	invalid_parameter_test();
}

ZTEST(test_ospi_negative, test_ospi_unaligned_address)
{
	unaligned_address_test();
}

/* ======== Test Suite Lifecycle Functions ======== */

static void *test_ospi_negative_setup(void)
{
	LOG_INF("=== OSPI Negative Test Suite Setup ===");
	ospi_flash_setup_device();
	return NULL;
}

static void test_ospi_negative_before(void *fixture)
{
	(void)fixture;
	ospi_flash_setup_device();
}

ZTEST_SUITE(test_ospi_negative, NULL, test_ospi_negative_setup,
	    test_ospi_negative_before, NULL,
	    NULL);
```

## src/test_ospi_xip_tests.c
```c
/* Copyright (C) 2026 Alif Semiconductor - All Rights Reserved.
 * Use, distribution and modification of this code is permitted under the
 * terms stated in the Alif Semiconductor Software License Agreement
 *
 * You should have received a copy of the Alif Semiconductor Software
 * License Agreement with this file. If not, please write to:
 * contact@alifsemi.com, or visit: https://alifsemi.com/license
 */


#include <string.h>
#include <zephyr/device.h>
#include <zephyr/devicetree.h>
#include <zephyr/drivers/flash.h>
#include <zephyr/logging/log.h>
#include <zephyr/ztest.h>

#include "test_ospi_flash_test.h"

LOG_MODULE_REGISTER(ospi_xip, LOG_LEVEL_INF);

const struct flash_parameters *flash_param;
const struct device *flash_dev;

void ospi_flash_setup_device(void)
{
	flash_dev = DEVICE_DT_GET(SPI_FLASH_DT_NODE);
	zassert_not_null(flash_dev, "Flash device handle is NULL");
	zassert_true(device_is_ready(flash_dev),
		     "Flash device is not ready: %s", flash_dev->name);
	flash_param = flash_get_parameters(flash_dev);
	zassert_not_null(flash_param, "Failed to get flash parameters");
}

/* -------- Test: XIP mode -------- */
static void xip_test(const struct device *dev)
{
	uint32_t i;
	uint32_t xip_r[64] = { 0 }, fls_r[64] = { 0 }, cnt;
	uint32_t *ptr = (uint32_t *)(DT_REG_ADDR_BY_NAME(
			DT_PARENT(DT_ALIAS(spi_flash0)), xip) +
			SPI_FLASH_TEST_REGION_OFFSET);
	int32_t rc, e_count = 0;

	LOG_INF("XiP Read");

	memcpy(xip_r, ptr, sizeof(xip_r));
	LOG_INF("Content Read from OSPI Flash in XiP Mode");

	cnt = ARRAY_SIZE(xip_r);
	LOG_INF("Read from Flash cmd while XiP Mode turned on");

	rc = flash_read(dev, SPI_FLASH_TEST_REGION_OFFSET, fls_r,
			cnt * sizeof(uint32_t));
	zassert_equal(rc, 0, "Flash read failed! %d\n", rc);

	for (i = 0; i < cnt; i++) {
		if (fls_r[i] != xip_r[i]) {
			e_count++;
		}
	}

	zassert_true(!e_count,
		     "XiP Test Failed! Err Count [%d]",
		     e_count);
	LOG_INF("XiP read test PASSED");
}

/* ======== XIP Test Suite ======== */

ZTEST(test_ospi_xip, test_ospi_xip_mode)
{
	xip_test(flash_dev);
}

/* ======== Test Suite Lifecycle Functions ======== */

static void *test_ospi_xip_setup(void)
{
	LOG_INF("=== OSPI XIP Test Suite Setup ===");
	ospi_flash_setup_device();
	return NULL;
}

static void test_ospi_xip_before(void *fixture)
{
	(void)fixture;
	zassert_not_null(flash_dev, "Flash device handle is NULL");
	zassert_true(device_is_ready(flash_dev),
		     "Flash device is not ready: %s", flash_dev->name);
}

ZTEST_SUITE(test_ospi_xip, NULL, test_ospi_xip_setup, test_ospi_xip_before,
	    NULL, NULL);
```
