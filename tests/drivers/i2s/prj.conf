## CMakeLists.txt
```
# Copyright (C) 2026 Alif Semiconductor - All Rights Reserved.
# Use, distribution and modification of this code is permitted under the
# terms stated in the Alif Semiconductor Software License Agreement
#
# You should have received a copy of the Alif Semiconductor Software
# License Agreement with this file. If not, please write to:
# contact@alifsemi.com, or visit: https://alifsemi.com/license

cmake_minimum_required(VERSION 3.20.0)

find_package(Zephyr REQUIRED HINTS $ENV{ZEPHYR_BASE})
project(i2s_alif)

# Common sources (always included)
target_sources(app PRIVATE
    src/common/i2s_test_common.c
)

# Golden vectors: needed for loopback and golden-vector test builds
if(CONFIG_I2S_LOOPBACK OR CONFIG_I2S_GOLDEN_TESTS OR CONFIG_I2S_NEGATIVE_TESTS)
    target_sources(app PRIVATE
        src/common/i2s_golden_vectors.c
    )
endif()

target_include_directories(app PRIVATE src/common src/negative)

# Set when any functional-only flag is active — used to gate non-functional suites
set(I2S_FUNCTIONAL FALSE)
if(CONFIG_I2S_FUNCTIONAL_TESTS)
    if(CONFIG_I2S_FEATURES OR CONFIG_I2S_LOOPBACK OR
       CONFIG_I2S_PLAY_HELLO OR CONFIG_I2S_PLAY_HELLO_CODEC OR
       CONFIG_I2S_FULL_DUPLEX)
        set(I2S_FUNCTIONAL TRUE)
    endif()
endif()

# Functional tests
if(CONFIG_I2S_FUNCTIONAL_TESTS)
    if(CONFIG_I2S_FEATURES)
        # Only the i2s_features ZTEST_SUITE. The i2s_alif_functional
        # (lb_matrix_*) and i2s_functional (PlayHello) suites are
        # excluded by not compiling their translation units.
        target_sources(app PRIVATE
            src/functional/test_i2s_features.c
        )
    elseif(CONFIG_I2S_LOOPBACK)
        # Only the i2s_alif_functional ZTEST_SUITE (test_lb_matrix_*).
        # The i2s_features and i2s_functional suites are excluded by
        # not compiling their translation units.
        target_sources(app PRIVATE
            src/functional/test_i2s_loopback.c
        )
    elseif(CONFIG_I2S_PLAY_HELLO OR CONFIG_I2S_PLAY_HELLO_CODEC)
        # Only the i2s_functional ZTEST_SUITE (test_i2s_playback.c).
        # The i2s_alif_functional (lb_matrix_*) and i2s_features suites
        # are excluded by not compiling their translation units.
        # Non-functional suites (golden, negative, config) are unaffected
        # and still controlled by their own master switches below.
        target_sources(app PRIVATE
            src/functional/test_i2s_playback.c
        )
    elseif(CONFIG_I2S_FULL_DUPLEX)
        # Only test_full_duplex_same_device. Compiling test_i2s_features.c
        # with CONFIG_I2S_FULL_DUPLEX set #ifndef-excludes the matrix tests,
        # leaving only the full-duplex test. The i2s_alif_functional
        # (lb_matrix_*) and i2s_functional (PlayHello) suites are excluded
        # by not compiling their translation units.
        target_sources(app PRIVATE
            src/functional/test_i2s_features.c
        )
    else()
        target_sources(app PRIVATE
            src/functional/test_i2s_loopback.c
            src/functional/test_i2s_features.c
            src/functional/test_i2s_playback.c
        )
    endif()
endif()

# Golden vector tests — excluded when any functional-only config is active
if(CONFIG_I2S_GOLDEN_TESTS AND NOT I2S_FUNCTIONAL)
    target_sources(app PRIVATE
        src/golden/test_i2s_golden_tx.c
    )
endif()

# Negative tests — excluded when any functional-only config is active
if(CONFIG_I2S_NEGATIVE_TESTS AND NOT I2S_FUNCTIONAL)
        target_sources(app PRIVATE
            src/negative/test_i2s_negative.c
        )
endif()

if(CONFIG_I2S_STRESS_TESTS AND NOT I2S_FUNCTIONAL)
    target_sources(app PRIVATE
        src/stress/test_i2s_stress.c
    )
endif()

if(CONFIG_I2S_PERF_TESTS AND NOT I2S_FUNCTIONAL)
    target_sources(app PRIVATE
        src/performance/test_i2s_performance.c
    )
endif()

# Configuration tests — excluded when any functional-only config is active
if(CONFIG_I2S_CONFIG_TESTS AND NOT I2S_FUNCTIONAL)
    if(EXISTS ${CMAKE_CURRENT_SOURCE_DIR}/src/config/test_i2s_config.c)
        target_sources(app PRIVATE src/config/test_i2s_config.c)
    endif()
endif()
```

## Kconfig
```
# Copyright (C)  Alif Semiconductor - All Rights Reserved.
# Use, distribution and modification of this code is permitted under the
# terms stated in the Alif Semiconductor Software License Agreement
#
# You should have received a copy of the Alif Semiconductor Software
# License Agreement with this file. If not, please write to:
# contact@alifsemi.com, or visit: https://alifsemi.com/license

# Main test category switches
config I2S_FUNCTIONAL_TESTS
	bool "Enable functional I2S tests"
	default y
	help
	  Enable functional I2S tests including loopback, features, and playback tests.
	  Includes comprehensive loopback matrix testing and audio playback validation.

config I2S_GOLDEN_TESTS
	bool "Enable golden vector tests"
	default y
	help
	  Enable golden vector tests with pre-computed test patterns for
	  comprehensive I2S validation across multiple sample rates and bit depths.

config I2S_LOOPBACK_VERIFY
	bool "Verify RX data against golden vectors in golden TX tests"
	depends on I2S_GOLDEN_TESTS && I2S_GPIO_LOOPBACK
	default n
	help
	  When enabled, i2s_golden_run() also configures RX and verifies that
	  received data matches the transmitted golden vectors bit-exactly.

	  Requires an external wire from the I2S SDO output to the I2S SDI
	  input on the target board. The exact pin pair depends on the board
	  and overlay (see README.rst and the boards/ overlays).

	  The snps,designware-i2s driver does not support I2S_OPT_LOOPBACK,
	  so a physical wire is mandatory.

config I2S_NEGATIVE_TESTS
	bool "Enable negative tests"
	default y
	help
	  Build the i2s_negative suite: state machine, underrun, overrun,
	  queue limits, and full-duplex mismatch. On LPI2S (i2s4) the
	  cases are named test_lpi2s_*. On I2S2 and I2S3 they are named
	  test_i2s_*. The TX half of neg_stop_and_drain runs only when
	  I2S_GPIO_LOOPBACK is y. Dropped when a functional selector is
	  set.

config I2S_STRESS_TESTS
	bool "Enable I2S stress tests"
	default n
	help
	  Build the i2s_stress suite: repeated start/drop, start/stop,
	  and start/drain, underrun and overrun recovery, a 30 s
	  192 kHz transmit, queue fill/drain, and a 10 s full-duplex
	  run. Full duplex skips unless I2S_GPIO_LOOPBACK is y. Off by
	  default because the suite takes about a minute. Dropped when
	  a functional selector is set.

config I2S_PERF_TESTS
	bool "Enable I2S performance tests"
	default n
	help
	  Build the i2s_performance suite: block period, throughput,
	  datasheet rates at 16-bit and 32-bit, startup latency, and
	  underrun margin. Startup latency skips unless
	  I2S_GPIO_LOOPBACK is y. Off by default because each rate is
	  held for one second. Dropped when a functional selector is
	  set.

config I2S_CONFIG_TESTS
	bool "Enable configuration tests"
	default y
	help
	  Enable configuration tests to validate I2S driver configuration
	  options and parameter handling.

# Functional test granular controls
config I2S_GPIO_LOOPBACK
	bool "Physical GPIO wire loopback between I2S SDO and SDI present"
	default n
	help
	  Master switch indicating that an external wire connects the I2S
	  SDO output to the I2S SDI input on the target board, enabling
	  hardware loopback tests.

	  The exact pinout depends on the board and the device-tree overlay
	  selected at build time (for example: P9_3 -> P9_0 on the AE7/AE8
	  development kits, P0_5 -> P0_4 on B1, etc.). Refer to README.rst
	  and the per-board overlays under boards/ for the wiring required
	  by your target. When this switch is set all loopback bit-depth
	  tests (12/16/20/24/32-bit) run unconditionally.

# Hardware capability flags
config I2S_SLAVE_MODE_SUPPORTED
	bool "I2S controller supports clock-slave configuration"
	default n
	help
	  Set to y only if the I2S hardware can be configured with
	  I2S_OPT_BIT_CLK_SLAVE / I2S_OPT_FRAME_CLK_SLAVE (i.e. BCLK and
	  WS are accepted as inputs from an external master).

	  When disabled (default), tests that require a clock-slave RX
	  port — specifically test_mic_rx_to_tx_bit_exact_forwarding and
	  test_mic_rx_to_tx_bit_exact_matrix — will skip explicitly
	  instead of silently timing out with -EAGAIN.

# Feature test controls
config I2S_PLAY_HELLO
	bool "Enable TX-only hello_samples_24bit_48khz playback test"
	depends on I2S_FUNCTIONAL_TESTS
	default n
	help
	  Enable test_PlayHelloSamples48k_TxOnly_10s.  Only test_i2s_playback.c
	  is compiled for the functional suite; golden, negative, and config
	  suites still compile and run as controlled by their own master switches.

config I2S_PLAY_HELLO_CODEC
	bool "Enable codec-backed hello_samples_24bit_48khz playback test"
	depends on I2S_FUNCTIONAL_TESTS
	select I2C
	select WM8904
	default n
	help
	  Enable test_PlayHelloSamples48k_Codec_10s.  Only test_i2s_playback.c
	  is compiled for the functional suite; golden, negative, and config
	  suites still compile and run as controlled by their own master switches.
	  Requires an i2s-codec snippet overlay (provides audio_codec DT node
	  and i2s-codec-tx alias) and a WM8904 codec wired to the board's I2C1
	  bus.  The codec is configured for playback at 48 kHz / 24-bit stereo
	  before I2S TX is started.

# Functional suite selectors — each compiles only the named suite
config I2S_LOOPBACK
	bool "Run only GPIO wire loopback tests"
	depends on I2S_FUNCTIONAL_TESTS
	default n
	help
	  When enabled, only the loopback test suite executes. All other
	  test suites are suppressed via CMakeLists.txt source exclusion.

	  Requires an external wire from the I2S SDO output to the I2S SDI
	  input on the target board. The exact pin pair depends on the board
	  and overlay (see README.rst and the boards/ overlays).

config I2S_FEATURES
	bool "Run only the i2s_features ZTEST suite"
	depends on I2S_FUNCTIONAL_TESTS
	default n
	help
	  When enabled, compile and run only the i2s_features ZTEST_SUITE
	  (src/functional/test_i2s_features.c). The i2s_alif_functional
	  suite (lb_matrix_*, src/functional/test_i2s_loopback.c) and the
	  i2s_functional suite (PlayHello, src/functional/test_i2s_playback.c)
	  are excluded at the CMakeLists level (their translation units are
	  not compiled).

config I2S_FULL_DUPLEX
	bool "Run only test_full_duplex_same_device"
	depends on I2S_FUNCTIONAL_TESTS
	default n
	help
	  When enabled, only test_full_duplex_same_device from functional tests
	  is compiled into the image. All other tests are excluded.

source "Kconfig.zephyr"
```

## prj.conf
```kconfig
CONFIG_ZTEST=y
CONFIG_I2S=y
CONFIG_LOG=y
CONFIG_HEAP_MEM_POOL_SIZE=81920
```

## src/main.c
```c
/* Copyright Alif Semiconductor - All Rights Reserved.
 * Use, distribution and modification of this code is permitted under the
 * terms stated in the Alif Semiconductor Software License Agreement
 *
 * You should have received a copy of the Alif Semiconductor Software
 * License Agreement with this file. If not, please write to:
 * contact@alifsemi.com, or visit: https://alifsemi.com/license
 */


#include <zephyr/ztest.h>

int main(void)
{
	ztest_run_all(NULL, false, 1, 1);
	return 0;
}
```
