/* Copyright (C) 2025 Alif Semiconductor - All Rights Reserved.
 * Use, distribution and modification of this code is permitted under the
 * terms stated in the Alif Semiconductor Software License Agreement
 *
 * You should have received a copy of the Alif Semiconductor Software
 * License Agreement with this file. If not, please write to:
 * contact@alifsemi.com, or visit: https://alifsemi.com/license
 */

/* DMA overlay for SPI1/SPI0.  Stack with boards/spi.overlay.
 * SPI instances are shared peripherals, use dma0 for both HP and HE.
 */
#include "board_common.overlay"

&SPI_DMA {
	status = "okay";
};

&spi1 {
	dmas = <&SPI_DMA 0 21>, <&SPI_DMA 1 17>;
	dma-names = "txdma", "rxdma";
};

&spi0 {
	dmas = <&SPI_DMA 2 20>, <&SPI_DMA 3 16>;
	dma-names = "txdma", "rxdma";
};
