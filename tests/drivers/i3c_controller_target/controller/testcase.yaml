## tests/drivers/i3c_controller_target/controller/testcase.yaml
```yaml
common:
  tags:
    - drivers
    - i3c
    - controller
  extra_conf_files:
    - prj.conf

tests:
  drivers.i3c.controller.e7:
    platform_allow:
      - alif_e7_dk/ae722f80f55d5xx/rtss_he
      - alif_e7_dk/ae722f80f55d5xx/rtss_hp
    extra_dtc_overlay_files:
      - boards/alif_e7_i3c.overlay
    extra_configs:
      - CONFIG_I3C_TEST_CONTROLLER=y
    integration_platforms:
      - alif_e7_dk/ae722f80f55d5xx/rtss_he

  drivers.i3c.controller.e8:
    platform_allow:
      - alif_e8_dk/ae822fa0e5597xx0/rtss_he
      - alif_e8_dk/ae822fa0e5597xx0/rtss_hp
    extra_dtc_overlay_files:
      - boards/alif_e8_i3c.overlay
    extra_configs:
      - CONFIG_I3C_TEST_CONTROLLER=y

  drivers.i3c.controller.b1:
    platform_allow:
      - alif_b1_dk/ab1c1f4m51820hh0/rtss_he
    extra_dtc_overlay_files:
      - boards/alif_b1_i3c.overlay
    extra_configs:
      - CONFIG_I3C_TEST_CONTROLLER=y

  drivers.i3c.controller.e1c:
    platform_allow:
      - alif_e1c_dk/ae1c1f4051920hh/rtss_he
    extra_dtc_overlay_files:
      - boards/alif_e1c_i3c.overlay
    extra_configs:
      - CONFIG_I3C_TEST_CONTROLLER=y

  drivers.i3c.controller.lpi3c:
    platform_allow:
      - alif_e8_dk/ae822fa0e5597xx0/rtss_he
      - alif_e8_dk/ae822fa0e5597xx0/rtss_hp
    extra_dtc_overlay_files:
      - boards/alif_e8_lpi3c.overlay
    extra_configs:
      - CONFIG_I3C_TEST_CONTROLLER=y
    integration_platforms:
      - alif_e8_dk/ae822fa0e5597xx0/rtss_he
```

## tests/drivers/i3c_controller_target/target/testcase.yaml
```yaml
common:
  tags:
    - drivers
    - i3c
    - target
  extra_conf_files:
    - prj.conf
  build_only: true
  platform_allow:
    - alif_e1c_dk/ae1c1f4051920hh/rtss_he
    - alif_b1_dk/ab1c1f4m51820hh0/rtss_he

tests:
  drivers.i3c.target.e7:
    platform_allow:
      - alif_e7_dk/ae722f80f55d5xx/rtss_he
      - alif_e7_dk/ae722f80f55d5xx/rtss_hp
    extra_dtc_overlay_files:
      - boards/alif_e7_i3c.overlay
    extra_configs:
      - CONFIG_I3C_TEST_TARGET=y
    integration_platforms:
      - alif_e8_dk/ae822fa0e5597xx0/rtss_hp

  drivers.i3c.target.e8:
    platform_allow:
      - alif_e7_dk/ae722f80f55d5xx/rtss_he
      - alif_e7_dk/ae722f80f55d5xx/rtss_hp
    extra_dtc_overlay_files:
      - boards/alif_e8_i3c.overlay
    extra_configs:
      - CONFIG_I3C_TEST_TARGET=y
    integration_platforms:
      - alif_e8_dk/ae822fa0e5597xx0/rtss_he

  drivers.i3c.target.b1:
    platform_allow:
      - alif_b1_dk/ab1c1f4m51820hh0/rtss_he
    extra_dtc_overlay_files:
      - boards/alif_b1_i3c.overlay
    extra_configs:
      - CONFIG_I3C_TEST_TARGET=y

  drivers.i3c.target.e1c:
    platform_allow:
      - alif_e1c_dk/ae1c1f4051920hh/rtss_he
    extra_dtc_overlay_files:
      - boards/alif_e1c_i3c.overlay
    extra_configs:
      - CONFIG_I3C_TEST_TARGET=y

  drivers.i3c.target.lpi3c:
    platform_allow:
      - alif_e8_dk/ae822fa0e5597xx0/rtss_he
      - alif_e8_dk/ae822fa0e5597xx0/rtss_hp
    extra_dtc_overlay_files:
      - boards/alif_e8_lpi3c.overlay
    extra_configs:
      - CONFIG_I3C_TEST_TARGET=y
    integration_platforms:
      - alif_e8_dk/ae822fa0e5597xx0/rtss_he
```

## tests/drivers/mram/Kconfig
```kconfig
menu "MRAM Test Selection"

choice
	prompt "Select MRAM test type"
	default ALIF_MRAM_CORE
	help
	  Selects which ztest sources CMake compiles.
	  Driven by snippets / testcase.yaml; do not enable both.

config ALIF_MRAM_CORE
	bool "Core tests (functional + performance + stress)"

config ALIF_MRAM_FILESYSTEM
	bool "Filesystem test"

endchoice

endmenu

source "Kconfig.zephyr"
```

## tests/drivers/mram/testcase.yaml
```yaml
tests:
  drivers.flash.mram.core:
    description: "MRAM flash driver core tests (functional, performance, stress)"
    tags:
      - drivers
      - flash
      - mram
      - functional
      - performance
      - stress
    harness: ztest
    timeout: 900
    required_snippets:
      - alif-mram
    platform_allow:
      - alif_b1_dk/ab1c1f4m51820ph0/rtss_he
      - alif_e7_dk/ae722f80f55d5xx/rtss_he
      - alif_e7_dk/ae722f80f55d5xx/rtss_hp
      - alif_e8_dk/ae822fa0e5597xx0/rtss_he
      - alif_e8_dk/ae822fa0e5597xx0/rtss_hp
    integration_platforms:
      - alif_b1_dk/ab1c1f4m51820ph0/rtss_he
      - alif_e7_dk/ae722f80f55d5xx/rtss_he
      - alif_e7_dk/ae722f80f55d5xx/rtss_hp
      - alif_e8_dk/ae822fa0e5597xx0/rtss_he
      - alif_e8_dk/ae822fa0e5597xx0/rtss_hp

  drivers.flash.mram.fs:
    description: "MRAM filesystem (LittleFS) tests"
    tags:
      - drivers
      - flash
      - mram
      - filesystem
      - littlefs
    harness: ztest
    timeout: 900
    required_snippets:
      - alif-mram-filesystem
    platform_allow:
      - alif_b1_dk/ab1c1f4m51820ph0/rtss_he
      - alif_e7_dk/ae722f80f55d5xx/rtss_he
      - alif_e7_dk/ae722f80f55d5xx/rtss_hp
      - alif_e8_dk/ae822fa0e5597xx0/rtss_he
      - alif_e8_dk/ae822fa0e5597xx0/rtss_hp
    integration_platforms:
      - alif_b1_dk/ab1c1f4m51820ph0/rtss_he
      - alif_e7_dk/ae722f80f55d5xx/rtss_he
      - alif_e7_dk/ae722f80f55d5xx/rtss_hp
      - alif_e8_dk/ae822fa0e5597xx0/rtss_he
      - alif_e8_dk/ae822fa0e5597xx0/rtss_hp
```

## tests/drivers/pdm/testcase.yaml
```yaml
# Representative PDM / LpPDM scenarios. Not exhaustive — see README.rst.
# ZTEST name: test_pdm_*   for -S pdm   (&pdm)
#             test_lppdm_* for -S lppdm (&lppdm)
common:
  tags: pdm
  harness: ztest
  timeout: 90

.pdm_platforms: &pdm_platforms
  - alif_e8_dk/ae822fa0e5597xx0/rtss_he
  - alif_e8_dk/ae822fa0e5597xx0/rtss_hp
  - alif_e7_dk/ae722f80f55d5xx/rtss_he
  - alif_e7_dk/ae722f80f55d5xx/rtss_hp

.lppdm_platforms: &lppdm_platforms
  - alif_b1_dk/ab1c1f4m51820hh0/rtss_he
  - alif_e1c_dk/ae1c1f4051920hh/rtss_he
  - alif_e8_dk/ae822fa0e5597xx0/rtss_he
  - alif_e7_dk/ae722f80f55d5xx/rtss_he

tests:
  # --- PDM: E7/E8 HE + HP ---
  drivers.pdm.mono.mode1.ch0:
    required_snippets:
      - pdm
    platform_allow: *pdm_platforms
    integration_platforms: *pdm_platforms
    extra_configs:
      - CONFIG_TEST_PDM_MONO_CH=y
      - CONFIG_TEST_PDM_CH0=y
      - CONFIG_TEST_PDM_MODE1=y
  drivers.pdm.mono.mode2.ch3:
    required_snippets:
      - pdm
    platform_allow: *pdm_platforms
    extra_configs:
      - CONFIG_TEST_PDM_MONO_CH=y
      - CONFIG_TEST_PDM_CH3=y
      - CONFIG_TEST_PDM_MODE2=y
  drivers.pdm.mono.mode3.ch0:
    required_snippets:
      - pdm
    platform_allow: *pdm_platforms
    extra_configs:
      - CONFIG_TEST_PDM_MONO_CH=y
      - CONFIG_TEST_PDM_CH0=y
      - CONFIG_TEST_PDM_MODE3=y
  drivers.pdm.mono.mode4.ch0:
    required_snippets:
      - pdm
    platform_allow: *pdm_platforms
    extra_configs:
      - CONFIG_TEST_PDM_MONO_CH=y
      - CONFIG_TEST_PDM_CH0=y
      - CONFIG_TEST_PDM_MODE4=y
  drivers.pdm.mono.mode5.ch0:
    required_snippets:
      - pdm
    platform_allow: *pdm_platforms
    extra_configs:
      - CONFIG_TEST_PDM_MONO_CH=y
      - CONFIG_TEST_PDM_CH0=y
      - CONFIG_TEST_PDM_MODE5=y
  drivers.pdm.mono.mode7.ch0:
    required_snippets:
      - pdm
    platform_allow: *pdm_platforms
    extra_configs:
      - CONFIG_TEST_PDM_MONO_CH=y
      - CONFIG_TEST_PDM_CH0=y
      - CONFIG_TEST_PDM_MODE7=y
  drivers.pdm.mono.mode8.ch0:
    required_snippets:
      - pdm
    platform_allow: *pdm_platforms
    extra_configs:
      - CONFIG_TEST_PDM_MONO_CH=y
      - CONFIG_TEST_PDM_CH0=y
      - CONFIG_TEST_PDM_MODE8=y
  drivers.pdm.stereo.mode1.ch0_1:
    required_snippets:
      - pdm
    platform_allow: *pdm_platforms
    extra_configs:
      - CONFIG_TEST_PDM_STEREO_CH=y
      - CONFIG_TEST_PDM_CH0=y
      - CONFIG_TEST_PDM_CH1=y
      - CONFIG_TEST_PDM_MODE1=y
  drivers.pdm.stereo.mode1.ch2_3:
    required_snippets:
      - pdm
    platform_allow: *pdm_platforms
    extra_configs:
      - CONFIG_TEST_PDM_STEREO_CH=y
      - CONFIG_TEST_PDM_CH2=y
      - CONFIG_TEST_PDM_CH3=y
      - CONFIG_TEST_PDM_MODE1=y
  drivers.pdm.stereo.mode1.ch6_7:
    required_snippets:
      - pdm
    platform_allow: *pdm_platforms
    extra_configs:
      - CONFIG_TEST_PDM_STEREO_CH=y
      - CONFIG_TEST_PDM_CH6=y
      - CONFIG_TEST_PDM_CH7=y
      - CONFIG_TEST_PDM_MODE1=y
  drivers.pdm.stereo.mode6.ch4_5:
    required_snippets:
      - pdm
    platform_allow: *pdm_platforms
    extra_configs:
      - CONFIG_TEST_PDM_STEREO_CH=y
      - CONFIG_TEST_PDM_CH4=y
      - CONFIG_TEST_PDM_CH5=y
      - CONFIG_TEST_PDM_MODE6=y
  drivers.pdm.multi.mode1.ch0_1_2:
    required_snippets:
      - pdm
    platform_allow: *pdm_platforms
    extra_configs:
      - CONFIG_TEST_PDM_MULTI_CH=y
      - CONFIG_TEST_PDM_CH0=y
      - CONFIG_TEST_PDM_CH1=y
      - CONFIG_TEST_PDM_CH2=y
      - CONFIG_TEST_PDM_MODE1=y
  drivers.pdm.multi.mode6.ch0_1_4_5:
    required_snippets:
      - pdm
    platform_allow: *pdm_platforms
    extra_configs:
      - CONFIG_TEST_PDM_MULTI_CH=y
      - CONFIG_TEST_PDM_CH0=y
      - CONFIG_TEST_PDM_CH1=y
      - CONFIG_TEST_PDM_CH4=y
      - CONFIG_TEST_PDM_CH5=y
      - CONFIG_TEST_PDM_MODE6=y
  drivers.pdm.multi.mode9.ch4_5_6_7:
    required_snippets:
      - pdm
    platform_allow: *pdm_platforms
    extra_configs:
      - CONFIG_TEST_PDM_MULTI_CH=y
      - CONFIG_TEST_PDM_CH4=y
      - CONFIG_TEST_PDM_CH5=y
      - CONFIG_TEST_PDM_CH6=y
      - CONFIG_TEST_PDM_CH7=y
      - CONFIG_TEST_PDM_MODE9=y

  # --- LpPDM: B1 / E1C / E7 / E8 HE ---
  drivers.lppdm.mono.mode1.ch0:
    required_snippets:
      - lppdm
    platform_allow: *lppdm_platforms
    extra_configs:
      - CONFIG_TEST_PDM_MONO_CH=y
      - CONFIG_TEST_PDM_CH0=y
      - CONFIG_TEST_PDM_MODE1=y
  drivers.lppdm.stereo.mode1.ch0_1:
    required_snippets:
      - lppdm
    platform_allow: *lppdm_platforms
    extra_configs:
      - CONFIG_TEST_PDM_STEREO_CH=y
      - CONFIG_TEST_PDM_CH0=y
      - CONFIG_TEST_PDM_CH1=y
      - CONFIG_TEST_PDM_MODE1=y
  drivers.lppdm.multi.mode6.ch4_5_6_7:
    required_snippets:
      - lppdm
    platform_allow: *lppdm_platforms
    extra_configs:
      - CONFIG_TEST_PDM_MULTI_CH=y
      - CONFIG_TEST_PDM_CH4=y
      - CONFIG_TEST_PDM_CH5=y
      - CONFIG_TEST_PDM_CH6=y
      - CONFIG_TEST_PDM_CH7=y
      - CONFIG_TEST_PDM_MODE6=y
```

## tests/drivers/pinctrl/api/testcase.yaml
```yaml
common:
  tags: drivers pinctrl
  harness: ztest

tests:
  drivers.pinctrl.api.ensemble:
    platform_allow:
      - alif_e8_dk/ae822fa0e5597xx0/rtss_he
      - alif_e8_dk/ae822fa0e5597xx0/rtss_hp
      - alif_e7_dk/ae722f80f55d5xx/rtss_he
      - alif_e7_dk/ae722f80f55d5xx/rtss_hp
    extra_dtc_overlay_files:
      - boards/alif_ensemble_pinctrl.overlay
    integration_platforms:
      - alif_e8_dk/ae822fa0e5597xx0/rtss_he

  drivers.pinctrl.api.balletto:
    platform_allow:
      - alif_b1_dk/ab1c1f4m51820ph0/rtss_he
      - alif_e1c_dk/ae1c1f4051920hh/rtss_he
    extra_dtc_overlay_files:
      - boards/alif_balletto_pinctrl.overlay
    integration_platforms:
      - alif_e1c_dk/ae1c1f4051920hh/rtss_he
```

## tests/drivers/pm/qdec/testcase.yaml
```yaml
common:
  tags:
    - power
    - pm
    - qdec
    - sensor
    - gpio
    - drivers
  filter: SOC_FAMILY_ENSEMBLE or SOC_FAMILY_BALLETTO
  depends_on:
    - gpio
    - sensor
  timeout: 180

tests:
  drivers.pm.qdec.s2ram:
    extra_args:
      - SNIPPET=qdec-pm-s2ram-tcm
      - CONFIG_FLASH_BASE_ADDRESS=0x0
      - CONFIG_FLASH_LOAD_OFFSET=0x0
      - CONFIG_FLASH_SIZE=256
    platform_allow:
      - alif_e8_dk/ae822fa0e5597xx0/rtss_he
      - alif_e7_dk/ae722f80f55d5xx/rtss_he
      - alif_e1c_dk/ae1c1f4051920hh/rtss_he
      - alif_b1_dk/ab1c1f4m51820ph0/rtss_he
    integration_platforms:
      - alif_e8_dk/ae822fa0e5597xx0/rtss_he
    harness: ztest

  drivers.pm.qdec.mram:
    extra_args:
      - SNIPPET=qdec-pm-mram
    platform_allow:
      - alif_e8_dk/ae822fa0e5597xx0/rtss_he
      - alif_e8_dk/ae822fa0e5597xx0/rtss_hp
      - alif_e7_dk/ae722f80f55d5xx/rtss_he
      - alif_e7_dk/ae722f80f55d5xx/rtss_hp
      - alif_e1c_dk/ae1c1f4051920hh/rtss_he
      - alif_b1_dk/ab1c1f4m51820ph0/rtss_he
    integration_platforms:
      - alif_e8_dk/ae822fa0e5597xx0/rtss_he
    harness: console
    harness_config:
      type: multi_line
      regex:
        - "SOFT_OFF has no retention"
```

## tests/drivers/pwm/pwm_api/testcase.yaml
```yaml
tests:
  drivers.pwm:
    tags:
      - drivers
      - pwm
      - userspace
    filter: dt_alias_exists("pwm-led0") or dt_alias_exists("pwm-led6")
    depends_on: pwm
```

## tests/drivers/pwm/pwm_loopback/dts/bindings/test-pwm-loopback.yaml
```yaml
description: |
    This binding provides resources required to build and run the
    tests/drivers/pwm/pwm_loopback test in Zephyr.

compatible: "test-pwm-loopback"

properties:
  pwms:
    type: phandle-array
    required: true
    description: |
      PWM pins that will be used for generating and capturing a pulse-width
      modulated signal. The pin at the first index will be used for signal
      generation while the pin at the second index will be used for capturing
      the generated signal. The two pins must be physically connected to
      each other.
```

## tests/drivers/uart/testcase.yaml
```yaml
common:
  tags:
    - drivers
    - uart
  harness: ztest
  timeout: 600
  platform_allow:
    - alif_b1_dk/ab1c1f4m51820ph0/rtss_he
    - alif_e1c_dk/ae1c1f4051920hh/rtss_he
    - alif_e8_dk/ae822fa0e5597xx0/rtss_he
    - alif_e8_dk/ae822fa0e5597xx0/rtss_hp
    - alif_e7_dk/ae722f80f55d5xx/rtss_he
    - alif_e7_dk/ae722f80f55d5xx/rtss_hp
  integration_platforms:
    - alif_e8_dk/ae822fa0e5597xx0/rtss_he

tests:
  drivers.uart:
    extra_dtc_overlay_files:
      - boards/alif_uart.overlay
    extra_configs:
      - CONFIG_TEST_INTERNAL_LB=y

  drivers.uart.rtscts:
    extra_args:
      - SNIPPET=uart0-rts-cts
    extra_dtc_overlay_files:
      - boards/alif_uart.overlay
    extra_configs:
      - CONFIG_TEST_UART_RTSCTS=y
      - CONFIG_TEST_INTERNAL_LB=n

  drivers.uart.dma:
    extra_args:
      - EXTRA_CONF_FILE=dma.conf
      - SNIPPET=alif-uart-dma
    extra_configs:
      - CONFIG_TEST_UART_DMA=y
      - CONFIG_TEST_INTERNAL_LB=n

  drivers.uart.stress:
    extra_dtc_overlay_files:
      - boards/alif_uart.overlay
    extra_configs:
      - CONFIG_TEST_STRESS=y
      - CONFIG_TEST_INTERNAL_LB=n
    timeout: 600

  drivers.uart.perf:
    build_only: true
    extra_dtc_overlay_files:
      - boards/alif_uart.overlay
    extra_configs:
      - CONFIG_TEST_PERFORMANCE=y
      - CONFIG_TEST_INTERNAL_LB=n

  drivers.uart.fifo:
    extra_dtc_overlay_files:
      - boards/alif_uart.overlay
    extra_configs:
      - CONFIG_TEST_UART_FIFO=y
      - CONFIG_TEST_INTERNAL_LB=n

  drivers.uart.lpuart:
    extra_dtc_overlay_files:
      - boards/alif_lpuart.overlay
    extra_configs:
      - CONFIG_TEST_UART_LPUART=y
      - CONFIG_TEST_INTERNAL_LB=y

  drivers.uart.hotplug:
    build_only: true
    extra_dtc_overlay_files:
      - boards/alif_uart.overlay
    extra_configs:
      - CONFIG_TEST_UART_HOTPLUG=y
      - CONFIG_TEST_INTERNAL_LB=n
  drivers.uart.line_errors:
    build_only: true
    extra_dtc_overlay_files:
      - boards/alif_uart.overlay
    extra_configs:
      - CONFIG_TEST_UART_LINE_ERRORS=y
      - CONFIG_TEST_INTERNAL_LB=n
      - CONFIG_UART_LINE_CTRL=y
```

## tests/drivers/wifi/boards/alif_e8_dk_ae822fa0e5597xx0_rtss_hp.conf
```kconfig
# E8 DK board-specific config
CONFIG_SDHC_INIT_PRIORITY=80
CONFIG_WIFI_SHELL_TEST_SSID="mahesh's S23"
CONFIG_WIFI_SHELL_TEST_PSK="Aadhya13$"
CONFIG_WIFI_ZPERF_TEST_SSID="Alif-Wireless"
CONFIG_WIFI_ZPERF_TEST_PSK="Alif$2o24$"
CONFIG_WIFI_ZPERF_SERVER_IP="10.0.0.79"
```

## tests/modules/lvgl/testcase.yaml
```yaml
common:
  tags:
    - modules
    - lvgl
    - dave2d
    - gpu2d
    - display
  depends_on: display
  harness: ztest
  platform_allow:
    - alif_e8_dk/ae822fa0e5597xx0/rtss_hp
    - alif_e8_dk/ae822fa0e5597xx0/rtss_he
  integration_platforms:
    - alif_e8_dk/ae822fa0e5597xx0/rtss_hp

tests:
  modules.lvgl.dave2d:
    filter: dt_compat_enabled("tes,cdc-2.1")
```
