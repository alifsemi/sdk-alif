/* Copyright (C) 2025 Alif Semiconductor - All Rights Reserved.
 * Use, distribution and modification of this code is permitted under the
 * terms stated in the Alif Semiconductor Software License Agreement
 *
 * You should have received a copy of the Alif Semiconductor Software
 * License Agreement with this file. If not, please write to:
 * contact@alifsemi.com, or visit: https://alifsemi.com/license
 */

/ {
	aliases {
		i2c-instance = &i2c0;	/* change this to &i2c0, &i2c2, etc. as needed */
	};
};

&i2c0 {
	status = "okay";
};
