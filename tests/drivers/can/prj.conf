## CMakeLists.txt
```
# Copyright Alif Semiconductor - All Rights Reserved.
# Use, distribution and modification of this code is permitted under the
# terms stated in the Alif Semiconductor Software License Agreement
#
# You should have received a copy of the Alif Semiconductor Software
# License Agreement with this file. If not, please write to:
# contact@alifsemi.com, or visit: https://alifsemi.com/license

cmake_minimum_required(VERSION 3.20.0)
find_package(Zephyr REQUIRED HINTS $ENV{ZEPHYR_BASE})
project(can)

target_sources(app PRIVATE src/test_can_normal_tx.c)
target_sources(app PRIVATE src/test_can_normal_rx.c)
```

## Kconfig
```
# Copyright Alif Semiconductor - All Rights Reserved.
# Use, distribution and modification of this code is permitted under the
# terms stated in the Alif Semiconductor Software License Agreement
#
# You should have received a copy of the Alif Semiconductor Software
# License Agreement with this file. If not, please write to:
# contact@alifsemi.com, or visit: https://alifsemi.com/license

mainmenu "CAN Normal Mode Test"

source "Kconfig.zephyr"

config CAN_TEST_BITRATE_NOMINAL
	int "Nominal bitrate for CAN tests (bits/s)"
	default 500000
	help
	  Nominal bitrate used in CAN normal mode tests.
	  Valid options: 125000, 250000, 500000, 1000000.

config CAN_TEST_SAMPLE_POINT_NOMINAL
	int "Nominal sample point (per mille)"
	default 800
	help
	  Sample point in per mille (e.g. 800 = 80.0%).

if CAN_FD_MODE

config CAN_TEST_BITRATE_DATA
	int "Data phase bitrate for CAN-FD tests (bits/s)"
	default 2000000
	help
	  Data phase bitrate used in CAN-FD tests.
	  Valid options: 1000000, 2000000, 5000000.

config CAN_TEST_SAMPLE_POINT_DATA
	int "Data phase sample point (per mille)"
	default 800
	help
	  Data phase sample point in per mille.

endif # CAN_FD_MODE

config CAN_TEST_RX_TIMEOUT_MS
	int "RX test timeout in milliseconds"
	default 60000
	help
	  Timeout for RX tests waiting for external CANalyzer frames.
	  Set to a large value (e.g. 60000) for manual testing.
	  Set to a small value (e.g. 3000) for automated CI where
	  frames are injected by a script.
```

## prj.conf
```kconfig
# Copyright Alif Semiconductor - All Rights Reserved.
# Use, distribution and modification of this code is permitted under the
# terms stated in the Alif Semiconductor Software License Agreement
#
# You should have received a copy of the Alif Semiconductor Software
# License Agreement with this file. If not, please write to:
# contact@alifsemi.com, or visit: https://alifsemi.com/license

CONFIG_CAN=y
CONFIG_CAN_MANUAL_RECOVERY_MODE=y
CONFIG_CAN_ACCEPT_RTR=y
CONFIG_CAN_MAX_FILTER=8
CONFIG_CAN_STATS=y
CONFIG_STATS=y
CONFIG_ZTEST=y
CONFIG_LOG=y
CONFIG_LOG_BUFFER_SIZE=8192
```

## boards/can_normal.overlay
```dts
/*
 * Copyright Alif Semiconductor - All Rights Reserved.
 * Use, distribution and modification of this code is permitted under the
 * terms stated in the Alif Semiconductor Software License Agreement
 *
 * You should have received a copy of the Alif Semiconductor Software
 * License Agreement with this file. If not, please write to:
 * contact@alifsemi.com, or visit: https://alifsemi.com/license
 */

&can0 {
	status = "okay";
};

/ {
	chosen {
		zephyr,canbus = &can0;
	};
};
```

## src/test_can_normal_rx.c
```c
/* Copyright Alif Semiconductor - All Rights Reserved.
 * Use, distribution and modification of this code is permitted under the
 * terms stated in the Alif Semiconductor Software License Agreement
 *
 * You should have received a copy of the Alif Semiconductor Software
 * License Agreement with this file. If not, please write to:
 * contact@alifsemi.com, or visit: https://alifsemi.com/license
 */

/*
 * CAN Normal Mode RX Test Suite
 *
 * Each test installs its own RX filter, blocks on a semaphore until the
 * expected frame arrives, validates it, then removes the filter.
 * No shared msgq, no cross-test contention.
 */

#include <zephyr/kernel.h>
#include <zephyr/device.h>
#include <zephyr/drivers/can.h>
#include <zephyr/ztest.h>
#include <zephyr/logging/log.h>

LOG_MODULE_REGISTER(alif_can_normal_rx, LOG_LEVEL_INF);

/* Test bitrates (override via Kconfig) */
#define TEST_BITRATE_NOMINAL      CONFIG_CAN_TEST_BITRATE_NOMINAL
#define TEST_SAMPLE_POINT_NOMINAL CONFIG_CAN_TEST_SAMPLE_POINT_NOMINAL
#define TEST_BITRATE_DATA         CONFIG_CAN_TEST_BITRATE_DATA
#define TEST_SAMPLE_POINT_DATA    CONFIG_CAN_TEST_SAMPLE_POINT_DATA

/* Timeouts: 0 = block forever (manual testing) */
#define TEST_RECV_TIMEOUT_MS      CONFIG_CAN_TEST_RX_TIMEOUT_MS

/* Test CAN IDs */
#define TEST_STD_ID_RX            0x123U
#define TEST_RTR_ID_RX            0x456U
#define TEST_EXT_ID_RX            0x18ABCDEFU

/* Expected payloads from CANalyzer */
#define CAN_RX_PAYLOAD_LEN        8U
static const uint8_t can_rx_expected_data[CAN_RX_PAYLOAD_LEN] = {
	0xAA, 0xBB, 0xCC, 0xDD, 0xEE, 0xFF, 0x11, 0x22
};

static const struct device *can_dev;
static struct k_sem rx_sem;
static struct can_frame rx_frame;

static void rx_callback(const struct device *dev, struct can_frame *frame,
			void *user_data)
{
	ARG_UNUSED(dev);
	ARG_UNUSED(user_data);

	LOG_INF("RX callback: id=0x%08X, dlc=%u, flags=0x%02X",
		frame->id, frame->dlc, frame->flags);

	rx_frame = *frame;
	k_sem_give(&rx_sem);
}

/**
 * @brief Block until a frame matching @p filter arrives.
 *
 * Installs the filter, waits on rx_sem, validates basic fields,
 * then removes the filter.  Returns 0 on success, -EAGAIN on timeout.
 */
static int recv_frame(const struct can_filter *filter,
		      struct can_frame *frame)
{
	int filter_id;
	int err;

	/* Drop a give left by a frame that arrived after the previous take. */
	k_sem_reset(&rx_sem);

	filter_id = can_add_rx_filter(can_dev, rx_callback, NULL, filter);
	zassert_true(filter_id >= 0, "add_rx_filter failed (err %d)", filter_id);

	err = k_sem_take(&rx_sem, TEST_RECV_TIMEOUT_MS ?
			 K_MSEC(TEST_RECV_TIMEOUT_MS) : K_FOREVER);

	can_remove_rx_filter(can_dev, filter_id);

	if (err == -EAGAIN) {
		return -EAGAIN;
	}
	zassert_equal(err, 0, "sem_take failed (err %d)", err);

	*frame = rx_frame;
	return 0;
}

static void *rx_suite_setup(void)
{
	struct can_timing timing = {0};
	can_mode_t cap;
	int err;

	can_dev = DEVICE_DT_GET(DT_CHOSEN(zephyr_canbus));
	zassert_true(device_is_ready(can_dev), "CAN device not ready");

	k_sem_init(&rx_sem, 0, 1);

	err = can_get_capabilities(can_dev, &cap);
	zassert_equal(err, 0, "get_capabilities failed (err %d)", err);

	(void)can_stop(can_dev);

	err = can_calc_timing(can_dev, &timing, TEST_BITRATE_NOMINAL,
			      TEST_SAMPLE_POINT_NOMINAL);
	zassert_equal(err, 0, "calc_timing failed (err %d)", err);

	err = can_set_timing(can_dev, &timing);
	zassert_equal(err, 0, "set_timing failed (err %d)", err);

#ifdef CONFIG_CAN_FD_MODE
	if ((cap & CAN_MODE_FD) != 0) {
		err = can_calc_timing_data(can_dev, &timing, TEST_BITRATE_DATA,
					   TEST_SAMPLE_POINT_DATA);
		zassert_equal(err, 0, "calc_timing_data failed (err %d)", err);

		err = can_set_timing_data(can_dev, &timing);
		zassert_equal(err, 0, "set_timing_data failed (err %d)", err);
	}
#endif

	return NULL;
}

static void rx_suite_before(void *fixture)
{
	ARG_UNUSED(fixture);
	can_mode_t mode = CAN_MODE_NORMAL;
	int err;

#ifdef CONFIG_CAN_FD_MODE
	can_mode_t cap;

	err = can_get_capabilities(can_dev, &cap);
	zassert_equal(err, 0, "get_capabilities failed (err %d)", err);

	if ((cap & CAN_MODE_FD) != 0) {
		mode |= CAN_MODE_FD;
	}
#endif

	(void)can_stop(can_dev);

	err = can_set_mode(can_dev, mode);
	zassert_equal(err, 0, "set_mode failed (err %d)", err);

	err = can_start(can_dev);
	zassert_equal(err, 0, "can_start failed (err %d)", err);
}

/**
 * @brief Receive a standard frame from the external CANalyzer.
 */
ZTEST(can_normal_rx, test_receive_std_from_CANalyzer)
{
	struct can_filter filter = {
		.flags = 0,
		.id    = TEST_STD_ID_RX,
		.mask  = CAN_STD_ID_MASK
	};
	struct can_frame frame;
	int err;

	LOG_INF("=== Waiting for standard frame ===");
	LOG_INF("CANalyzer -> ID 0x%03X, DLC=8, data=AA BB CC DD EE FF 11 22",
		TEST_STD_ID_RX);

	err = recv_frame(&filter, &frame);
	if (err == -EAGAIN) {
		ztest_test_skip();
	}

	zassert_equal(frame.id, TEST_STD_ID_RX,
		      "RX ID mismatch: expected 0x%03X, got 0x%08X",
		      TEST_STD_ID_RX, frame.id);
	zassert_equal(frame.dlc, CAN_RX_PAYLOAD_LEN,
		      "RX DLC mismatch: expected %u, got %u",
		      CAN_RX_PAYLOAD_LEN, frame.dlc);
	zassert_equal(frame.flags, 0, "unexpected flags 0x%02x", frame.flags);
	zassert_mem_equal(frame.data, can_rx_expected_data,
			CAN_RX_PAYLOAD_LEN, "RX data mismatch");

	LOG_INF("Standard frame received OK");
}

/**
 * @brief Receive an extended frame from the external CANalyzer.
 */
ZTEST(can_normal_rx, test_receive_ext_from_CANalyzer)
{
	static const uint8_t ext_expected_data[4] = {0xDE, 0xAD, 0xBE, 0xEF};
	struct can_filter filter = {
		.flags = CAN_FILTER_IDE,
		.id    = TEST_EXT_ID_RX,
		.mask  = CAN_EXT_ID_MASK
	};
	struct can_frame frame;
	int err;

	LOG_INF("=== Waiting for extended frame ===");
	LOG_INF("CANalyzer -> ID 0x%08X, DLC=4, data=DE AD BE EF",
		TEST_EXT_ID_RX);

	err = recv_frame(&filter, &frame);
	if (err == -EAGAIN) {
		ztest_test_skip();
	}

	zassert_equal(frame.id, TEST_EXT_ID_RX,
		      "RX ID mismatch: expected 0x%08X, got 0x%08X",
		      TEST_EXT_ID_RX, frame.id);
	zassert_equal(frame.dlc, 4U,
		      "RX DLC mismatch: expected 4, got %u", frame.dlc);
	zassert_equal(frame.flags, CAN_FRAME_IDE,
		      "unexpected flags 0x%02x", frame.flags);
	zassert_mem_equal(frame.data, ext_expected_data, 4U,
			"RX data mismatch");

	LOG_INF("Extended frame received OK");
}

/**
 * @brief Receive an RTR frame from the external CANalyzer.
 */
ZTEST(can_normal_rx, test_receive_rtr_from_CANalyzer)
{
	struct can_filter filter = {
		.flags = 0,
		.id    = TEST_RTR_ID_RX,
		.mask  = CAN_STD_ID_MASK
	};
	struct can_frame frame;
	int err;

	LOG_INF("=== Waiting for RTR frame ===");
	LOG_INF("CANalyzer -> RTR frame ID 0x%03X, DLC=8", TEST_RTR_ID_RX);

	err = recv_frame(&filter, &frame);
	if (err == -EAGAIN) {
		ztest_test_skip();
	}

	zassert_equal(frame.id, TEST_RTR_ID_RX,
		      "RX ID mismatch: expected 0x%03X, got 0x%08X",
		      TEST_RTR_ID_RX, frame.id);
	zassert_equal(frame.dlc, 8U,
		      "RX DLC mismatch: expected 8, got %u", frame.dlc);
	zassert_equal(frame.flags, CAN_FRAME_RTR,
		      "unexpected flags 0x%02x", frame.flags);

	LOG_INF("RTR frame received OK");
}

#ifdef CONFIG_CAN_FD_MODE
/**
 * @brief Receive a CAN FD frame from the external CANalyzer.
 */
ZTEST(can_normal_rx, test_receive_fd_from_CANalyzer)
{
	static const uint8_t fd_expected_data[64] = {
		0x00, 0x01, 0x02, 0x03, 0x04, 0x05, 0x06, 0x07,
		0x08, 0x09, 0x0A, 0x0B, 0x0C, 0x0D, 0x0E, 0x0F,
		0x10, 0x11, 0x12, 0x13, 0x14, 0x15, 0x16, 0x17,
		0x18, 0x19, 0x1A, 0x1B, 0x1C, 0x1D, 0x1E, 0x1F,
		0x20, 0x21, 0x22, 0x23, 0x24, 0x25, 0x26, 0x27,
		0x28, 0x29, 0x2A, 0x2B, 0x2C, 0x2D, 0x2E, 0x2F,
		0x30, 0x31, 0x32, 0x33, 0x34, 0x35, 0x36, 0x37,
		0x38, 0x39, 0x3A, 0x3B, 0x3C, 0x3D, 0x3E, 0x3F
	};

	struct can_filter filter = {
		.flags = CAN_FILTER_IDE,
		.id    = TEST_EXT_ID_RX,
		.mask  = CAN_EXT_ID_MASK
	};
	struct can_frame frame;
	int err;

	LOG_INF("=== Waiting for CAN FD frame ===");
	LOG_INF("CANalyzer -> FD+BRS frame ID 0x%08X, DLC=15, data=00..3F",
		TEST_EXT_ID_RX);

	err = recv_frame(&filter, &frame);
	if (err == -EAGAIN) {
		ztest_test_skip();
	}

	zassert_equal(frame.id, TEST_EXT_ID_RX,
		      "RX ID mismatch: expected 0x%08X, got 0x%08X",
		      TEST_EXT_ID_RX, frame.id);
	zassert_equal(frame.dlc, 0x0FU,
		      "RX DLC mismatch: expected 15, got %u", frame.dlc);
	zassert_equal(frame.flags, CAN_FRAME_IDE | CAN_FRAME_FDF | CAN_FRAME_BRS,
		      "unexpected flags 0x%02x", frame.flags);
	zassert_mem_equal(frame.data, fd_expected_data, 64U,
			"RX data mismatch");

	LOG_INF("CAN FD frame received OK");
}
#endif /* CONFIG_CAN_FD_MODE */

ZTEST_SUITE(can_normal_rx, NULL, rx_suite_setup, rx_suite_before,
	    NULL, NULL);
```

## src/test_can_normal_tx.c
```c
/* Copyright Alif Semiconductor - All Rights Reserved.
 * Use, distribution and modification of this code is permitted under the
 * terms stated in the Alif Semiconductor Software License Agreement
 *
 * You should have received a copy of the Alif Semiconductor Software
 * License Agreement with this file. If not, please write to:
 * contact@alifsemi.com, or visit: https://alifsemi.com/license
 */

/*
 * CAN Normal Mode TX Test Suite
 *
 * Self-contained tests that exercise TX paths only.
 * Requires a CAN analyzer on the bus to ACK frames.
 */

#include <zephyr/kernel.h>
#include <zephyr/device.h>
#include <zephyr/drivers/can.h>
#include <zephyr/ztest.h>
#include <zephyr/logging/log.h>

LOG_MODULE_REGISTER(alif_can_normal_tx, LOG_LEVEL_INF);

/* Test bitrates (override via Kconfig) */
#define TEST_BITRATE_NOMINAL      CONFIG_CAN_TEST_BITRATE_NOMINAL
#define TEST_SAMPLE_POINT_NOMINAL CONFIG_CAN_TEST_SAMPLE_POINT_NOMINAL
#define TEST_BITRATE_DATA         CONFIG_CAN_TEST_BITRATE_DATA
#define TEST_SAMPLE_POINT_DATA    CONFIG_CAN_TEST_SAMPLE_POINT_DATA

/* Timeouts */
#define TEST_SEND_TIMEOUT_MS      2000

/* Test CAN IDs */
#define TEST_STD_ID_TX            0x5A5U
#define TEST_EXT_ID_TX            0x01FF5A5AU

/* Test frames */
static const struct can_frame test_tx_std_frame = {
	.flags = 0,
	.id    = TEST_STD_ID_TX,
	.dlc   = 8,
	.data  = {0x01, 0x02, 0x03, 0x04, 0x05, 0x06, 0x07, 0x08}
};

static const struct can_frame test_tx_ext_frame = {
	.flags = CAN_FRAME_IDE,
	.id    = TEST_EXT_ID_TX,
	.dlc   = 4,
	.data  = {0xDE, 0xAD, 0xBE, 0xEF}
};

static const struct can_frame test_tx_rtr_std_frame = {
	.flags = CAN_FRAME_RTR,
	.id    = TEST_STD_ID_TX,
	.dlc   = 8,
	.data  = {0}
};

static const struct can_frame test_tx_rtr_ext_frame = {
	.flags = CAN_FRAME_RTR | CAN_FRAME_IDE,
	.id    = TEST_EXT_ID_TX,
	.dlc   = 4,
	.data  = {0}
};

static const struct can_frame test_tx_zero_dlc_frame = {
	.flags = 0,
	.id    = TEST_STD_ID_TX,
	.dlc   = 0,
	.data  = {0}
};

#ifdef CONFIG_CAN_FD_MODE
static const struct can_frame test_tx_fd_frame = {
	.flags = CAN_FRAME_FDF | CAN_FRAME_BRS,
	.id    = TEST_STD_ID_TX,
	.dlc   = 0x0FU,
	.data  = {
		0x00, 0x01, 0x02, 0x03, 0x04, 0x05, 0x06, 0x07,
		0x08, 0x09, 0x0A, 0x0B, 0x0C, 0x0D, 0x0E, 0x0F,
		0x10, 0x11, 0x12, 0x13, 0x14, 0x15, 0x16, 0x17,
		0x18, 0x19, 0x1A, 0x1B, 0x1C, 0x1D, 0x1E, 0x1F,
		0x20, 0x21, 0x22, 0x23, 0x24, 0x25, 0x26, 0x27,
		0x28, 0x29, 0x2A, 0x2B, 0x2C, 0x2D, 0x2E, 0x2F,
		0x30, 0x31, 0x32, 0x33, 0x34, 0x35, 0x36, 0x37,
		0x38, 0x39, 0x3A, 0x3B, 0x3C, 0x3D, 0x3E, 0x3F
	}
};

static const struct can_frame test_tx_fd_no_brs_frame = {
	.flags = CAN_FRAME_FDF,
	.id    = TEST_STD_ID_TX,
	.dlc   = 0x0DU,
	.data  = {
		0xA0, 0xA1, 0xA2, 0xA3, 0xA4, 0xA5, 0xA6, 0xA7,
		0xA8, 0xA9, 0xAA, 0xAB, 0xAC, 0xAD, 0xAE, 0xAF,
		0xB0, 0xB1, 0xB2, 0xB3, 0xB4, 0xB5, 0xB6, 0xB7,
		0xB8, 0xB9, 0xBA, 0xBB, 0xBC, 0xBD, 0xBE, 0xBF
	}
};
#endif

static const struct device *can_dev;
static struct k_sem tx_sem;
static int tx_cb_error;

static void tx_callback(const struct device *dev, int error, void *user_data)
{
	ARG_UNUSED(dev);
	ARG_UNUSED(user_data);

	/* Runs from the CAN ISR. Keep a non-zero error so a later success
	 * cannot hide an earlier failure when several frames are in flight.
	 */
	if (error != 0) {
		tx_cb_error = error;
	}
	k_sem_give(&tx_sem);
}

static void *tx_suite_setup(void)
{
	struct can_timing timing = {0};
	can_mode_t cap;
	int err;

	can_dev = DEVICE_DT_GET(DT_CHOSEN(zephyr_canbus));
	zassert_true(device_is_ready(can_dev), "CAN device not ready");

	k_sem_init(&tx_sem, 0, 10);

	err = can_get_capabilities(can_dev, &cap);
	zassert_equal(err, 0, "get_capabilities failed (err %d)", err);

	(void)can_stop(can_dev);

	err = can_calc_timing(can_dev, &timing, TEST_BITRATE_NOMINAL,
			      TEST_SAMPLE_POINT_NOMINAL);
	zassert_equal(err, 0, "calc_timing failed (err %d)", err);

	err = can_set_timing(can_dev, &timing);
	zassert_equal(err, 0, "set_timing failed (err %d)", err);

#ifdef CONFIG_CAN_FD_MODE
	if ((cap & CAN_MODE_FD) != 0) {
		err = can_calc_timing_data(can_dev, &timing, TEST_BITRATE_DATA,
					   TEST_SAMPLE_POINT_DATA);
		zassert_equal(err, 0, "calc_timing_data failed (err %d)", err);

		err = can_set_timing_data(can_dev, &timing);
		zassert_equal(err, 0, "set_timing_data failed (err %d)", err);
	}
#endif

	return NULL;
}

static void tx_suite_before(void *fixture)
{
	ARG_UNUSED(fixture);
	can_mode_t mode = CAN_MODE_NORMAL;
	int err;

#ifdef CONFIG_CAN_FD_MODE
	can_mode_t cap;

	err = can_get_capabilities(can_dev, &cap);
	zassert_equal(err, 0, "get_capabilities failed (err %d)", err);

	if ((cap & CAN_MODE_FD) != 0) {
		mode |= CAN_MODE_FD;
	}
#endif

	(void)can_stop(can_dev);

	err = can_set_mode(can_dev, mode);
	zassert_equal(err, 0, "set_mode failed (err %d)", err);

	err = can_start(can_dev);
	zassert_equal(err, 0, "can_start failed (err %d)", err);
}

static void send_and_wait(const struct can_frame *frame)
{
	int err;

	tx_cb_error = 0;
	k_sem_reset(&tx_sem);

	err = can_send(can_dev, frame, K_MSEC(TEST_SEND_TIMEOUT_MS),
		       tx_callback, NULL);
	zassert_equal(err, 0, "can_send failed (err %d)", err);

	err = k_sem_take(&tx_sem, K_MSEC(TEST_SEND_TIMEOUT_MS));
	zassert_equal(err, 0,
		      "TX timeout - no ACK from bus (is CANalyzer connected?)");
	zassert_equal(tx_cb_error, 0, "TX callback reported error %d",
		      tx_cb_error);
}

static void assert_post_tx_state(void)
{
	struct can_bus_err_cnt err_cnt;
	enum can_state state;
	int err;

	err = can_get_state(can_dev, &state, &err_cnt);
	zassert_equal(err, 0, "get_state failed (err %d)", err);
	zassert_equal(state, CAN_STATE_ERROR_ACTIVE,
		      "Expected ERROR_ACTIVE after TX, got state %d", state);
	zassert_equal(err_cnt.tx_err_cnt, 0, "TX error counter non-zero after TX");
	zassert_equal(err_cnt.rx_err_cnt, 0, "RX error counter non-zero after TX");
}

ZTEST(can_normal_tx, test_send_std_classic)
{
	send_and_wait(&test_tx_std_frame);
	assert_post_tx_state();
	LOG_INF("Classic STD frame sent OK");
}

ZTEST(can_normal_tx, test_send_ext_classic)
{
	send_and_wait(&test_tx_ext_frame);
	assert_post_tx_state();
	LOG_INF("Classic EXT frame sent OK");
}

ZTEST(can_normal_tx, test_send_rtr_std)
{
	send_and_wait(&test_tx_rtr_std_frame);
	assert_post_tx_state();
	LOG_INF("Standard RTR frame sent OK");
}

ZTEST(can_normal_tx, test_send_rtr_ext)
{
	send_and_wait(&test_tx_rtr_ext_frame);
	assert_post_tx_state();
	LOG_INF("Extended RTR frame sent OK");
}

ZTEST(can_normal_tx, test_send_zero_dlc)
{
	send_and_wait(&test_tx_zero_dlc_frame);
	assert_post_tx_state();
	LOG_INF("Zero-DLC frame sent OK");
}

#ifdef CONFIG_CAN_FD_MODE
ZTEST(can_normal_tx, test_send_fd)
{
	send_and_wait(&test_tx_fd_frame);
	assert_post_tx_state();
	LOG_INF("CAN FD+BRS frame sent OK");
}

ZTEST(can_normal_tx, test_send_fd_no_brs)
{
	send_and_wait(&test_tx_fd_no_brs_frame);
	assert_post_tx_state();
	LOG_INF("CAN FD no-BRS frame sent OK");
}
#endif

ZTEST(can_normal_tx, test_back_to_back_tx)
{
	int err;
	int i;

	tx_cb_error = 0;
	k_sem_reset(&tx_sem);

	for (i = 0; i < 10; i++) {
		err = can_send(can_dev, &test_tx_std_frame,
			       K_MSEC(TEST_SEND_TIMEOUT_MS),
			       tx_callback, NULL);
		zassert_equal(err, 0, "can_send failed iter %d (err %d)",
			      i, err);
	}

	for (i = 0; i < 10; i++) {
		err = k_sem_take(&tx_sem, K_MSEC(TEST_SEND_TIMEOUT_MS));
		zassert_equal(err, 0,
			      "TX timeout iter %d - no ACK from bus", i);
	}

	zassert_equal(tx_cb_error, 0, "TX callback reported error %d",
		      tx_cb_error);

	assert_post_tx_state();
	LOG_INF("Back-to-back TX (10 frames) OK");
}

ZTEST(can_normal_tx, test_bus_recovery_api)
{
	can_mode_t mode = CAN_MODE_NORMAL | CAN_MODE_MANUAL_RECOVERY;
	int err;

#ifdef CONFIG_CAN_FD_MODE
	can_mode_t cap;

	err = can_get_capabilities(can_dev, &cap);
	zassert_equal(err, 0, "get_capabilities failed (err %d)", err);
	if ((cap & CAN_MODE_FD) != 0) {
		mode |= CAN_MODE_FD;
	}
#endif

	err = can_stop(can_dev);
	zassert_equal(err, 0, "can_stop failed (err %d)", err);

	err = can_recover(can_dev, K_NO_WAIT);
	zassert_equal(err, -ENETDOWN,
		      "expected -ENETDOWN while stopped, got %d", err);

	err = can_set_mode(can_dev, mode);
	zassert_equal(err, 0, "set manual recovery mode failed (err %d)", err);
	zassert_equal(can_get_mode(can_dev), mode, "mode mismatch after set_mode");

	err = can_start(can_dev);
	zassert_equal(err, 0, "can_start failed (err %d)", err);

	/* Not bus-off: driver returns success and does not run recovery. */
	err = can_recover(can_dev, K_MSEC(100));
	zassert_equal(err, 0, "can_recover failed while error-active (err %d)", err);
}

ZTEST(can_normal_tx, test_error_state_active)
{
	struct can_bus_err_cnt err_cnt;
	enum can_state state;
	int err;

	err = can_get_state(can_dev, &state, &err_cnt);
	zassert_equal(err, 0, "get_state failed (err %d)", err);

	zassert_equal(state, CAN_STATE_ERROR_ACTIVE,
		      "Expected ERROR_ACTIVE, got state %d", state);
	zassert_equal(err_cnt.tx_err_cnt, 0, "TX error counter should be 0");
	zassert_equal(err_cnt.rx_err_cnt, 0, "RX error counter should be 0");
}

ZTEST(can_normal_tx, test_stats_accessors)
{
	uint32_t bit_errors = can_stats_get_bit_errors(can_dev);
	uint32_t bit0_errors = can_stats_get_bit0_errors(can_dev);
	uint32_t bit1_errors = can_stats_get_bit1_errors(can_dev);
	uint32_t stuff_errors = can_stats_get_stuff_errors(can_dev);
	uint32_t crc_errors = can_stats_get_crc_errors(can_dev);
	uint32_t form_errors = can_stats_get_form_errors(can_dev);
	uint32_t ack_errors = can_stats_get_ack_errors(can_dev);
	uint32_t rx_overruns = can_stats_get_rx_overruns(can_dev);

	LOG_INF("stats: bit=%u bit0=%u bit1=%u stuff=%u crc=%u form=%u ack=%u ovr=%u",
		bit_errors, bit0_errors, bit1_errors, stuff_errors,
		crc_errors, form_errors, ack_errors, rx_overruns);
}

ZTEST_SUITE(can_normal_tx, NULL, tx_suite_setup, tx_suite_before, NULL, NULL);
```
