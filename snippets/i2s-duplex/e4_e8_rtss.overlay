/* Copyright (C) Alif Semiconductor - All Rights Reserved.
 * Use, distribution and modification of this code is permitted under the
 * terms stated in the Alif Semiconductor Software License Agreement
 *
 * You should have received a copy of the Alif Semiconductor Software
 * License Agreement with this file. If not, please write to:
 * contact@alifsemi.com, or visit: https://alifsemi.com/license
 *
 */

/*
 * I2S_3 : Tested in E8 devkit please short following pins:
 *	J9.0 with J9.3  (loopback SDI with SDO)
 */

i2s_rxtx: &i2s3 {
	status = "okay";
};
