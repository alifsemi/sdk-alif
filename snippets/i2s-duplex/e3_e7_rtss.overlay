/* Copyright (C) Alif Semiconductor - All Rights Reserved.
 * Use, distribution and modification of this code is permitted under the
 * terms stated in the Alif Semiconductor Software License Agreement
 *
 * You should have received a copy of the Alif Semiconductor Software
 * License Agreement with this file. If not, please write to:
 * contact@alifsemi.com, or visit: https://alifsemi.com/license
 *
 */

/*
 * I2S_0 : Tested in E7 devkit please short following pins:
 *	J11.34 with J11.33  (loopback SDI with SDO)
 */

&pinctrl {
	pinctrl_i2s0_B:pinctrl_i2s0_B {
		group0 {
			pinmux = < PIN_P4_1__I2S0_SDI_B >,
				 < PIN_P4_2__I2S0_SDO_B >,
				 < PIN_P4_3__I2S0_SCLK_B >,
				 < PIN_P4_4__I2S0_WS_B >;
			read-enable = <0x1>;
		};
	};
};

i2s_rxtx: &i2s0 {
	pinctrl-0 = <&pinctrl_i2s0_B>;
	status = "okay";
};
