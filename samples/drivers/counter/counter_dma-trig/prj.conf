## CMakeLists.txt
```
# Copyright (C) 2026 Alif Semiconductor - All Rights Reserved.
# Use, distribution and modification of this code is permitted under the
# terms stated in the Alif Semiconductor Software License Agreement
#
# You should have received a copy of the Alif Semiconductor Software
# License Agreement with this file. If not, please write to:
# contact@alifsemi.com, or visit: https://alifsemi.com/license

cmake_minimum_required(VERSION 3.20.0)

# One overlay per board family + DMA instance (HE/HP share when mux is the same).
if(BOARD MATCHES "alif_e8_dk" OR BOARD MATCHES "alif_e7_dk")
	set(DTC_OVERLAY_FILE ${CMAKE_CURRENT_SOURCE_DIR}/boards/lptimer_dma0_e7_e8.overlay)
elseif(BOARD MATCHES "alif_b1_dk" OR BOARD MATCHES "alif_e1c_dk")
	set(DTC_OVERLAY_FILE ${CMAKE_CURRENT_SOURCE_DIR}/boards/lptimer_dma2_b1_e1c.overlay)
endif()

find_package(Zephyr REQUIRED HINTS $ENV{ZEPHYR_BASE})
project(counter_dma_trig)

target_sources(app PRIVATE src/main.c)
```

## sample.yaml
```
sample:
  name: Counter DMA trigger (LPTIMER)
tests:
  sample.drivers.counter.counter_dma_trig.lptimer:
    tags:
      - counter
      - dma
    platform_allow:
      - alif_e7_dk/ae722f80f55d5xx/rtss_he
      - alif_e7_dk/ae722f80f55d5xx/rtss_hp
      - alif_e8_dk/ae822fa0e5597xx0/rtss_he
      - alif_e8_dk/ae822fa0e5597xx0/rtss_hp
      - alif_b1_dk/ab1c1f4m51820ph0/rtss_he
      - alif_e1c_dk/ae1c1f4051920hh/rtss_he
    depends_on:
      - counter
      - dma
    timeout: 40
    harness: console
    harness_config:
      type: one_line
      regex:
        - "LPTIMER DMA trig: PASS"
  sample.drivers.counter.counter_dma_trig.lptimer.dma2:
    tags:
      - counter
      - dma
    platform_allow:
      - alif_e7_dk/ae722f80f55d5xx/rtss_he
      - alif_e8_dk/ae822fa0e5597xx0/rtss_he
    extra_args:
      - EXTRA_DTC_OVERLAY_FILE=boards/lptimer_dma2_e7_e8_he.overlay
    depends_on:
      - counter
      - dma
    build_only: true
```

## prj.conf
```kconfig
CONFIG_PRINTK=y
CONFIG_COUNTER=y
CONFIG_DMA=y
CONFIG_COUNTER_DW_DMA=y
 CONFIG_DMA_PL330=y
CONFIG_SERIAL=y
CONFIG_CONSOLE=y
CONFIG_UART_CONSOLE=y
CONFIG_STDOUT_CONSOLE=y
```

## boards/lptimer_dma0_e7_e8.overlay
```dts
/* Copyright (C) Alif Semiconductor - All Rights Reserved.
 * Use, distribution and modification of this code is permitted under the
 * terms stated in the Alif Semiconductor Software License Agreement
 *
 * You should have received a copy of the Alif Semiconductor Software
 * License Agreement with this file. If not, please write to:
 * contact@alifsemi.com, or visit: https://alifsemi.com/license
 */

/* Note:
 * E7 / E8 HE and HP — DMA0.
 * LPTIMER0 timeout → LPTIMER0_DMA_REQ → DMA0_REQ[0], EVTRTR0 group 1.
 * Handshake 1 (EVTRTR ACK). Second dmas cell is req 5 (negative test).
 */

#include <zephyr/dt-bindings/dma/alif_dma_event_router.h>

&timer0 {
	status = "okay";
	dma-trig;
	dmas = <&evtrtr0 ALIF_DMA_ENCODE(0, 1, 1) 0>,
	       <&evtrtr0 ALIF_DMA_ENCODE(0, 1, 1) 5>;
	dma-names = "rx", "neg";
};

&dma0 {
	status = "okay";
};

&evtrtr0 {
	status = "okay";
};
```

## boards/lptimer_dma2_b1_e1c.overlay
```dts
/* Copyright (C) Alif Semiconductor - All Rights Reserved.
 * Use, distribution and modification of this code is permitted under the
 * terms stated in the Alif Semiconductor Software License Agreement
 *
 * You should have received a copy of the Alif Semiconductor Software
 * License Agreement with this file. If not, please write to:
 * contact@alifsemi.com, or visit: https://alifsemi.com/license
 */

/* Note:
 * B1 / E1C HE — DMA2.
 * LPTIMER0_DMA_REQ → DMA2_REQ[0], EVTRTR2 group 1.
 * Handshake 1 (EVTRTR ACK). Second dmas cell is req 5 (negative test).
 */

#include <zephyr/dt-bindings/dma/alif_dma_event_router.h>

&timer0 {
	status = "okay";
	dma-trig;
	dmas = <&evtrtr2 ALIF_DMA_ENCODE(0, 1, 1) 0>,
	       <&evtrtr2 ALIF_DMA_ENCODE(0, 1, 1) 5>;
	dma-names = "rx", "neg";
};

&dma2 {
	status = "okay";
};

&evtrtr2 {
	status = "okay";
};
```

## boards/lptimer_dma2_e7_e8_he.overlay
```dts
/* Copyright (C) Alif Semiconductor - All Rights Reserved.
 * Use, distribution and modification of this code is permitted under the
 * terms stated in the Alif Semiconductor Software License Agreement
 *
 * You should have received a copy of the Alif Semiconductor Software
 * License Agreement with this file. If not, please write to:
 * contact@alifsemi.com, or visit: https://alifsemi.com/license
 */

/* Note:
 * Extra overlay: E7 / E8 HE only — retarget to DMA2 (not HP: no dma2).
 * Applied on top of lptimer_dma0_e7_e8.overlay.
 *
 *   west build ... -- -DEXTRA_DTC_OVERLAY_FILE=boards/lptimer_dma2_e7_e8_he.overlay
 *
 * LPTIMER0_DMA_REQ → DMA2_REQ[0], EVTRTR2 group 0 (group 1 is LPUTIMER).
 */

#include <zephyr/dt-bindings/dma/alif_dma_event_router.h>

&dma2 {
	status = "okay";
};

&evtrtr2 {
	status = "okay";
};

&timer0 {
	dmas = <&evtrtr2 ALIF_DMA_ENCODE(0, 0, 1) 0>,
	       <&evtrtr2 ALIF_DMA_ENCODE(0, 0, 1) 5>;
	dma-names = "rx", "neg";
};
```

## src/main.c
```c
/* Copyright (C) 2026 Alif Semiconductor - All Rights Reserved.
 * Use, distribution and modification of this code is permitted under the
 * terms stated in the Alif Semiconductor Software License Agreement
 *
 * You should have received a copy of the Alif Semiconductor Software
 * License Agreement with this file. If not, please write to:
 * contact@alifsemi.com, or visit: https://alifsemi.com/license
 */

#include <zephyr/kernel.h>
#include <zephyr/device.h>
#include <zephyr/drivers/counter.h>
#include <zephyr/drivers/dma.h>
#include <zephyr/sys/printk.h>
#include <zephyr/sys/sys_io.h>

#define DELAY_US		2000000
#define TIMER			DT_NODELABEL(timer0)
#define LPTIMER_EOI		0xc
#define LPTIMER_INTSTAT		0x10

#if !DT_NODE_HAS_STATUS_OKAY(TIMER)
#error "Overlay must enable timer0"
#endif
#if !DT_NODE_HAS_PROP(TIMER, dma_trig)
#error "Overlay must set dma-trig on timer0"
#endif
#if !DT_DMAS_HAS_IDX(TIMER, 1)
#error "Overlay needs a second dmas entry (wrong DMA_REQ)"
#endif
#if !IS_ENABLED(CONFIG_COUNTER_DW_DMA)
#error "Enable CONFIG_COUNTER_DW_DMA"
#endif

BUILD_ASSERT(DT_DMAS_CELL_BY_IDX(TIMER, 0, periph) !=
	     DT_DMAS_CELL_BY_IDX(TIMER, 1, periph),
	     "negative dmas entry must not be LPTIMER0_DMA_REQ");

static const struct device *counter_dev = DEVICE_DT_GET(TIMER);
static const struct device *dma_dev = DEVICE_DT_GET(DT_DMAS_CTLR(TIMER));
static const uint32_t dma_channel = DT_DMAS_CELL_BY_IDX(TIMER, 0, channel);
static const uint32_t dma_slot = DT_DMAS_CELL_BY_IDX(TIMER, 0, periph);
static const uint32_t dma_slot_neg = DT_DMAS_CELL_BY_IDX(TIMER, 1, periph);
static const uint32_t timer_base = DT_REG_ADDR(TIMER);

static K_SEM_DEFINE(dma_done, 0, 1);
static volatile int dma_status;
static volatile uint32_t dma_dst;
static volatile uint32_t dma_src = 0xA5A5A5A5U;
static struct dma_block_config block;
static struct dma_config dma_cfg;
static struct counter_top_cfg top_cfg;

static void timer_eoi(void)
{
	(void)sys_read32(timer_base + LPTIMER_EOI);
}

static uint32_t ticks_to_ms(uint32_t ticks)
{
	uint32_t ms = (uint32_t)(counter_ticks_to_us(counter_dev, ticks) /
				 USEC_PER_MSEC);

	return (ms != 0U) ? ms : (DELAY_US / USEC_PER_MSEC);
}

static void print_alarm(uint32_t ticks)
{
	printk("Set alarm in %u sec (%u ticks)\n",
	       (uint32_t)(counter_ticks_to_us(counter_dev, ticks) / USEC_PER_SEC),
	       ticks);
}

static void dma_cb(const struct device *dev, void *user_data,
		   uint32_t channel, int status)
{
	ARG_UNUSED(dev);
	ARG_UNUSED(user_data);
	ARG_UNUSED(channel);

	dma_status = status;
	k_sem_give(&dma_done);
}

static int arm_dma_alarm(uint32_t slot, uint32_t ticks)
{
	int ret;

	dma_dst = 0;
	dma_status = -1;
	dma_cfg.dma_slot = slot;
	k_sem_reset(&dma_done);

	counter_stop(counter_dev);
	timer_eoi();

	ret = dma_config(dma_dev, dma_channel, &dma_cfg);
	if (ret != 0) {
		return ret;
	}

	ret = dma_start(dma_dev, dma_channel);
	if (ret != 0) {
		return ret;
	}

	top_cfg.ticks = ticks;
	return counter_set_top_value(counter_dev, &top_cfg);
}

static int wait_dma_req(uint32_t slot, uint32_t ticks, int32_t wait_ms,
			int64_t *elapsed, uint32_t *status_reg)
{
	int ret;
	int64_t t0;

	ret = arm_dma_alarm(slot, ticks);
	if (ret != 0) {
		return ret;
	}

	t0 = k_uptime_get();
	ret = k_sem_take(&dma_done, K_MSEC(wait_ms));
	*elapsed = k_uptime_get() - t0;
	*status_reg = sys_read32(timer_base + LPTIMER_INTSTAT);
	(void)dma_stop(dma_dev, dma_channel);
	counter_stop(counter_dev);
	return ret;
}

static bool pos_dma_ok(int err, int64_t elapsed, uint32_t alarm_ms,
		       uint32_t status_reg)
{
	return (err == 0) && (dma_status >= 0) &&
	       (elapsed >= (int64_t)(alarm_ms / 2U)) &&
	       (dma_dst == dma_src) && (status_reg != 0U);
}

int main(void)
{
	int err;
	int64_t elapsed;
	uint32_t status_reg;
	uint32_t ticks;
	uint32_t alarm_ms;
	uint32_t now_sec = 0;

	printk("Counter DMA trig (LPTIMER)\n\n");

	if (!device_is_ready(counter_dev) || !device_is_ready(dma_dev)) {
		printk("device not ready.\n");
		return 0;
	}

	ticks = counter_us_to_ticks(counter_dev, DELAY_US);
	if (ticks == 0U) {
		ticks = 1U;
	}

	block.source_address = (uint32_t)&dma_src;
	block.dest_address = (uint32_t)&dma_dst;
	block.block_size = sizeof(dma_dst);
	block.source_addr_adj = DMA_ADDR_ADJ_NO_CHANGE;
	block.dest_addr_adj = DMA_ADDR_ADJ_NO_CHANGE;
	dma_cfg.channel_direction = PERIPHERAL_TO_MEMORY;
	dma_cfg.source_data_size = sizeof(dma_dst);
	dma_cfg.dest_data_size = sizeof(dma_dst);
	dma_cfg.source_burst_length = 1;
	dma_cfg.dest_burst_length = 1;
	dma_cfg.complete_callback_en = 1;
	dma_cfg.block_count = 1;
	dma_cfg.head_block = &block;
	dma_cfg.dma_callback = dma_cb;

	alarm_ms = ticks_to_ms(ticks);
	err = wait_dma_req(dma_slot_neg, ticks,
			   (int32_t)(alarm_ms + (2U * MSEC_PER_SEC)),
			   &elapsed, &status_reg);
	timer_eoi();
	if (err == 0) {
		printk("FAIL: DMA completed on wrong request\n");
		return 0;
	}
	if (status_reg == 0U) {
		printk("FAIL: timeout with no timer pending\n");
		return 0;
	}

	print_alarm(ticks);

	while (1) {
		alarm_ms = ticks_to_ms(ticks);
		err = wait_dma_req(dma_slot, ticks,
				   (int32_t)(alarm_ms + (8U * MSEC_PER_SEC)),
				   &elapsed, &status_reg);
		timer_eoi();

		if (!pos_dma_ok(err, elapsed, alarm_ms, status_reg)) {
			printk("FAIL: DMA alarm\n");
			return 0;
		}

		now_sec += (uint32_t)(elapsed / MSEC_PER_SEC);
		printk("!!! Alarm !!!\n");
		printk("Now: %u\n", now_sec);
		printk("LPTIMER DMA trig: PASS\n");

		ticks = ticks * 2U;
		print_alarm(ticks);
	}
}
```
