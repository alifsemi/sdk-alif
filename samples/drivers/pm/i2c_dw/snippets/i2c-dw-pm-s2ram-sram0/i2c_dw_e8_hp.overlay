/* Copyright (C) 2026 Alif Semiconductor - All Rights Reserved.
 * Use, distribution and modification of this code is permitted under the
 * terms stated in the Alif Semiconductor Software License Agreement
 *
 * You should have received a copy of the Alif Semiconductor Software
 * License Agreement with this file. If not, please write to:
 * contact@alifsemi.com, or visit: https://alifsemi.com/license
 *
 */

/*
 * E8 HP: I2C0 (master) + I2C1 (slave).
 * PM: SRAM0 retention S2RAM (HP, RTC wakeup).
 */

#include "pm_sram0_hp.overlay"

/ {
	aliases {
		master-i2c = &i2c0;
		slave-i2c = &i2c1;
	};
};

&i2c0 {
	status = "okay";
};

&i2c1 {
	status = "okay";
};
