/* Copyright (C) 2026 Alif Semiconductor - All Rights Reserved.
 * Use, distribution and modification of this code is permitted under the
 * terms stated in the Alif Semiconductor Software License Agreement
 *
 * You should have received a copy of the Alif Semiconductor Software
 * License Agreement with this file. If not, please write to:
 * contact@alifsemi.com, or visit: https://alifsemi.com/license
 *
 */

/*
 * E7 HE: I2C0 (master) + I2C1 (slave).
 * PM: TCM boot S2RAM (Ensemble memory masks).
 */

#include "pm_tcm_ensemble.overlay"

/ {
	aliases {
		master-i2c = &i2c0;
		slave-i2c = &i2c1;
	};
};

&i2c0 {
	status = "okay";
};

&i2c1 {
	status = "okay";
};
