/* Copyright (C) 2026 Alif Semiconductor - All Rights Reserved.
 * Use, distribution and modification of this code is permitted under the
 * terms stated in the Alif Semiconductor Software License Agreement
 *
 * You should have received a copy of the Alif Semiconductor Software
 * License Agreement with this file. If not, please write to:
 * contact@alifsemi.com, or visit: https://alifsemi.com/license
 *
 */

/*
 * E7 HP: I2S1 speaker (TX) + I2S3 mic (RX).
 * PM: MRAM boot SOFT_OFF (HP, LPTIMER0 wakeup).
 */

#include "pm_mram_hp.overlay"

i2s_tx: &i2s1 {
	status = "okay";
};

i2s_rx: &i2s3 {
	status = "okay";
};
