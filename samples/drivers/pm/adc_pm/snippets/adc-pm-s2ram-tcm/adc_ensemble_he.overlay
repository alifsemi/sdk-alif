/* Copyright (C) 2026 Alif Semiconductor - All Rights Reserved.
 * Use, distribution and modification of this code is permitted under the
 * terms stated in the Alif Semiconductor Software License Agreement
 *
 * You should have received a copy of the Alif Semiconductor Software
 * License Agreement with this file. If not, please write to:
 * contact@alifsemi.com, or visit: https://alifsemi.com/license
 *
 */

/*
 * Ensemble HE (E7/E8): ADC0 temperature-sensor conversions around PM states.
 * PM: TCM boot S2RAM (Ensemble memory masks).
 */

#include "pm_tcm_ensemble.overlay"

&adc0 {
	status = "okay";
};
