## CMakeLists.txt
```
# Copyright (C) 2026 Alif Semiconductor - All Rights Reserved.
# Use, distribution and modification of this code is permitted under the
# terms stated in the Alif Semiconductor Software License Agreement
#
# You should have received a copy of the Alif Semiconductor Software
# License Agreement with this file. If not, please write to:
# contact@alifsemi.com, or visit: https://alifsemi.com/license


cmake_minimum_required(VERSION 3.20.0)
find_package(Zephyr REQUIRED HINTS $ENV{ZEPHYR_BASE})
project(cam_pm)

target_sources(app PRIVATE src/main.c src/camera.c)
target_include_directories(app PRIVATE src)
```

## Kconfig
```
# Copyright (C) 2026 Alif Semiconductor - All Rights Reserved.
# Use, distribution and modification of this code is permitted under the
# terms stated in the Alif Semiconductor Software License Agreement
#
# You should have received a copy of the Alif Semiconductor Software
# License Agreement with this file. If not, please write to:
# contact@alifsemi.com, or visit: https://alifsemi.com/license


mainmenu "Alif Power Management States with MIPI Camera Demo"

source "Kconfig.zephyr"
```

## sample.yaml
```
sample:
  name: Alif Power Management States Demo
  description: >
    Demonstrates Zephyr power management states (PM_STATE_RUNTIME_IDLE,
    PM_STATE_SUSPEND_TO_IDLE, PM_STATE_SUSPEND_TO_RAM, PM_STATE_SOFT_OFF)
    for Alif RTSS cores. Shows power profile configuration, state transitions
    with RTC wakeup, EWIC low-power mode, and retention behavior differences
    between HP (no retention) and HE (retention supported) cores.
common:
  tags:
    - power
    - pm
    - counter
    - rtc
    - drivers
  filter: SOC_FAMILY_ENSEMBLE
  harness: console
  harness_config:
    type: multi_line
    regex:
      - "CAM PM demo"
      - "POWER STATE SEQUENCE"
      - "PM_STATE_(SUSPEND_TO_RAM|SOFT_OFF)"
tests:
  sample.drivers.devkit.he.arx3a0.tcm:
    platform_allow:
      - alif_e7_dk_rtss_he
      - alif_e8_dk_rtss_he
    integration_platforms:
      - alif_e7_dk_rtss_he
    depends_on:
      - counter
    extra_args:
      - SNIPPET=devkit-he-arx3a0-tcm
  sample.drivers.devkit.hp.arx3a0.mram:
    platform_allow:
      - alif_e7_dk_rtss_hp
      - alif_e8_dk_rtss_hp
    integration_platforms:
      - alif_e7_dk_rtss_hp
    depends_on:
      - counter
    extra_args:
      - SNIPPET=devkit-hp-arx3a0-mram
  sample.drivers.devkit.he.ov5675.tcm:
    platform_allow:
      - alif_e7_dk_rtss_he
      - alif_e8_dk_rtss_he
    integration_platforms:
      - alif_e7_dk_rtss_he
    depends_on:
      - counter
    extra_args:
      - SNIPPET=devkit-he-ov5675-tcm
  sample.drivers.devkit.hp.ov5675.mram:
    platform_allow:
      - alif_e7_dk_rtss_hp
      - alif_e8_dk_rtss_hp
    integration_platforms:
      - alif_e7_dk_rtss_hp
    depends_on:
      - counter
    extra_args:
      - SNIPPET=devkit-hp-ov5675-mram
```

## prj.conf
```kconfig
CONFIG_PM=y
CONFIG_PM_DEVICE_SYSTEM_MANAGED=y
CONFIG_IDLE_STACK_SIZE=16384
CONFIG_MAIN_STACK_SIZE=16384
CONFIG_SYS_CLOCK_TICKS_PER_SEC=1000

CONFIG_COUNTER=y

CONFIG_STDOUT_CONSOLE=y
CONFIG_PRINTK=y
CONFIG_ASSERT=y

CONFIG_LOG=y
CONFIG_LOG_DEFAULT_LEVEL=3
CONFIG_LOG_MODE_DEFERRED=y
CONFIG_LOG_PROCESS_THREAD_SLEEP_MS=5
CONFIG_LOG_BACKEND_UART=y
CONFIG_PM_DEVICE_LOG_LEVEL_WRN=y

# Video/Camera
CONFIG_VIDEO=y
CONFIG_VIDEO_ALIF_CAM_EXTENDED=y
CONFIG_VIDEO_BUFFER_POOL_SZ_MAX=1048576
CONFIG_VIDEO_BUFFER_POOL_NUM_MAX=2
CONFIG_VIDEO_LOG_LEVEL_INF=y
CONFIG_I2C=y
CONFIG_I2C_TARGET=y
CONFIG_I2C_DW_CLOCK_SPEED=100
CONFIG_SYS_HEAP_AUTO=y
CONFIG_VIDEO_MIPI_CSI2_DW=y
CONFIG_MIPI_DPHY_LOG_LEVEL_DBG=y
CONFIG_STDOUT_CONSOLE=y
CONFIG_PRINTK=y
CONFIG_USE_ALIF_ISP_LIB=y
CONFIG_ISP_LIB_SCALAR_MODULE=y
CONFIG_ISP_LIB_DMSC_MODULE=y
CONFIG_ISP_LIB_CCM_MODULE=n
CONFIG_ISP_LIB_WBM_MODULE=n
CONFIG_ISP_LIB_WB_MODULE=n
```

## debug.conf
```kconfig
# Extra instrumentation for tracing the post-S2RAM camera bring-up.
# Build with: -DEXTRA_CONF_FILE=debug.conf
#
# Not for normal runs: immediate logging serialises every message onto the
# UART from the calling context, which noticeably changes timing.

# Immediate logging must stay OFF on this SoC. The console UART sits in
# power_domain_syst, which S2RAM powers down, and there are log call sites on
# the far side of that cut -- power_domain_alif.c emits "Disabled power domain"
# *after* the domain is already gone. In immediate mode that reaches
# uart_ns16550_poll_out, which spins forever on a transmit-ready bit an
# unpowered UART never sets, with interrupts locked. Deferred logging buffers
# instead and the log thread drains it after resume, which is what makes the
# rest of the PM path safe.
CONFIG_LOG_MODE_DEFERRED=y
CONFIG_LOG_MODE_IMMEDIATE=n

# "Disabled power domain N" is INF, but the matching enable and the refcounts
# are DBG only, so the resume side is currently invisible.
CONFIG_POWER_DOMAIN_LOG_LEVEL_DBG=y

# Per-device suspend/resume transitions and their return codes.
CONFIG_PM_DEVICE_LOG_LEVEL_WRN=n
CONFIG_PM_DEVICE_LOG_LEVEL_DBG=y

# Which state the policy picked, and the residency it was offered.
#CONFIG_PM_LOG_LEVEL_DBG=y

# ISP/CPI internals: FIFO moves, stream start/stop, aborted buffers.
CONFIG_VIDEO_LOG_LEVEL_INF=n
CONFIG_VIDEO_LOG_LEVEL_DBG=y
```

## src/main.c
```c
/* Copyright (C) 2026 Alif Semiconductor - All Rights Reserved.
 * Use, distribution and modification of this code is permitted under the
 * terms stated in the Alif Semiconductor Software License Agreement
 *
 * You should have received a copy of the Alif Semiconductor Software
 * License Agreement with this file. If not, please write to:
 * contact@alifsemi.com, or visit: https://alifsemi.com/license
 *
 */

#include <stdio.h>
#include <zephyr/kernel.h>
#include <zephyr/device.h>
#include <zephyr/devicetree.h>
#include <zephyr/init.h>
#include <zephyr/pm/pm.h>
#include <zephyr/pm/policy.h>
#include <zephyr/drivers/counter.h>
#include <string.h>
#include <zephyr/sys/util.h>
#include <zephyr/logging/log.h>
#include "camera.h"
LOG_MODULE_REGISTER(cam_pm, LOG_LEVEL_INF);

/* Set to 1 to dump full NVIC ISPR state on wakeup */
#define APP_PM_WAKEUP_DEBUG 0

#if DT_NODE_HAS_COMPAT_STATUS(DT_NODELABEL(rtc0), snps_dw_apb_rtc, okay)
	#define WAKEUP_SOURCE DT_NODELABEL(rtc0)
#elif DT_NODE_HAS_COMPAT_STATUS(DT_NODELABEL(timer0), snps_dw_timers, okay)
	#define WAKEUP_SOURCE DT_NODELABEL(timer0)
#else
#error "Wakeup Device not enabled in the dts"
#endif

/*
 * Sleep duration constants for each PM state.
 *
 * Upper bound: at 400 MHz, ticks to cycles calculation in PM driver
 * overflows uint32 max for values > 10.7s (2^32 / 400). All deep-sleep
 * durations and overlay min-residency-us values must stay below this ceiling.
 */
/* Sleep duration for PM_STATE_RUNTIME_IDLE */
#define RUNTIME_IDLE_SLEEP_USEC (10 * 1000 * 1000)
/* Sleep duration for PM_STATE_SUSPEND_TO_IDLE */
#define SUSPEND_IDLE_SLEEP_USEC (10 * 1000)
/* Sleep duration for PM_STATE_SUSPEND_TO_RAM substate 0 (STANDBY) */
#define S2RAM_STANDBY_SLEEP_USEC (6 * 1000 * 1000)
/* Sleep duration for PM_STATE_SUSPEND_TO_RAM substate 1 (STOP) */
#define S2RAM_STOP_SLEEP_USEC (9 * 1000 * 1000)
/* Sleep duration for PM_STATE_SOFT_OFF */
#define SOFT_OFF_SLEEP_USEC (10 * 1000 * 1000)

/*
 * MRAM base address - used to determine boot location
 * TCM boot: VTOR = 0x0
 * MRAM boot: VTOR >= 0x80000000
 */
#define MRAM_BASE_ADDRESS 0x80000000

#define IS_BOOTING_FROM_MRAM() (SCB->VTOR >= MRAM_BASE_ADDRESS)

/*
 * True when the DTS chosen zephyr,sram points at sram0. The snippet overlay
 * is responsible for ensuring SRAM0 has retention support on the target board.
 */
#if DT_NODE_EXISTS(DT_NODELABEL(sram0))
#define IS_SRAM0_CONFIGURED_AS_RAM() \
	DT_SAME_NODE(DT_CHOSEN(zephyr_sram), DT_NODELABEL(sram0))
#else
#define IS_SRAM0_CONFIGURED_AS_RAM() 0
#endif

/*
 * S2RAM_SUPPORTED — retention-capable sleep is possible when:
 *   - SRAM0 is the configured data RAM (HE or HP, E8 only), OR
 *   - HE core booting from TCM (TCM has hardware retention)
 *
 * SOFT_OFF_SUPPORTED — mutually exclusive with S2RAM: used when no
 * retained RAM is available (HP-TCM, HE-MRAM boot without SRAM0).
 */
#define S2RAM_SUPPORTED \
	(IS_SRAM0_CONFIGURED_AS_RAM() || \
	 (IS_ENABLED(CONFIG_RTSS_HE) && !IS_BOOTING_FROM_MRAM()))

#define SOFT_OFF_SUPPORTED (!S2RAM_SUPPORTED)

/* Validate ordering of deep-sleep durations at compile time */
BUILD_ASSERT(S2RAM_STOP_SLEEP_USEC > S2RAM_STANDBY_SLEEP_USEC,
	     "STOP sleep duration must be greater than STANDBY sleep duration");
BUILD_ASSERT(SOFT_OFF_SLEEP_USEC > S2RAM_STOP_SLEEP_USEC,
	     "SOFT_OFF sleep duration must be greater than STOP sleep duration");

/**
 * Helper function to lock/unlock deeper power states.
 * @param lock true → lock all deep states (allow RUNTIME_IDLE only)
 *             false → unlock the applicable state; keep the other locked
 */
static void app_pm_lock_deeper_states(bool lock)
{
	if (lock) {
		/*
		 * Lock both deep states unconditionally so PM policy cannot
		 * accidentally enter them during the RUNTIME_IDLE phase, where
		 * the 10 s sleep exceeds the reduced min-residency values.
		 */
		pm_policy_state_lock_get(PM_STATE_SUSPEND_TO_RAM, PM_ALL_SUBSTATES);
		pm_policy_state_lock_get(PM_STATE_SOFT_OFF,       PM_ALL_SUBSTATES);
	} else if (S2RAM_SUPPORTED) {
		pm_policy_state_lock_put(PM_STATE_SUSPEND_TO_RAM, PM_ALL_SUBSTATES);
		/* SOFT_OFF stays locked for the entire demo */
	} else {
		pm_policy_state_lock_put(PM_STATE_SOFT_OFF, PM_ALL_SUBSTATES);
		/* S2RAM stays locked for the entire demo */
	}
}

/*
 * This function will be invoked in the PRE_KERNEL_2 phase of the init routine.
 */
static int app_pre_kernel_init(void)
{
	/* Lock deeper power states to allow only RUNTIME_IDLE */
	app_pm_lock_deeper_states(true);

	return 0;
}

SYS_INIT(app_pre_kernel_init, PRE_KERNEL_2, 0);

#if !defined(CONFIG_CORTEX_M_SYSTICK_LPM_TIMER_COUNTER)
static volatile uint32_t alarm_cb_status;
static void alarm_callback_fn(const struct device *wakeup_dev,
			      uint8_t chan_id, uint32_t ticks,
			      void *user_data)
{
	LOG_DBG("%s: Alarm triggered", wakeup_dev->name);
	alarm_cb_status = 1;
}
#endif

static int app_enter_normal_sleep(uint32_t sleep_usec)
{
	int ret;

	ret = camera_pm_thread_suspend();
	if (ret) {
		LOG_ERR("Failed to suspend camera thread: %d", ret);
		return ret;
	}
	LOG_INF("Camera Capture is Suspended");

#if defined(CONFIG_CORTEX_M_SYSTICK_LPM_TIMER_COUNTER)
	k_sleep(K_USEC(sleep_usec));
#else
	const struct device *const wakeup_dev = DEVICE_DT_GET(WAKEUP_SOURCE);
	struct counter_alarm_cfg alarm_cfg;

	alarm_cfg.flags = 0;
	alarm_cfg.ticks = counter_us_to_ticks(wakeup_dev, sleep_usec);
	alarm_cfg.callback = alarm_callback_fn;
	alarm_cfg.user_data = &alarm_cfg;

	ret = counter_set_channel_alarm(wakeup_dev, 0, &alarm_cfg);
	if (ret) {
		LOG_ERR("Could not set the alarm");
		camera_pm_thread_resume();
		return ret;
	}
	LOG_DBG("Set alarm for %u microseconds", sleep_usec);

	k_sleep(K_USEC(sleep_usec));

	if (!alarm_cb_status) {
		camera_pm_thread_resume();
		return -1;
	}
	alarm_cb_status = 0;

#endif
	return 0;
}

static int app_enter_deep_sleep(uint32_t sleep_usec)
{
	int ret;

	ret = camera_pm_thread_suspend();
	if (ret) {
		LOG_ERR("Failed to suspend camera thread: %d", ret);
		return ret;
	}
	LOG_INF("Camera Capture is Suspended: for Deep Sleep");

#if defined(CONFIG_CORTEX_M_SYSTICK_LPM_TIMER_COUNTER)
	/*
	 * Set a delay more than the min-residency-us configured so that
	 * the sub-system will go to OFF state.
	 */
	k_sleep(K_USEC(sleep_usec));
#else
	const struct device *const wakeup_dev = DEVICE_DT_GET(WAKEUP_SOURCE);
	struct counter_alarm_cfg alarm_cfg;
	/*
	 * Set the alarm and delay so that idle thread can run
	 */
	alarm_cfg.flags = 0;
	alarm_cfg.ticks = counter_us_to_ticks(wakeup_dev, sleep_usec);
	alarm_cfg.callback = alarm_callback_fn;
	alarm_cfg.user_data = &alarm_cfg;
	ret = counter_set_channel_alarm(wakeup_dev, 0, &alarm_cfg);
	if (ret) {
		LOG_ERR("Failed to set the alarm (err %d)", ret);
		camera_pm_thread_resume();
		return ret;
	}

	LOG_DBG("Set alarm for %u microseconds", sleep_usec);
	/*
	 * Wait for the alarm to trigger. The idle thread will
	 * take care of entering the deep sleep state via PM framework.
	 */
	k_sleep(K_USEC(sleep_usec));
#endif
	camera_pm_thread_resume();
	LOG_INF("Camera Capture is Resumed: for Deep Sleep");

	return 0;
}

/* PM state name lookup for notifier logging */
static const char * const pm_state_names[] = {
	[PM_STATE_ACTIVE]          = "ACTIVE",
	[PM_STATE_RUNTIME_IDLE]    = "RUNTIME_IDLE",
	[PM_STATE_SUSPEND_TO_IDLE] = "SUSPEND_TO_IDLE",
	[PM_STATE_STANDBY]         = "STANDBY",
	[PM_STATE_SUSPEND_TO_RAM]  = "SUSPEND_TO_RAM",
	[PM_STATE_SUSPEND_TO_DISK] = "SUSPEND_TO_DISK",
	[PM_STATE_SOFT_OFF]        = "SOFT_OFF",
};

#define PM_STATE_STR(s) \
	((s) < ARRAY_SIZE(pm_state_names) ? pm_state_names[(s)] : "UNKNOWN")

static void pm_notify_entry(enum pm_state state)
{
	const struct pm_state_info *info = pm_state_next_get(0);

	LOG_INF("PM enter: %s (substate %u)", PM_STATE_STR(state), info->substate_id);
}

/*
 * With CONFIG_LOG_MODE_DEFERRED, LOG_INF here only writes to the ring buffer
 * — no UART access — so this is safe even before devices are resumed.
 */
static void pm_notify_pre_resume(enum pm_state state)
{
	const struct pm_state_info *info = pm_state_next_get(0);
	uint32_t active_exc = SCB->ICSR & SCB_ICSR_VECTACTIVE_Msk;

	if (active_exc >= 16U) {
		LOG_INF("PM wakeup: %s (substate %u) IRQ %u",
			PM_STATE_STR(state), info->substate_id, active_exc - 16U);
	} else if (active_exc != 0U) {
		LOG_INF("PM wakeup: %s (substate %u) exception %u",
			PM_STATE_STR(state), info->substate_id, active_exc);
	} else {
		LOG_INF("PM wakeup: %s (substate %u)",
			PM_STATE_STR(state), info->substate_id);
	}
#if APP_PM_WAKEUP_DEBUG
	for (int i = 0; i < 16; i++) {
		if (NVIC->ISPR[i]) {
			LOG_INF("PM wakeup: NVIC ISPR[%d] = 0x%08x", i, NVIC->ISPR[i]);
		}
	}
#endif
}

static void pm_notify_exit(enum pm_state state)
{
	const struct pm_state_info *info = pm_state_next_get(0);

	LOG_INF("PM exit:  %s (substate %u)", PM_STATE_STR(state), info->substate_id);
}

static struct pm_notifier app_pm_notifier = {
	.state_entry       = pm_notify_entry,
	.pre_device_resume = pm_notify_pre_resume,
	.state_exit        = pm_notify_exit,
};

int main(void)
{
	const struct device *const cons = DEVICE_DT_GET(DT_CHOSEN(zephyr_console));
	const struct device *const wakeup_dev = DEVICE_DT_GET(WAKEUP_SOURCE);
	int ret;

	__ASSERT(device_is_ready(cons), "%s: device not ready", cons->name);
	__ASSERT(device_is_ready(wakeup_dev), "%s: device not ready", wakeup_dev->name);

	pm_notifier_register(&app_pm_notifier);

	if (S2RAM_SUPPORTED) {
		LOG_INF("%s (S2RAM): CAM PM demo "
			"(RUNTIME_IDLE, SUSPEND_TO_IDLE, S2RAM STANDBY, S2RAM STOP)",
			CONFIG_BOARD);
	} else {
		LOG_INF("%s (SOFT_OFF): CAM PM demo "
			"(RUNTIME_IDLE, SUSPEND_TO_IDLE, SOFT_OFF)",
			CONFIG_BOARD);
	}

	LOG_INF("CAM: PM states demo WITH Camera Capture");
	camera_pm_thread_init();
	camera_pm_thread_start();

	ret = counter_start(wakeup_dev);
	__ASSERT(!ret || ret == -EALREADY, "Failed to start counter (err %d)", ret);

	LOG_INF("POWER STATE SEQUENCE:");
	LOG_INF("  1. PM_STATE_RUNTIME_IDLE");
	LOG_INF("  2. PM_STATE_SUSPEND_TO_IDLE");
	if (S2RAM_SUPPORTED) {
		LOG_INF("  3. PM_STATE_SUSPEND_TO_RAM (substate 0: STANDBY)");
		LOG_INF("  4. PM_STATE_SUSPEND_TO_RAM (substate 1: STOP)");
	} else {
		LOG_INF("  3. PM_STATE_SOFT_OFF");
	}

	/* Lock SUSPEND_TO_IDLE during CAM and RUNTIME_IDLE to prevent deeper sleep */
	pm_policy_state_lock_get(PM_STATE_SUSPEND_TO_IDLE, PM_ALL_SUBSTATES);

	LOG_INF("Enter RUNTIME_IDLE sleep for (%d microseconds)", RUNTIME_IDLE_SLEEP_USEC);
	ret = app_enter_normal_sleep(RUNTIME_IDLE_SLEEP_USEC);
	__ASSERT(ret == 0, "Could not enter RUNTIME_IDLE sleep (err %d)", ret);

	LOG_INF("Exited from RUNTIME_IDLE sleep");

	camera_pm_thread_resume();
	LOG_INF("Camera Capture is starting...");
	ret = camera_pm_wait_capture_done();
	__ASSERT(ret == 0, "Camera capture did not complete successfully (err %d)", ret);
	LOG_INF("Camera Capture cycle completed");

	pm_policy_state_lock_put(PM_STATE_SUSPEND_TO_IDLE, PM_ALL_SUBSTATES);

#if defined(CONFIG_CORTEX_M_SYSTICK_LPM_TIMER_COUNTER)
	LOG_INF("Enter PM_STATE_SUSPEND_TO_IDLE for (%d microseconds)",
		SUSPEND_IDLE_SLEEP_USEC);
	k_sleep(K_USEC(SUSPEND_IDLE_SLEEP_USEC));
	LOG_INF("Exited from PM_STATE_SUSPEND_TO_IDLE");
	pm_policy_state_lock_get(PM_STATE_SUSPEND_TO_IDLE, PM_ALL_SUBSTATES);
	pm_policy_state_lock_put(PM_STATE_SUSPEND_TO_IDLE, PM_ALL_SUBSTATES);
#else
	/* Lock SUSPEND_TO_IDLE when LPM timer support is not configured */
	pm_policy_state_lock_get(PM_STATE_SUSPEND_TO_IDLE, PM_ALL_SUBSTATES);
	LOG_INF("PM_STATE_SUSPEND_TO_IDLE (skipped - LPM timer not enabled)");
#endif

	/* Unlock deeper power states to allow S2RAM and/or SOFT_OFF */
	app_pm_lock_deeper_states(false);

	if (S2RAM_SUPPORTED) {
		LOG_INF("Enter PM_STATE_SUSPEND_TO_RAM (substate 0: STANDBY) for (%d microseconds)",
			S2RAM_STANDBY_SLEEP_USEC);
		ret = app_enter_deep_sleep(S2RAM_STANDBY_SLEEP_USEC);
		__ASSERT(ret == 0, "Could not enter PM_STATE_SUSPEND_TO_RAM (err %d)", ret);

		LOG_INF("=== Resumed from PM_STATE_SUSPEND_TO_RAM (substate 0: STANDBY) ===");
		ret = camera_pm_wait_capture_done();
		__ASSERT(ret == 0, "Camera capture after STANDBY did not complete (err %d)",
			 ret);
		LOG_INF("Camera Capture cycle completed (after STANDBY)");
		/* Verify main thread is running properly */
		for (int i = 0; i < 3; i++) {
			LOG_INF("Main thread running - iteration %d - tick: %llu",
				i, k_uptime_ticks());
			k_sleep(K_SECONDS(2));
		}
		pm_policy_state_lock_get(PM_STATE_SUSPEND_TO_IDLE, PM_ALL_SUBSTATES);
		pm_policy_state_lock_put(PM_STATE_SUSPEND_TO_IDLE, PM_ALL_SUBSTATES);

		LOG_INF("Enter PM_STATE_SUSPEND_TO_RAM (substate 1: STOP) for (%d microseconds)",
			S2RAM_STOP_SLEEP_USEC);
		ret = app_enter_deep_sleep(S2RAM_STOP_SLEEP_USEC);
		__ASSERT(ret == 0, "Could not enter PM_STATE_SUSPEND_TO_RAM (err %d)", ret);

		LOG_INF("=== Resumed from PM_STATE_SUSPEND_TO_RAM (substate 1: STOP) ===");

		ret = camera_pm_wait_capture_done();
		__ASSERT(ret == 0, "Camera capture after STOP did not complete (err %d)", ret);
		LOG_INF("Camera Capture cycle completed (after STOP)");

		/* Verify main thread is running properly */
		for (int i = 0; i < 3; i++) {
			LOG_INF("Main thread running - iteration %d - tick: %llu",
				i, k_uptime_ticks());
			k_sleep(K_SECONDS(2));
		}
		pm_policy_state_lock_get(PM_STATE_SUSPEND_TO_IDLE, PM_ALL_SUBSTATES);
		pm_policy_state_lock_put(PM_STATE_SUSPEND_TO_IDLE, PM_ALL_SUBSTATES);
	}

	if (SOFT_OFF_SUPPORTED) {
		LOG_INF("Enter PM_STATE_SOFT_OFF for (%d microseconds)", SOFT_OFF_SLEEP_USEC);
		LOG_INF("Note: SOFT_OFF has no retention - system will reset on wakeup");
		ret = app_enter_deep_sleep(SOFT_OFF_SLEEP_USEC);
		__ASSERT(ret == 0, "Could not enter PM_STATE_SOFT_OFF (err %d)", ret);
		LOG_INF("=== Resumed from PM_STATE_SOFT_OFF ===");

		/* Should never reach here - SOFT_OFF causes full reset on wakeup */
		LOG_ERR("ERROR: Resumed after PM_STATE_SOFT_OFF - this should not happen!");
		__ASSERT(false, "PM_STATE_SOFT_OFF should have caused a reset");
	}

		LOG_INF("=== CAM PM SEQUENCE COMPLETED ===");

		camera_pm_thread_stop();
		LOG_INF("Camera Capture is Stopped (PM sequence done)");

		app_pm_lock_deeper_states(true);
		/* Demo complete — prevent SUSPEND_TO_IDLE so the idle spin
		 * stays in RUNTIME_IDLE
		 */
		pm_policy_state_lock_get(PM_STATE_SUSPEND_TO_IDLE, PM_ALL_SUBSTATES);

		while (true) {
			/* spin here */
			k_sleep(K_SECONDS(1));
		}

	return 0;
}
```

## src/camera.c
```c
/* Copyright (C) 2026 Alif Semiconductor - All Rights Reserved.
 * Use, distribution and modification of this code is permitted under the
 * terms stated in the Alif Semiconductor Software License Agreement
 *
 * You should have received a copy of the Alif Semiconductor Software
 * License Agreement with this file. If not, please write to:
 * contact@alifsemi.com, or visit: https://alifsemi.com/license
 *
 */

#include <zephyr/kernel.h>
#include <zephyr/device.h>
#include <zephyr/devicetree.h>
#include <errno.h>
#include <string.h>
#include <zephyr/drivers/video.h>
#include <zephyr/drivers/gpio.h>
#include <soc_common.h>
#include <se_service.h>
#include <zephyr/drivers/video/video_alif.h>
#include <zephyr/pm/policy.h>
#include <zephyr/logging/log.h>

#include "camera.h"

LOG_MODULE_DECLARE(cam_pm, LOG_LEVEL_DBG);

/* Number of frames to capture per PM cycle */
#define N_FRAMES		10
#ifdef CONFIG_DT_HAS_OVTI_OV5675_ENABLED
#define N_VID_BUFF		2
#else
#define N_VID_BUFF		2
#endif

/* ISP enabled check */
#define ISP_ENABLED DT_NODE_HAS_STATUS_OKAY(DT_NODELABEL(isp))

/* Pipeline format */
#define PIPELINE_FORMAT	VIDEO_PIX_FMT_Y10P

#if ISP_ENABLED
#define OUTPUT_FORMAT	VIDEO_PIX_FMT_RGB888_PLANAR_PRIVATE
#endif

#if (CONFIG_VIDEO_ALIF_CAM_EXTENDED && CONFIG_VIDEO_MIPI_CSI2_DW)
#define NUM_CAMS DT_PROP_LEN(DT_NODELABEL(csi), phy_if)
#else
#define NUM_CAMS 1
#endif

/* size of stack area used by each thread */
#define STACKSIZE 4096

/* Thread Priority */
#define CAMERA_PRIORITY 7

K_THREAD_STACK_DEFINE(CameraT_stack, STACKSIZE);
static struct k_thread thread_camera;

/* Semaphore for PM suspend/resume synchronization */
K_SEM_DEFINE(camera_pm_resume_sem, 0, 1);

/* Semaphore to signal that camera thread has suspended */
K_SEM_DEFINE(camera_pm_suspended_sem, 0, 1);

/* Semaphore to signal that a capture cycle has completed */
K_SEM_DEFINE(camera_capture_done_sem, 0, 1);

/* Thread control flags */
static volatile uint8_t THREAD_TO_BE_SUSPEND;
static volatile uint8_t THREAD_SUSPENDED;
static volatile uint8_t THREAD_TO_BE_STOPPED;

/* Video buffers */
static struct video_buffer *buffers[N_VID_BUFF];

/* Video format */
static struct video_format fmt;

#if ISP_ENABLED
static struct video_format input_fmt;
#endif

/* Video device */
static const struct device *video_dev;

/* Tracks whether capture was active when the PM suspend was requested,
 * so we only auto-restart capture on resume if it was streaming before.
 */
static bool was_streaming;

static bool capture_active;

/* Result of the last capture cycle, reported by camera_pm_wait_capture_done() */
static int capture_result;

static int fourcc_to_pitch(uint32_t fourcc, uint32_t width)
{
	int pitch;

	switch (fourcc) {
	case VIDEO_PIX_FMT_RGB888_PLANAR_PRIVATE:
	case VIDEO_PIX_FMT_NV24:
	case VIDEO_PIX_FMT_NV42:
		pitch = width * 3;
		break;
	case VIDEO_PIX_FMT_RGB565:
	case VIDEO_PIX_FMT_Y10P:
	case VIDEO_PIX_FMT_BGGR10:
	case VIDEO_PIX_FMT_GBRG10:
	case VIDEO_PIX_FMT_GRBG10:
	case VIDEO_PIX_FMT_RGGB10:
	case VIDEO_PIX_FMT_BGGR12:
	case VIDEO_PIX_FMT_GBRG12:
	case VIDEO_PIX_FMT_GRBG12:
	case VIDEO_PIX_FMT_RGGB12:
	case VIDEO_PIX_FMT_BGGR14:
	case VIDEO_PIX_FMT_GBRG14:
	case VIDEO_PIX_FMT_GRBG14:
	case VIDEO_PIX_FMT_RGGB14:
	case VIDEO_PIX_FMT_BGGR16:
	case VIDEO_PIX_FMT_GBRG16:
	case VIDEO_PIX_FMT_GRBG16:
	case VIDEO_PIX_FMT_RGGB16:
	case VIDEO_PIX_FMT_Y10:
	case VIDEO_PIX_FMT_Y12:
	case VIDEO_PIX_FMT_Y14:
	case VIDEO_PIX_FMT_YUYV:
	case VIDEO_PIX_FMT_YVYU:
	case VIDEO_PIX_FMT_VYUY:
	case VIDEO_PIX_FMT_UYVY:
	case VIDEO_PIX_FMT_NV16:
	case VIDEO_PIX_FMT_NV61:
	case VIDEO_PIX_FMT_YUV422P:
		pitch = width << 1;
		break;
	case VIDEO_PIX_FMT_NV12:
	case VIDEO_PIX_FMT_NV21:
	case VIDEO_PIX_FMT_YUV420:
	case VIDEO_PIX_FMT_YVU420:
		pitch = (width * 3) >> 1;
		break;
	case VIDEO_PIX_FMT_BGGR8:
	case VIDEO_PIX_FMT_GBRG8:
	case VIDEO_PIX_FMT_GRBG8:
	case VIDEO_PIX_FMT_RGGB8:
	case VIDEO_PIX_FMT_GREY:
	default:
		pitch = width;
		break;
	}

	return pitch;
}

/*
 * Initialize camera and allocate buffers (called once at startup)
 */
static int camera_init(void)
{
	struct video_caps caps[NUM_CAMS];
	enum video_endpoint_id ep;
	size_t bsize;
	int ret;
	int i = 0;
	int loop_ctr;

#if (CONFIG_VIDEO_ALIF_CAM_EXTENDED && CONFIG_VIDEO_MIPI_CSI2_DW)
	uint8_t current_sensor;
#endif

#if ISP_ENABLED
	video_dev = DEVICE_DT_GET_ONE(vsi_isp_pico);
#else
	video_dev = DEVICE_DT_GET_ONE(alif_cam);
#endif

	if (!device_is_ready(video_dev)) {
		LOG_ERR("%s: device not ready.", video_dev->name);
		return -1;
	}
	LOG_INF("- Device name: %s", video_dev->name);

	for (loop_ctr = NUM_CAMS - 1; loop_ctr >= 0; loop_ctr--) {
		/* Reset both index AND fmt for each camera */
		i = 0;
		memset(&fmt, 0, sizeof(fmt));
#if (CONFIG_VIDEO_ALIF_CAM_EXTENDED && CONFIG_VIDEO_MIPI_CSI2_DW)
		ret = video_get_ctrl(video_dev, VIDEO_CID_ALIF_CSI_CURR_CAM, &current_sensor);
		if (ret) {
			LOG_ERR("Failed to get current camera!");
			return ret;
		}
		LOG_INF("Selected camera: %s", (current_sensor) ? "Standard" : "Selfie");
#endif

		if (IS_ENABLED(ISP_ENABLED)) {
			ep = VIDEO_EP_IN;
		} else {
			ep = VIDEO_EP_OUT;
		}

		/* Get capabilities */
		if (video_get_caps(video_dev, ep, &caps[loop_ctr])) {
			LOG_ERR("Unable to retrieve video capabilities");
			return -1;
		}

		LOG_INF("- Capabilities:");
		while (caps[loop_ctr].format_caps[i].pixelformat) {
			const struct video_format_cap *fcap = &caps[loop_ctr].format_caps[i];

			LOG_INF("  %c%c%c%c width (min, max, step)[%u; %u; %u] "
				"height (min, max, step)[%u; %u; %u]",
			       (char)fcap->pixelformat,
			       (char)(fcap->pixelformat >> 8),
			       (char)(fcap->pixelformat >> 16),
			       (char)(fcap->pixelformat >> 24),
			       fcap->width_min, fcap->width_max, fcap->width_step,
			       fcap->height_min, fcap->height_max, fcap->height_step);
			if (fcap->pixelformat == PIPELINE_FORMAT) {
				fmt.pixelformat = PIPELINE_FORMAT;
				fmt.width = fcap->width_min;
				fmt.height = fcap->height_min;
			}
			i++;
		}

		if (fmt.pixelformat == 0) {
			LOG_ERR("Desired Pixel format is not supported.");
			return -1;
		}

		fmt.pitch = fourcc_to_pitch(fmt.pixelformat, fmt.width);

		LOG_INF("Setting format: %c%c%c%c %ux%u pitch=%d on ep=%d",
			(char)fmt.pixelformat,
			(char)(fmt.pixelformat >> 8),
			(char)(fmt.pixelformat >> 16),
			(char)(fmt.pixelformat >> 24),
			fmt.width, fmt.height, fmt.pitch, ep);

		ret = video_set_format(video_dev, ep, &fmt);
		if (ret) {
			LOG_ERR("Failed to set video format. ret - %d", ret);
			return -1;
		}

#if ISP_ENABLED
		if (ep == VIDEO_EP_IN) {
			input_fmt = fmt;
		}
#endif

#if (CONFIG_VIDEO_ALIF_CAM_EXTENDED && CONFIG_VIDEO_MIPI_CSI2_DW)
		if (NUM_CAMS > 1) {
			current_sensor ^= 1;
			ret = video_set_ctrl(video_dev, VIDEO_CID_ALIF_CSI_CURR_CAM,
					     &current_sensor);
			if (ret) {
				LOG_ERR("Unable to switch camera!");
			}
		}
#endif
	}

#if ISP_ENABLED
	/* Set Output Endpoint format for ISP */
	fmt.pixelformat = OUTPUT_FORMAT;
	fmt.width = 480;
	fmt.height = 480;
	fmt.pitch = fourcc_to_pitch(fmt.pixelformat, fmt.width);

	ret = video_set_format(video_dev, VIDEO_EP_OUT, &fmt);
	if (ret) {
		LOG_ERR("Failed to set video format. ret - %d", ret);
		return -1;
	}
#endif

	LOG_INF("- format: %c%c%c%c %ux%u",
		(char)fmt.pixelformat,
		(char)(fmt.pixelformat >> 8),
		(char)(fmt.pixelformat >> 16),
		(char)(fmt.pixelformat >> 24),
		fmt.width, fmt.height);

	/* Size to allocate for each buffer */
	bsize = fmt.pitch * fmt.height;

	LOG_INF("Width - %u, Pitch - %u, Height - %u, Buff size - %u",
		fmt.width, fmt.pitch, fmt.height, (uint32_t)bsize);

#if (CONFIG_VIDEO_ALIF_CAM_EXTENDED && CONFIG_VIDEO_MIPI_CSI2_DW)
	if (NUM_CAMS > 1) {
		current_sensor = 0;
		ret = video_set_ctrl(video_dev, VIDEO_CID_ALIF_CSI_CURR_CAM,
				     &current_sensor);
		if (ret) {
			LOG_ERR("Unable to switch camera!");
		}
	}
#endif

	/* Alloc video buffers and enqueue for capture */
	for (i = 0; i < ARRAY_SIZE(buffers); i++) {
		buffers[i] = video_buffer_alloc(bsize, K_NO_WAIT);
		if (buffers[i] == NULL) {
			LOG_ERR("Unable to alloc video buffer");
			return -1;
		}

		LOG_INF("- addr - 0x%x, size - %u, bytesused - %u",
			(uint32_t)buffers[i]->buffer,
			(uint32_t)bsize,
			buffers[i]->bytesused);

		memset(buffers[i]->buffer, 0, bsize);
		video_enqueue(video_dev, VIDEO_EP_OUT, buffers[i]);

		LOG_INF("capture buffer[%d]: dump binary memory "
			"\"/home/$USER/capture_%d.bin\" 0x%08x 0x%08x -r",
			i, i, (uint32_t)buffers[i]->buffer,
			(uint32_t)buffers[i]->buffer + bsize - 1);
	}

	/* Wait for camera sensor to stabilize */
	k_msleep(7000);

	return 0;
}

/*
 * Camera capture thread function
 */
static void camera_capture_thread(void *p1, void *p2, void *p3)
{
	struct video_buffer *vbuf;
	unsigned int frame = 0;
	uint32_t last_timestamp = 0;
	uint32_t frame_time = 0;
	uint32_t fps_x10 = 0;
	size_t bsize;
	int ret;
	int cycle_ret;
	int i, j;
	bool pm_locks_held = false;

	ARG_UNUSED(p1);
	ARG_UNUSED(p2);
	ARG_UNUSED(p3);

	if (!was_streaming) {
		LOG_INF("skip starting a new capture cycle this round");
	}

	/* Initialize camera */
	ret = camera_init();
	if (ret) {
		LOG_ERR("Camera initialization failed: %d", ret);
		return;
	}

	bsize = fmt.pitch * fmt.height;

	while (1) {
		/* Check if thread should be stopped (PM sequence done) */
		if (THREAD_TO_BE_STOPPED) {
			LOG_INF("Camera: thread stopping (PM sequence completed)");
			return;
		}

		/* Re-enqueue buffers for capture */
		if (!capture_active) {
			/*
			 * Check if thread should be suspended (PM cycle).
			 * Only suspend when capture is not active.
			 */
			if (THREAD_TO_BE_SUSPEND) {
				THREAD_SUSPENDED = 1;
				LOG_INF("Camera: putting thread into wait for PM resume");

				/* Signal that we are now suspended */
				k_sem_give(&camera_pm_suspended_sem);

				/* Block on semaphore - does not wake system like k_msleep */
				k_sem_take(&camera_pm_resume_sem, K_FOREVER);

				/* Check if we were woken to stop rather than resume */
				if (THREAD_TO_BE_STOPPED) {
					LOG_INF("Camera: thread stopping (suspend)");
					return;
				}

				LOG_INF("Camera: Woken up by PM resume");
				THREAD_SUSPENDED = 0;

				/*
				 * Lock idle and deep PM states during camera
				 * resume. SUSPEND_TO_IDLE (IWIC) would otherwise
				 * fire on sensor re-init sleeps and break D-PHY/ISP.
				 */
				pm_policy_state_lock_get(PM_STATE_SUSPEND_TO_IDLE,
							 PM_ALL_SUBSTATES);
				pm_policy_state_lock_get(PM_STATE_SUSPEND_TO_RAM,
							 PM_ALL_SUBSTATES);
				pm_policy_state_lock_get(PM_STATE_SOFT_OFF,
							 PM_ALL_SUBSTATES);
				pm_locks_held = true;

				/* The PM framework already ran SUSPEND/RESUME on
				 * every PM device in dependency order, so the
				 * DPHY, CSI2, CPI and sensor are usable by the
				 * time we get here. Only the pipeline format has
				 * to be re-applied to start a new capture cycle.
				 */
#if ISP_ENABLED
				/* Re-apply input format (pipeline/sensor format) */
				ret = video_set_format(video_dev, VIDEO_EP_IN, &input_fmt);
				if (ret) {
					LOG_ERR("Failed to re-set ISP input format: %d", ret);
				}
#endif
				ret = video_set_format(video_dev, VIDEO_EP_OUT, &fmt);
				if (ret) {
					LOG_ERR("Failed to re-set video format: %d", ret);
				}
				LOG_INF("Waiting for sensor to stabilize...");
				k_msleep(1000);
			}

			/* Flush any stale buffers from driver FIFOs before re-enqueue.
			 * Buffers from camera_init() are still in fifo_in since
			 * streaming was never started before suspend.
			 */
			/* cancel=true to drain immediately */
			video_flush(video_dev, VIDEO_EP_OUT, true);

			/* Drain buffers that flush moved to fifo_out.
			 * Without this, re-enqueueing them into fifo_in causes
			 * the same buffer nodes to be in both FIFOs, corrupting
			 * the linked lists.
			 */
			{
				struct video_buffer *tmp;

			while (video_dequeue(video_dev, VIDEO_EP_OUT,
					     &tmp, K_NO_WAIT) == 0) {
				/* Just drain - already tracked in buffers[] */
				}
			}

			/* Clear and re-enqueue all buffers */
			for (i = 0; i < ARRAY_SIZE(buffers); i++) {
				if (buffers[i] != NULL) {
					memset(buffers[i]->buffer, 0,
					       sizeof(char) * bsize);
					buffers[i]->timestamp = 0;
					buffers[i]->bytesused = 0;
					video_enqueue(video_dev, VIDEO_EP_OUT,
						      buffers[i]);
				}
			}

			/* Start video capture */
			ret = video_stream_start(video_dev);
			if (ret) {
				LOG_ERR("Unable to start capture: %d", ret);
				/* Leave the video device in a known state on start failure. */
				video_stream_stop(video_dev);
				video_flush(video_dev, VIDEO_EP_OUT, true);
				/* Release PM policy locks acquired earlier before exiting. */
				if (pm_locks_held) {
					pm_policy_state_lock_put(PM_STATE_SUSPEND_TO_IDLE,
								 PM_ALL_SUBSTATES);
					pm_policy_state_lock_put(PM_STATE_SUSPEND_TO_RAM,
								 PM_ALL_SUBSTATES);
					pm_policy_state_lock_put(PM_STATE_SOFT_OFF,
								 PM_ALL_SUBSTATES);
					pm_locks_held = false;
				}

				/* Report the failure so the waiter fails fast
				 * instead of blocking for the full timeout.
				 */
				capture_result = ret;
				k_sem_give(&camera_capture_done_sem);

				return;
			}

			LOG_INF("Capture started");
			frame = 0;
			last_timestamp = 0;
			capture_active = true;
		}

		/*
		 * Bounded capture loop matching working main.c pattern:
		 * - Dequeue each frame
		 * - Re-enqueue only for first (N_FRAMES - N_VID_BUFF) frames
		 * - Let ISP IN-FIFO drain for last N_VID_BUFF frames
		 */
		cycle_ret = 0;

		for (j = 0; j < N_FRAMES; j++) {
			if (THREAD_TO_BE_SUSPEND) {
				LOG_INF("Camera: suspend requested mid-capture, breaking");
				cycle_ret = -ECANCELED;
				break;
			}
			ret = video_dequeue(video_dev, VIDEO_EP_OUT, &vbuf, K_MSEC(2000));

			if (ret) {
				LOG_ERR("Unable to dequeue video buf: %d", ret);
				cycle_ret = ret;
				break;
			}

			LOG_INF("Got frame %u! size: %u; timestamp %u ms",
				frame++, vbuf->bytesused, vbuf->timestamp);

			/*
			 * Skip FPS for first N_VID_BUFF frames: these are
			 * stale ISP pipeline-flush frames with bogus
			 * timestamps (dequeued almost instantly).
			 */
			if (j < N_VID_BUFF) {
				last_timestamp = vbuf->timestamp;
			} else if (last_timestamp == 0) {
				LOG_INF("FPS: 0");
				last_timestamp = vbuf->timestamp;
			} else {
				frame_time = vbuf->timestamp - last_timestamp;
				last_timestamp = vbuf->timestamp;
				if (frame_time > 0) {
					fps_x10 = 10000U / frame_time;
					LOG_INF("FPS: %u.%u", fps_x10 / 10U, fps_x10 % 10U);
				} else {
					LOG_INF("FPS: N/A (same timestamp)");
				}
			}

			if (j < N_FRAMES - N_VID_BUFF) {
				ret = video_enqueue(video_dev, VIDEO_EP_OUT, vbuf);
				if (ret) {
					LOG_ERR("Unable to requeue video buf: %d",
						ret);
					cycle_ret = ret;
					break;
				}

				ret = video_stream_start(video_dev);
				if (ret && ret != -EBUSY) {
					LOG_ERR("Unable to restart capture: %d",
						ret);
					cycle_ret = ret;
					break;
				}
			}
		}

		/* Drain and stop: matching working main.c sequence */
		LOG_INF("Calling video flush.");
		video_flush(video_dev, VIDEO_EP_OUT, true);
		LOG_INF("Flush done.");

		LOG_INF("Calling video stream stop.");
		ret = video_stream_stop(video_dev);
		if (ret) {
			LOG_ERR("Unable to stop capture: %d", ret);
		}
		LOG_INF("Stream stop done.");

		/* Release PM state locks AFTER capture is fully done */
		if (pm_locks_held) {
			pm_policy_state_lock_put(PM_STATE_SOFT_OFF, PM_ALL_SUBSTATES);
			pm_policy_state_lock_put(PM_STATE_SUSPEND_TO_RAM, PM_ALL_SUBSTATES);
			pm_policy_state_lock_put(PM_STATE_SUSPEND_TO_IDLE, PM_ALL_SUBSTATES);
			pm_locks_held = false;
		}

		/* Wait for hardware to fully reset */
		k_msleep(100);

		capture_active = false;

		if (cycle_ret == 0 && frame < N_FRAMES) {
			LOG_ERR("Capture produced only %u of %u frames", frame,
				(unsigned int)N_FRAMES);
			cycle_ret = -EIO;
		}

		LOG_INF("Capture completed after %u frames, waiting for PM cycle",
			frame);

		/* Signal main thread that the capture cycle is done, carrying
		 * the outcome so a truncated cycle is not reported as success.
		 */
		capture_result = cycle_ret;
		k_sem_give(&camera_capture_done_sem);

		/* Wait for next PM suspend/resume cycle instead of free-running.
		 * Without this, the thread starts unsolicited captures without
		 * PM lock protection, which can corrupt hardware state if the
		 * system enters deep sleep mid-capture.
		 */
		THREAD_TO_BE_SUSPEND = 1;
	}
}

int camera_pm_thread_init(void)
{
	k_tid_t tid = k_thread_create(&thread_camera, CameraT_stack, STACKSIZE,
			&camera_capture_thread, NULL, NULL, NULL,
			CAMERA_PRIORITY, 0, K_FOREVER);
	if (tid == NULL) {
		LOG_ERR("Error creating Camera Thread");
		return -1;
	}

	return 0;
}

int camera_pm_thread_start(void)
{
	/* Stay suspended until main explicitly resumes after the first PM cycle. */
	THREAD_TO_BE_SUSPEND = 1;
	THREAD_SUSPENDED = 0;

	k_thread_start(&thread_camera);
	return 0;
}

int camera_pm_thread_suspend(void)
{
	int ret;

	if (THREAD_SUSPENDED) {
		return 0;
	}

	was_streaming = capture_active;
	THREAD_TO_BE_SUSPEND = 1;

	ret = k_sem_take(&camera_pm_suspended_sem, K_SECONDS(30));
	if (ret) {
		LOG_ERR("Camera thread did not acknowledge suspend (err: %d)", ret);
		return ret;
	}
	LOG_INF("Camera thread is now suspended (polling for resume)");

	/* The PM framework suspends the video devices as part of the system
	 * state transition, so nothing else is needed here.
	 */
	return 0;
}

int camera_pm_thread_resume(void)
{
	LOG_INF("Camera: Try to Resume...");

	/* Reset stale signal from interrupted capture cycles */
	k_sem_reset(&camera_capture_done_sem);
	capture_result = 0;

	/* Clear the suspend flag and signal semaphore to wake thread */
	THREAD_TO_BE_SUSPEND = 0;
	k_sem_give(&camera_pm_resume_sem);

	LOG_INF("Camera: resume signal sent");
	return 0;
}

int camera_pm_thread_stop(void)
{
	int ret;

	LOG_INF("Camera: requesting thread stop");

	THREAD_TO_BE_STOPPED = 1;

	/* Also clear suspend flag in case thread is currently suspended */
	THREAD_TO_BE_SUSPEND = 0;

	/* Wake thread if blocked on resume semaphore so it can check stop flag */
	k_sem_give(&camera_pm_resume_sem);

	/* Wait for thread to finish */
	ret = k_thread_join(&thread_camera, K_SECONDS(5));
	if (ret != 0) {
		LOG_ERR("Camera: thread join failed or timed out (err: %d)", ret);
		return ret;
	}

	LOG_INF("Camera: thread stopped");
	return 0;
}

int camera_pm_wait_capture_done(void)
{
	int ret = k_sem_take(&camera_capture_done_sem, K_SECONDS(30));

	if (ret) {
		return ret;
	}

	/* The cycle may have ended early on a pipeline error, so report the
	 * outcome instead of the mere fact that the thread finished.
	 */
	return capture_result;
}
```

## src/camera.h
```c
/* Copyright (C) 2026 Alif Semiconductor - All Rights Reserved.
 * Use, distribution and modification of this code is permitted under the
 * terms stated in the Alif Semiconductor Software License Agreement
 *
 * You should have received a copy of the Alif Semiconductor Software
 * License Agreement with this file. If not, please write to:
 * contact@alifsemi.com, or visit: https://alifsemi.com/license
 *
 */

#ifndef CAMERA_H_
#define CAMERA_H_

int camera_pm_thread_init(void);
int camera_pm_thread_start(void);
int camera_pm_thread_suspend(void);
int camera_pm_thread_resume(void);
int camera_pm_thread_stop(void);
int camera_pm_wait_capture_done(void);

#endif /* CAMERA_H_ */
```

## src/camera_test.h
```c
/* Copyright (C) 2026 Alif Semiconductor - All Rights Reserved.
 * Use, distribution and modification of this code is permitted under the
 * terms stated in the Alif Semiconductor Software License Agreement
 *
 * You should have received a copy of the Alif Semiconductor Software
 * License Agreement with this file. If not, please write to:
 * contact@alifsemi.com, or visit: https://alifsemi.com/license
 *
 */

#ifndef CAMERA_TEST_H_
#define CAMERA_TEST_H_

int camera_pm_thread_init(void);
int camera_pm_thread_start(void);
int camera_pm_thread_suspend(void);
int camera_pm_thread_resume(void);
int camera_pm_thread_stop(void);
int camera_pm_wait_capture_done(void);

#endif /* CAMERA_TEST_H_ */
```
