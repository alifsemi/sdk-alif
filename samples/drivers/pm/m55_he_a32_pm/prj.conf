## CMakeLists.txt
```
# Copyright (C) 2024 Alif Semiconductor - All Rights Reserved.
# Use, distribution and modification of this code is permitted under the
# terms stated in the Alif Semiconductor Software License Agreement
#
# You should have received a copy of the Alif Semiconductor Software
# License Agreement with this file. If not, please write to:
# contact@alifsemi.com, or visit: https://alifsemi.com/license


cmake_minimum_required(VERSION 3.20.0)
find_package(Zephyr REQUIRED HINTS $ENV{ZEPHYR_BASE})
project(m55_he_a32_pm)

target_include_directories(app PRIVATE include)
target_sources(app PRIVATE src/main.c src/a32_mhu.c)
```

## Kconfig
```
# Copyright (C) 2024 Alif Semiconductor - All Rights Reserved.
# Use, distribution and modification of this code is permitted under the
# terms stated in the Alif Semiconductor Software License Agreement
#
# You should have received a copy of the Alif Semiconductor Software
# License Agreement with this file. If not, please write to:
# contact@alifsemi.com, or visit: https://alifsemi.com/license


mainmenu "Alif A32 Power Management States via m55-he Demo"

source "Kconfig.zephyr"
```

## sample.yaml
```
sample:
  name: Alif M55-HE A32 cluster power-off
  description: >
    M55-HE asks Linux/TF-A to power down the A32 cluster over MHU0,
    then enters PM_STATE_SUSPEND_TO_RAM STANDBY so es1_ppu can drop.
    Uses the same SE run/off profile helpers as the system_off sample.
common:
  tags:
    - power
    - pm
    - ipm
    - counter
    - rtc
    - drivers
  filter: SOC_FAMILY_ENSEMBLE
  harness: console
  harness_config:
    type: multi_line
    regex:
      - "A32 off then HE S2RAM"
      - "A32/PD9 OFF"
      - "Resumed from PM_STATE_SUSPEND_TO_RAM"
tests:
  sample.pm.m55_he_a32_pm:
    platform_allow:
      - alif_e7_dk_rtss_he
      - alif_e8_dk_rtss_he
    integration_platforms:
      - alif_e8_dk_rtss_he
    depends_on:
      - counter
      - ipm
    extra_args:
      - SNIPPET=pm-a32-off-he
```

## prj.conf
```kconfig
CONFIG_PM=y
CONFIG_IPM=y
CONFIG_IDLE_STACK_SIZE=1024
CONFIG_SYS_CLOCK_TICKS_PER_SEC=1000

CONFIG_COUNTER=y

CONFIG_STDOUT_CONSOLE=y
CONFIG_PRINTK=y
CONFIG_ASSERT=y

# Logging Configuration - Only for this application
CONFIG_LOG=y
CONFIG_LOG_DEFAULT_LEVEL=0
CONFIG_LOG_MODE_IMMEDIATE=y
CONFIG_LOG_BACKEND_UART=y
```

## boards/alif_e8_dk_ae822fa0e5597xx0_rtss_he.overlay
```dts
/* Copyright (C) Alif Semiconductor - All Rights Reserved.
 * Use, distribution and modification of this code is permitted under the
 * terms stated in the Alif Semiconductor Software License Agreement
 *
 * You should have received a copy of the Alif Semiconductor Software
 * License Agreement with this file. If not, please write to:
 * contact@alifsemi.com, or visit: https://alifsemi.com/license
 *
 * HE <-> APSS MHU0 aliases used by the A32 master-shutdown handshake.
 * Board already has apsshemhu0r/s; add apssmhu0r/s for the shared MHU helpers.
 */

/{
	aliases {
		apssmhu0r = &rtssapss_rtsshe_mhu0_r;
		apssmhu0s = &rtsshe_rtssapss_mhu0_s;
	};
};
```

## src/main.c
```c
/* Copyright (C) 2024 Alif Semiconductor - All Rights Reserved.
 * Use, distribution and modification of this code is permitted under the
 * terms stated in the Alif Semiconductor Software License Agreement
 *
 * You should have received a copy of the Alif Semiconductor Software
 * License Agreement with this file. If not, please write to:
 * contact@alifsemi.com, or visit: https: //alifsemi.com/license
 *
 */

#include "aipm.h"
#include <zephyr/kernel.h>
#include <zephyr/device.h>
#include <zephyr/init.h>
#include <zephyr/pm/pm.h>
#include <zephyr/pm/policy.h>
#include <zephyr/drivers/counter.h>
#include <se_service.h>
#include <zephyr/sys/util.h>

#include "a32_mhu.h"

#include <zephyr/logging/log.h>
LOG_MODULE_REGISTER(m55_he_a32_pm, LOG_LEVEL_INF);

#if !defined(CONFIG_ALIF_SE_DTS_RUN_PROFILE) || !defined(CONFIG_ALIF_SE_DTS_OFF_PROFILE)
/**
 * As per the application requirements, it can remove the memory blocks which are not in use.
 */
#if defined(CONFIG_SOC_SERIES_E1C) || defined(CONFIG_SOC_SERIES_B1)
	#define APP_RET_MEM_BLOCKS SRAM4_1_MASK | SRAM4_2_MASK | SRAM4_3_MASK | SRAM4_4_MASK | \
					SRAM5_1_MASK | SRAM5_2_MASK | SRAM5_3_MASK | SRAM5_4_MASK |\
					SRAM5_5_MASK
	#define SERAM_MEMORY_BLOCKS_IN_USE SERAM_1_MASK | SERAM_2_MASK | SERAM_3_MASK | SERAM_4_MASK
#else
	#define APP_RET_MEM_BLOCKS SRAM4_1_MASK | SRAM4_2_MASK | SRAM5_1_MASK | SRAM5_2_MASK
	#define SERAM_MEMORY_BLOCKS_IN_USE SERAM_MASK
#endif
#endif /* CONFIG_ALIF_SE_DTS_RUN_PROFILE || CONFIG_ALIF_SE_DTS_OFF_PROFILE */

#if !defined(CONFIG_ALIF_SE_DTS_OFF_PROFILE)
#if DT_NODE_HAS_COMPAT_STATUS(DT_NODELABEL(rtc0), snps_dw_apb_rtc, okay)
	#define SE_OFFP_EWIC_CFG EWIC_RTC_A
	#define SE_OFFP_WAKEUP_EVENTS WE_LPRTC
#elif DT_NODE_HAS_COMPAT_STATUS(DT_NODELABEL(timer0), snps_dw_timers, okay)
	#define SE_OFFP_EWIC_CFG EWIC_VBAT_TIMER
	#define SE_OFFP_WAKEUP_EVENTS WE_LPTIMER0
#endif
#endif /* CONFIG_ALIF_SE_DTS_OFF_PROFILE */

#if DT_NODE_HAS_COMPAT_STATUS(DT_NODELABEL(rtc0), snps_dw_apb_rtc, okay)
	#define WAKEUP_SOURCE DT_NODELABEL(rtc0)
#elif DT_NODE_HAS_COMPAT_STATUS(DT_NODELABEL(timer0), snps_dw_timers, okay)
	#define WAKEUP_SOURCE DT_NODELABEL(timer0)
#else
#error "Wakeup Device not enabled in the dts"
#endif

/* Sleep duration for PM_STATE_SUSPEND_TO_RAM substate 0 (STANDBY) */
#define S2RAM_STANDBY_SLEEP_USEC (20 * 1000 * 1000)

/*
 * MRAM base address - used to determine boot location
 * TCM boot: VTOR = 0x0
 * MRAM boot: VTOR >= 0x80000000
 */
#define MRAM_BASE_ADDRESS 0x80000000

#define IS_BOOTING_FROM_MRAM() (SCB->VTOR >= MRAM_BASE_ADDRESS)

/*
 * S2RAM is required after A32/PD9 is off so the HE off-profile can drop
 * es1_ppu. That path needs TCM retention (HE + TCM boot).
 */
#if defined(CONFIG_RTSS_HE)
#define S2RAM_SUPPORTED (!IS_BOOTING_FROM_MRAM())
#else
#define S2RAM_SUPPORTED 0
#endif

#if !defined(CONFIG_ALIF_SE_DTS_RUN_PROFILE)
/**
 * Set the RUN profile parameters for this application.
 */
static int app_set_run_params(void)
{
	run_profile_t runp;
	int ret;

	runp.power_domains = PD_SYST_MASK | PD_SSE700_AON_MASK;
	runp.dcdc_voltage  = 825;
	runp.dcdc_mode     = DCDC_MODE_PWM;
	runp.aon_clk_src   = CLK_SRC_LFXO;
	runp.run_clk_src   = CLK_SRC_PLL;
	runp.vdd_ioflex_3V3 = IOFLEX_LEVEL_1V8;
	runp.ip_clock_gating = 0;
	runp.phy_pwr_gating = 0;
#if defined(CONFIG_RTSS_HP)
	runp.cpu_clk_freq  = CLOCK_FREQUENCY_400MHZ;
#else
	runp.cpu_clk_freq  = CLOCK_FREQUENCY_160MHZ;
#endif

	runp.memory_blocks = MRAM_MASK;

	ret = se_service_set_run_cfg(&runp);
	__ASSERT(ret == 0, "SE: set_run_cfg failed = %d", ret);

	return ret;
}
/*
 * CRITICAL: Must run at PRE_KERNEL_1 to restore SYSTOP before peripherals initialize.
 *
 * Priority 46 ensures this runs:
 *   - AFTER SE Services (priority 45) - SE must be ready for set_run_cfg()
 *   - BEFORE Power Domain (priority 47) - Power domain needs SYSTOP enabled
 *   - BEFORE UART and peripherals (priority 50+) - Peripherals need SYSTOP ON
 *
 * On cold boot: SYSTOP is already ON by default, safe to call.
 * On SOFT_OFF wakeup: SYSTOP is OFF, must restore BEFORE peripherals access registers.
 */
SYS_INIT(app_set_run_params, PRE_KERNEL_1, 46);
#endif /* CONFIG_ALIF_SE_DTS_RUN_PROFILE */

#if !defined(CONFIG_ALIF_SE_DTS_OFF_PROFILE)
static int app_set_off_params(enum pm_state state, uint8_t substate_id)
{
	int ret;
	off_profile_t offp;

	offp.dcdc_voltage  = 825;
	offp.dcdc_mode     = DCDC_MODE_OFF;
	offp.stby_clk_freq = SCALED_FREQ_RC_STDBY_76_8_MHZ;
	offp.aon_clk_src   = CLK_SRC_LFXO;
	offp.stby_clk_src  = CLK_SRC_HFRC;
	offp.vtor_address  = SCB->VTOR;
	offp.ip_clock_gating = 0;
	offp.phy_pwr_gating = 0;
	offp.vdd_ioflex_3V3 = IOFLEX_LEVEL_1V8;
	offp.ewic_cfg      = SE_OFFP_EWIC_CFG;
	offp.wakeup_events = SE_OFFP_WAKEUP_EVENTS;
	offp.memory_blocks = MRAM_MASK;

#if defined(CONFIG_RTSS_HE)
	/*
	 * HE core retention configuration:
	 * - TCM boot (VTOR = 0): Enable TCM retention (SERAM + APP_RET_MEM_BLOCKS)
	 * - MRAM boot (VTOR >= 0x80000000): Only SERAM retention needed
	 */
	if (!IS_BOOTING_FROM_MRAM()) {
		offp.memory_blocks |= APP_RET_MEM_BLOCKS | SERAM_MEMORY_BLOCKS_IN_USE;
	} else {
		offp.memory_blocks |= SERAM_MEMORY_BLOCKS_IN_USE;
	}
#else
	__ASSERT(IS_BOOTING_FROM_MRAM(), "HP TCM Retention is not possible - VTOR is set to TCM");
#endif

	switch (state) {
	case PM_STATE_SUSPEND_TO_RAM:
		if (substate_id == 0) {
			offp.power_domains = PD_SSE700_AON_MASK;
		} else if (substate_id == 1) {
			offp.power_domains = PD_VBAT_AON_MASK;
		}
		break;
	case PM_STATE_SOFT_OFF:
		offp.memory_blocks = MRAM_MASK | SERAM_MEMORY_BLOCKS_IN_USE;
		offp.power_domains = PD_VBAT_AON_MASK;
		break;
	default:
		break;
	}

	ret = se_service_set_off_cfg(&offp);
	__ASSERT(ret == 0, "SE: set_off_cfg failed = %d", ret);

	return ret;
}

static void pm_notify_state_entry(enum pm_state state)
{
	const struct pm_state_info *next_state = pm_state_next_get(0);
	uint8_t substate_id = next_state ? next_state->substate_id : 0;
	int ret;

	switch (state) {
	case PM_STATE_SUSPEND_TO_IDLE:
		break;
	case PM_STATE_SUSPEND_TO_RAM:
	case PM_STATE_SOFT_OFF:
		ret = app_set_off_params(state, substate_id);
		__ASSERT(ret == 0, "app_set_off_params failed = %d", ret);
		break;
	default:
		__ASSERT(false, "Entering unknown power state %d", state);
		break;
	}
}
#endif /* CONFIG_ALIF_SE_DTS_OFF_PROFILE */

#if !defined(CONFIG_ALIF_SE_DTS_RUN_PROFILE)
static void pm_notify_pre_device_resume(enum pm_state state)
{
	int ret;

	switch (state) {
	case PM_STATE_SUSPEND_TO_RAM:
		ret = app_set_run_params();
		__ASSERT(ret == 0, "app_set_run_params failed = %d", ret);
		break;
	case PM_STATE_SUSPEND_TO_IDLE:
	case PM_STATE_SOFT_OFF:
		break;
	default:
		__ASSERT(false, "Pre-resume for unknown power state %d", state);
		break;
	}
}
#endif

#if !defined(CONFIG_ALIF_SE_DTS_RUN_PROFILE) || !defined(CONFIG_ALIF_SE_DTS_OFF_PROFILE)
static struct pm_notifier app_pm_notifier = {
#if !defined(CONFIG_ALIF_SE_DTS_OFF_PROFILE)
	.state_entry = pm_notify_state_entry,
#endif
#if !defined(CONFIG_ALIF_SE_DTS_RUN_PROFILE)
	.pre_device_resume = pm_notify_pre_device_resume,
#endif
};
#endif

static void app_pm_lock_deeper_states(bool lock)
{
#if defined(CONFIG_RTSS_HE)
	if (lock) {
		pm_policy_state_lock_get(PM_STATE_SUSPEND_TO_RAM, PM_ALL_SUBSTATES);
		pm_policy_state_lock_get(PM_STATE_SOFT_OFF, PM_ALL_SUBSTATES);
	} else {
		/* Keep SOFT_OFF locked so idle selects S2RAM STANDBY. */
		pm_policy_state_lock_put(PM_STATE_SUSPEND_TO_RAM, PM_ALL_SUBSTATES);
	}
#else
	#error "m55_he_a32_pm is an RTSS-HE sample"
#endif

	LOG_DBG("%s deeper power state(s)", lock ? "Locked" : "Unlocked");
}

static int app_pre_kernel_init(void)
{
	app_pm_lock_deeper_states(true);

#if !defined(CONFIG_ALIF_SE_DTS_RUN_PROFILE) || !defined(CONFIG_ALIF_SE_DTS_OFF_PROFILE)
	pm_notifier_register(&app_pm_notifier);
#endif

	return 0;
}
SYS_INIT(app_pre_kernel_init, PRE_KERNEL_2, 0);

static int app_enter_deep_sleep(uint32_t sleep_usec)
{
#if defined(CONFIG_CORTEX_M_SYSTICK_LPM_TIMER_COUNTER)
	k_sleep(K_USEC(sleep_usec));
#else
	const struct device *const wakeup_dev = DEVICE_DT_GET(WAKEUP_SOURCE);
	struct counter_alarm_cfg alarm_cfg;
	int ret;

	alarm_cfg.ticks = counter_us_to_ticks(wakeup_dev, sleep_usec);
	ret = counter_set_channel_alarm(wakeup_dev, 0, &alarm_cfg);
	if (ret) {
		LOG_ERR("Failed to set the alarm (err %d)", ret);
		return ret;
	}

	LOG_DBG("Set alarm for %u microseconds", sleep_usec);
	k_sleep(K_USEC(sleep_usec));
#endif

	return 0;
}

int main(void)
{
	const struct device *const cons = DEVICE_DT_GET(DT_CHOSEN(zephyr_console));
	const struct device *const wakeup_dev = DEVICE_DT_GET(WAKEUP_SOURCE);
	int ret;

	__ASSERT(device_is_ready(cons), "%s: device not ready", cons->name);
	__ASSERT(device_is_ready(wakeup_dev), "%s: device not ready", wakeup_dev->name);

	if (IS_BOOTING_FROM_MRAM()) {
		LOG_INF("%s RTSS_HE (MRAM boot): A32 off then HE S2RAM", CONFIG_BOARD);
	} else {
		LOG_INF("%s RTSS_HE (TCM boot): A32 off then HE S2RAM", CONFIG_BOARD);
	}

	ret = counter_start(wakeup_dev);
	__ASSERT(!ret || ret == -EALREADY, "Failed to start counter (err %d)", ret);

	if (a32_mhu_shutdown() != 0) {
		LOG_ERR("A32/PD9 shutdown failed");
		return -1;
	}

	if (!S2RAM_SUPPORTED) {
		LOG_ERR("S2RAM not supported (need HE TCM boot)");
		return -1;
	}

	/*
	 * Keep IWIC locked so the idle thread selects S2RAM STANDBY.
	 * sys_poweroff() skips PM notifiers, so SE would never apply the
	 * standby off-profile and es1_ppu would stay ON.
	 */
	pm_policy_state_lock_get(PM_STATE_SUSPEND_TO_IDLE, PM_ALL_SUBSTATES);
	app_pm_lock_deeper_states(false);

	LOG_INF("POWER STATE SEQUENCE:");
	LOG_INF("  1. A32/PD9 OFF");
	LOG_INF("  2. PM_STATE_SUSPEND_TO_RAM (substate 0: STANDBY)");
	LOG_INF("Enter PM_STATE_SUSPEND_TO_RAM (substate 0: STANDBY) for (%d microseconds)",
		S2RAM_STANDBY_SLEEP_USEC);

	ret = app_enter_deep_sleep(S2RAM_STANDBY_SLEEP_USEC);
	__ASSERT(ret == 0, "Could not enter PM_STATE_SUSPEND_TO_RAM (err %d)", ret);

	LOG_INF("=== Resumed from PM_STATE_SUSPEND_TO_RAM (substate 0: STANDBY) ===");

	app_pm_lock_deeper_states(true);

	while (true) {
		k_sleep(K_SECONDS(1));
	}

	return 0;
}
```

## include/a32_going_off.h
```c
/* Copyright (C) Alif Semiconductor - All Rights Reserved.
 * Use, distribution and modification of this code is permitted under the
 * terms stated in the Alif Semiconductor Software License Agreement
 *
 * You should have received a copy of the Alif Semiconductor Software
 * License Agreement with this file. If not, please write to:
 * contact@alifsemi.com, or visit: https://alifsemi.com/license
 */

#ifndef A32_GOING_OFF_H
#define A32_GOING_OFF_H

#include <stdint.h>

/*
 * Keep in sync with:
 *   TF-A   include/plat/alif/common/alif_mhu.h
 *   Linux  arch/arm/mach-ensemble/a32_m55_shutdown.c
 *
 * One 32-bit value on MHU0 channel 0 (same transport as the Linux/Zephyr
 * MHU0 samples).
 *
 * Scenario A (Linux poweroff):
 *   TF-A -> A32_GOING_OFF, M55 -> A32_GOING_OFF_ACK
 *
 * Scenario B (M55 master-initiated):
 *   M55 -> M55_PERIPH_OFF_REQ, Linux IRQ -> M55_PERIPH_OFF_REQ_ACK
 *   then the same A32_GOING_OFF handshake as Scenario A.
 */
#define A32_GOING_OFF			0xA320FF01U
#define A32_GOING_OFF_ACK		0xA320FFA1U
#define M55_PERIPH_OFF_REQ		0xA320FF10U
#define M55_PERIPH_OFF_REQ_ACK		0xA320FF11U
#define A32_GOING_OFF_CHANNEL		0U

enum a32_cluster_state {
	A32_STATE_ON = 0,
	A32_STATE_OFF_REQ_SENT,
	A32_STATE_SHUTDOWN,
	A32_STATE_OFF,
	A32_STATE_FAIL,
};

#endif /* A32_GOING_OFF_H */
```

## include/a32_mhu.h
```c
/* Copyright (C) 2026 Alif Semiconductor - All Rights Reserved.
 * Use, distribution and modification of this code is permitted under the
 * terms stated in the Alif Semiconductor Software License Agreement
 *
 * You should have received a copy of the Alif Semiconductor Software
 * License Agreement with this file. If not, please write to:
 * contact@alifsemi.com, or visit: https://alifsemi.com/license
 */

#ifndef A32_MHU_H
#define A32_MHU_H

/*
 * Ask Linux/TF-A to power down the A32 cluster (PD-9) over MHU0.
 * Returns 0 when SE reports PD2_APPS off, negative on timeout or error.
 */
int a32_mhu_shutdown(void);

#endif /* A32_MHU_H */
```

## src/a32_mhu.c
```c
/* Copyright (C) 2026 Alif Semiconductor - All Rights Reserved.
 * Use, distribution and modification of this code is permitted under the
 * terms stated in the Alif Semiconductor Software License Agreement
 *
 * You should have received a copy of the Alif Semiconductor Software
 * License Agreement with this file. If not, please write to:
 * contact@alifsemi.com, or visit: https://alifsemi.com/license
 */

#include <aipm.h>
#include <se_service.h>
#include <zephyr/device.h>
#include <zephyr/drivers/ipm.h>
#include <zephyr/kernel.h>
#include <zephyr/logging/log.h>
#include <zephyr/pm/policy.h>

#include "a32_going_off.h"
#include "a32_mhu.h"

LOG_MODULE_REGISTER(a32_mhu, LOG_LEVEL_INF);

#if DT_NODE_EXISTS(DT_ALIAS(apssmhu0r)) && DT_NODE_EXISTS(DT_ALIAS(apssmhu0s))
#define A32_MHU_RX_NODE DT_ALIAS(apssmhu0r)
#define A32_MHU_TX_NODE DT_ALIAS(apssmhu0s)
#elif DT_NODE_EXISTS(DT_ALIAS(apsshemhu0r)) && DT_NODE_EXISTS(DT_ALIAS(apsshemhu0s))
#define A32_MHU_RX_NODE DT_ALIAS(apsshemhu0r)
#define A32_MHU_TX_NODE DT_ALIAS(apsshemhu0s)
#else
#error "Need HE<->APSS MHU0 aliases (apssmhu0r/s or apsshemhu0r/s)"
#endif

#define A32_TX_TIMEOUT_MS		20000
#define A32_REQ_ACK_TIMEOUT_MS		20000
#define A32_REQ_SEND_RETRIES		5
#define A32_PD9_POLL_TIMEOUT_MS		30000
#define A32_PD9_POLL_SLICE_MS		100
#define A32_LINUX_CLAIM_WAIT_S		20

static const struct device *a32_mhu_rx;
static const struct device *a32_mhu_tx;

static K_SEM_DEFINE(a32_sem_sent, 0, 1);
static K_SEM_DEFINE(a32_sem_req_ack, 0, 1);

static volatile bool a32_going_off_seen;
static volatile enum a32_cluster_state a32_state = A32_STATE_ON;
static uint32_t a32_tx_msg;

static void a32_recv_cb(const struct device *dev, void *user_data,
			uint32_t id, volatile void *data)
{
	uint32_t msg;
	uint32_t ack;
	int ret;

	ARG_UNUSED(dev);
	ARG_UNUSED(user_data);

	if ((id != A32_GOING_OFF_CHANNEL) || (data == NULL)) {
		return;
	}

	msg = *((volatile uint32_t *)data);
	LOG_INF("RX MHU0 Ch%u = 0x%x", id, msg);

	if (msg == M55_PERIPH_OFF_REQ_ACK) {
		k_sem_give(&a32_sem_req_ack);
		return;
	}

	if (msg != A32_GOING_OFF) {
		return;
	}

	/* ACK immediately: TF-A has a bounded ACK window. */
	a32_state = A32_STATE_SHUTDOWN;
	a32_going_off_seen = true;
	ack = A32_GOING_OFF_ACK;
	ret = ipm_send(a32_mhu_tx, 0, A32_GOING_OFF_CHANNEL, &ack, sizeof(ack));
	if (ret != 0) {
		LOG_ERR("A32_GOING_OFF_ACK send failed: %d", ret);
	}
}

static void a32_send_cb(const struct device *dev, void *user_data,
			uint32_t id, volatile void *data)
{
	ARG_UNUSED(dev);
	ARG_UNUSED(user_data);
	ARG_UNUSED(data);
	ARG_UNUSED(id);

	k_sem_give(&a32_sem_sent);
}

static int a32_send_word(uint32_t value)
{
	int ret;

	a32_tx_msg = value;
	k_sem_reset(&a32_sem_sent);
	LOG_INF("sending 0x%x on MHU0 Ch%u", value, A32_GOING_OFF_CHANNEL);

	ret = ipm_send(a32_mhu_tx, 0, A32_GOING_OFF_CHANNEL, &a32_tx_msg,
		       sizeof(a32_tx_msg));
	if (ret != 0) {
		LOG_ERR("ipm_send failed: %d", ret);
		return ret;
	}

	if (k_sem_take(&a32_sem_sent, K_MSEC(A32_TX_TIMEOUT_MS)) != 0) {
		LOG_ERR("TX completion timeout for 0x%x", value);
		return -EAGAIN;
	}

	return 0;
}

static int a32_pd9_is_off(void)
{
	run_profile_t runp;
	int ret;

	ret = se_service_get_run_cfg(&runp);
	if (ret != 0) {
		LOG_ERR("GET_RUN failed: %d", ret);
		return ret;
	}

	LOG_INF("GET_RUN domains=0x%x PD9(APSS)=%s", runp.power_domains,
		(runp.power_domains & PD2_APPS_MASK) ? "ON" : "OFF");

	return ((runp.power_domains & PD2_APPS_MASK) == 0U) ? 1 : 0;
}

/*
 * GET_RUN is live SoC state (OR of every master's vote). Do not feed that
 * snapshot back into SET_RUN. Only change this core's last requested profile.
 */
static int a32_drop_se_pd9(void)
{
	run_profile_t live;
	run_profile_t requested;
	int ret;

	ret = se_service_get_run_cfg(&live);
	if (ret != 0) {
		LOG_ERR("GET_RUN failed: %d", ret);
		return ret;
	}

	ret = se_service_get_last_set_run_cfg(&requested);
	if (ret == 0) {
		if ((requested.power_domains & PD2_APPS_MASK) != 0U) {
			requested.power_domains &= ~PD2_APPS_MASK;
			ret = se_service_set_run_cfg(&requested);
			if (ret != 0) {
				LOG_ERR("SET_RUN clear PD9 failed: %d", ret);
				return ret;
			}
		}
	} else {
		LOG_WRN("no last SET_RUN cache (%d)", ret);
	}

	ret = se_service_get_run_cfg(&live);
	if (ret != 0) {
		return ret;
	}

	return ((live.power_domains & PD2_APPS_MASK) == 0U) ? 0 : -EIO;
}

int a32_mhu_shutdown(void)
{
	int waited;
	int pd9;

	a32_mhu_rx = DEVICE_DT_GET(A32_MHU_RX_NODE);
	a32_mhu_tx = DEVICE_DT_GET(A32_MHU_TX_NODE);

	if (!device_is_ready(a32_mhu_rx) || !device_is_ready(a32_mhu_tx)) {
		LOG_ERR("MHU0 not ready");
		return -ENODEV;
	}

	ipm_register_callback(a32_mhu_rx, a32_recv_cb, NULL);
	ipm_register_callback(a32_mhu_tx, a32_send_cb, NULL);

	if (ipm_set_enabled(a32_mhu_rx, true) != 0) {
		LOG_ERR("failed to enable MHU0 RX");
		return -EIO;
	}

	/*
	 * Snippet may enable SUSPEND_TO_IDLE. Lock IWIC for the handshake
	 * so the wait cannot stall in idle before the send.
	 */
	pm_policy_state_lock_get(PM_STATE_SUSPEND_TO_IDLE, PM_ALL_SUBSTATES);

	LOG_INF("waiting %d s for Linux MHU0 client", A32_LINUX_CLAIM_WAIT_S);
	k_sleep(K_SECONDS(A32_LINUX_CLAIM_WAIT_S));

	a32_state = A32_STATE_OFF_REQ_SENT;
	k_sem_reset(&a32_sem_req_ack);
	for (waited = 0; waited < A32_REQ_SEND_RETRIES; waited++) {
		if (a32_send_word(M55_PERIPH_OFF_REQ) == 0) {
			break;
		}

		pd9 = a32_pd9_is_off();
		if (pd9 == 1) {
			a32_state = A32_STATE_OFF;
			break;
		}
		k_sleep(K_SECONDS(2));
	}

	if (a32_state == A32_STATE_OFF) {
		goto pd9_off_done;
	}

	if (waited == A32_REQ_SEND_RETRIES) {
		LOG_ERR("M55_PERIPH_OFF_REQ not accepted");
		a32_state = A32_STATE_FAIL;
		return -EAGAIN;
	}

	if (k_sem_take(&a32_sem_req_ack, K_MSEC(A32_REQ_ACK_TIMEOUT_MS)) != 0) {
		LOG_ERR("no M55_PERIPH_OFF_REQ_ACK from Linux");
		a32_state = A32_STATE_FAIL;
		return -ETIMEDOUT;
	}

	LOG_INF("got M55_PERIPH_OFF_REQ_ACK; waiting for PD9 OFF");

	waited = 0;
	while (waited < A32_PD9_POLL_TIMEOUT_MS) {
		if (a32_going_off_seen) {
			k_sleep(K_MSEC(200));
			if (a32_drop_se_pd9() == 0) {
				a32_state = A32_STATE_OFF;
				break;
			}
			LOG_ERR("SET_RUN did not clear PD9");
			a32_state = A32_STATE_FAIL;
			return -EIO;
		}

		pd9 = a32_pd9_is_off();
		if (pd9 == 1) {
			a32_state = A32_STATE_OFF;
			break;
		}
		k_sleep(K_MSEC(A32_PD9_POLL_SLICE_MS));
		waited += A32_PD9_POLL_SLICE_MS;
	}

	if (a32_state != A32_STATE_OFF) {
		LOG_ERR("PD9 still ON after %d s", A32_PD9_POLL_TIMEOUT_MS / 1000);
		a32_state = A32_STATE_FAIL;
		return -ETIMEDOUT;
	}

pd9_off_done:
	(void)ipm_set_enabled(a32_mhu_rx, false);
	LOG_INF("A32/PD9 OFF confirmed");
	return 0;
}
```
