/* Copyright (C) Alif 2026 Semiconductor - All Rights Reserved.
 * Use, distribution and modification of this code is permitted under the
 * terms stated in the Alif Semiconductor Software License Agreement
 *
 * You should have received a copy of the Alif Semiconductor Software
 * License Agreement with this file. If not, please write to:
 * contact@alifsemi.com, or visit: https://alifsemi.com/license
 *
 */

/*
 * PM off-profile overlay for Ensemble and Ensemble Gen2
 * SoCs - HE core TCM boot S2RAM.
 */

#include "pm_tcm_common.overlay"

&aipm_run_default {
	phy-pwr-gating = <(ALIF_PHY_GATE_LDO_MASK |
			ALIF_PHY_GATE_MIPI_TX_DPHY_MASK |
			ALIF_PHY_GATE_MIPI_RX_DPHY_MASK |
			ALIF_PHY_GATE_MIPI_PLL_DPHY_MASK)>;
	ip-clock-gating = <(ALIF_IP_CLK_GATE_CDC200_MASK |
			ALIF_IP_CLK_GATE_MIPI_DSI_MASK |
			ALIF_IP_CLK_GATE_GPU_MASK)>;
	memory-blocks = <(ALIF_MRAM_MASK | ALIF_SRAM0_MASK)>;
};

&off_profile_standby {
	memory-blocks = <(ALIF_SRAM4_1_MASK | ALIF_SRAM4_2_MASK |
			  ALIF_SRAM5_1_MASK | ALIF_SRAM5_2_MASK |
			  ALIF_SERAM_MASK | ALIF_MRAM_MASK)>;
};

&off_profile_stop {
	memory-blocks = <(ALIF_SRAM4_1_MASK | ALIF_SRAM4_2_MASK |
			  ALIF_SRAM5_1_MASK | ALIF_SRAM5_2_MASK |
			  ALIF_SERAM_MASK | ALIF_MRAM_MASK)>;
};
