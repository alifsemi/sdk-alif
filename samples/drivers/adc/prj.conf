## prj.conf
```kconfig
CONFIG_ADC=y
CONFIG_LOG=y
CONFIG_CBPRINTF_FP_SUPPORT=y
CONFIG_USE_ALIF_HAL_ANALOG=y
CONFIG_ADC_ALIF_DMA=y
CONFIG_ADC_ALIF_UTIMER_TRIGGER=y
CONFIG_DMA=y
```

## src/main.c
```c
/*
 * Copyright (C) 2024 Alif Semiconductor.
 * SPDX-License-Identifier: Apache-2.0
 */
#include <inttypes.h>
#include <stddef.h>
#include <stdint.h>
#include <zephyr/device.h>
#include <zephyr/devicetree.h>
#include <zephyr/drivers/adc.h>
#include <zephyr/kernel.h>
#include <zephyr/sys/printk.h>
#include <zephyr/sys/util.h>
#include "temperature.h"
#include <zephyr/logging/log.h>

LOG_MODULE_REGISTER(ALIF_ADC, LOG_LEVEL_INF);

#define ADC_CHANNEL_0				(0x00)
#define ADC_CHANNEL_1				(0x01)
#define ADC_CHANNEL_2				(0x02)
#define ADC_CHANNEL_3				(0x03)
#define ADC_CHANNEL_4				(0x04)
#define ADC_CHANNEL_5				(0x05)
#define ADC_CHANNEL_6				(0x06)
#define ADC_CHANNEL_7				(0x07)
#define ADC_CHANNEL_8				(0x08)

/****ADC MASK CHANNEL****/
#define ADC_UNMASK_CHANNEL_0			(1 << 0)
#define ADC_UNMASK_CHANNEL_1			(1 << 1)
#define ADC_UNMASK_CHANNEL_2			(1 << 2)
#define ADC_UNMASK_CHANNEL_3			(1 << 3)
#define ADC_UNMASK_CHANNEL_4			(1 << 4)
#define ADC_UNMASK_CHANNEL_5			(1 << 5)
#define ADC_UNMASK_CHANNEL_6			(1 << 6)
#define ADC_UNMASK_CHANNEL_7			(1 << 7)
#define ADC_UNMASK_CHANNEL_8			(1 << 8)

#define ADC_COMPARATOR_THRESHOLD_ABOVE_A	(1 << 0)
#define ADC_COMPARATOR_THRESHOLD_ABOVE_B	(1 << 1)
#define ADC_COMPARATOR_THRESHOLD_BELOW_A	(1 << 2)
#define ADC_COMPARATOR_THRESHOLD_BELOW_B	(1 << 3)
#define ADC_COMPARATOR_THRESHOLD_BETWEEN_A_B	(1 << 4)
#define ADC_COMPARATOR_THRESHOLD_OUTSIDE_A_B	(1 << 5)
#define MAX_NUM_THRESHOLD			(6)

#ifdef CONFIG_ADC_ALIF_DMA
#define ADC_DMA_NUM_SAMPLES			1
static uint32_t buffer[ADC_DMA_NUM_SAMPLES];
#else
static uint32_t m_samplings_done;
static uint8_t comparator;
uint32_t comp_value[MAX_NUM_THRESHOLD] = {0};
static uint32_t buffer[1];

enum adc_action adc_call_back(const struct device *dev,
				const struct adc_sequence *sequence,
				uint16_t sampling_index)
{
	ARG_UNUSED(dev);
	ARG_UNUSED(sequence);
	ARG_UNUSED(sampling_index);

	if (comparator & ADC_COMPARATOR_THRESHOLD_ABOVE_A) {
		comp_value[0] += 1;
	}
	if (comparator & ADC_COMPARATOR_THRESHOLD_ABOVE_B) {
		comp_value[1] += 1;
	}
	if (comparator & ADC_COMPARATOR_THRESHOLD_BELOW_A) {
		comp_value[2] += 1;
	}
	if (comparator & ADC_COMPARATOR_THRESHOLD_BELOW_B) {
		comp_value[3] += 1;
	}
	if (comparator & ADC_COMPARATOR_THRESHOLD_BETWEEN_A_B) {
		comp_value[4] += 1;
	}
	if (comparator & ADC_COMPARATOR_THRESHOLD_OUTSIDE_A_B) {
		comp_value[5] += 1;
	}
	++m_samplings_done;
	if (m_samplings_done < 2) {
		return ADC_ACTION_REPEAT;
	} else {
		return ADC_ACTION_FINISH;
	}
}
#endif /* CONFIG_ADC_ALIF_DMA */

int main(void)
{
	float temp;
	int ret;

	const struct device *adc_dev = DEVICE_DT_GET(DT_NODELABEL(adc0));

	if (!device_is_ready(adc_dev)) {
		LOG_ERR("adc device not ready");
		return -1;
	}

	struct adc_channel_cfg channel_cfg = {
		.differential = 0,
		.channel_id   = ADC_CHANNEL_6,
	};

#ifdef CONFIG_ADC_ALIF_DMA
	struct adc_sequence sequence = {
		.options     = NULL,
		.buffer      = (void *)buffer,
		.buffer_size = sizeof(buffer),
		.channels    = ADC_UNMASK_CHANNEL_6,
	};
#else
	struct adc_sequence_options adc_seq_options = {
		.callback  = adc_call_back,
		.user_data = (uint8_t *)&comparator,
	};
	struct adc_sequence sequence = {
		.options     = &adc_seq_options,
		.buffer      = (void *)buffer,
		.buffer_size = sizeof(buffer),
		.channels    = ADC_UNMASK_CHANNEL_6,
	};
#endif /* CONFIG_ADC_ALIF_DMA */

	/* Set the channel */
	ret = adc_channel_setup(adc_dev, &channel_cfg);
	if (ret) {
		LOG_ERR("Unable set up channel");
		return -1;
	}

#ifdef CONFIG_ADC_ALIF_DMA
	LOG_INF("ADC DMA mode - collecting %d samples per read", ADC_DMA_NUM_SAMPLES);

	while (1) {
		int64_t t0 = k_uptime_get();

		ret = adc_read(adc_dev, &sequence);
		if (ret) {
			LOG_ERR("ADC read failed: %d", ret);
			return -1;
		}

		int64_t dt = k_uptime_get() - t0;

		LOG_INF("adc_read() blocked for %lld ms (%d samples)",
			dt, ADC_DMA_NUM_SAMPLES);

		for (int i = 0; i < ADC_DMA_NUM_SAMPLES; i++) {
			if (channel_cfg.channel_id == ADC_CHANNEL_6) {
				temp = get_temperature(buffer[i]);
				if (temp == -1) {
					LOG_ERR("Sample[%d]: outside range (raw: %u)",
						i, buffer[i]);
				} else {
					LOG_INF("Sample[%d]: %0.1f C", i, (double)temp);
				}
			}
		}

		k_sleep(K_MSEC(1000));
	}

#else
	/* Start reading the samples - IRQ path */
	ret = adc_read(adc_dev, &sequence);
	if (ret) {
		LOG_ERR("Error: ADC_read failed");
		return -1;
	}

	LOG_INF("Allocated memory buffer Address is 0x%X", (uint32_t)buffer);

	if (channel_cfg.channel_id == ADC_CHANNEL_6) {
		temp = get_temperature(buffer[0]);
		if (temp == -1) {
			LOG_ERR(" Error: Temperature is outside range");
		} else {
			LOG_INF("Current temp %0.1f C", (double)temp);
		}
	}

	LOG_INF("ADC sampling Done");
#endif /* CONFIG_ADC_ALIF_DMA */

	return 0;
}
```

## src/temperature.h
```c
/*
 * Copyright (C) 2024 Alif Semiconductor.
 * SPDX-License-Identifier: Apache-2.0
 */

#ifndef TEMPERATURE_H_
#define TEMPERATURE_H_

#include <zephyr/sys/util.h>
#include <stdint.h>

/* ADC code range covered by the temperature lookup table */
#define ADC_TEMP_MIN 885
#define ADC_TEMP_MAX 1341

/*
 * Temperature lookup table indexed directly by (adc_value - ADC_TEMP_MIN).
 * Values are stored in tenths of a degree Celsius (e.g. -399 => -39.9 C),
 * covering ADC codes ADC_TEMP_MIN..ADC_TEMP_MAX.
 */
static const int16_t tempData[] = {
	-399, -396, -394, -391, -388, -386, -383, -381, -378, -376, -373, -370,
	-368, -365, -363, -360, -357, -355, -352, -350, -347, -344, -342, -339,
	-337, -334, -332, -329, -326, -324, -321, -319, -316, -313, -311, -308,
	-306, -303, -301, -298, -296, -294, -291, -289, -287, -284, -282, -280,
	-277, -275, -273, -271, -268, -266, -264, -261, -259, -257, -254, -252,
	-250, -247, -245, -243, -240, -238, -236, -233, -231, -229, -226, -224,
	-222, -219, -217, -215, -212, -210, -208, -205, -203, -200, -197, -194,
	-191, -189, -186, -183, -180, -177, -174, -171, -168, -165, -162, -159,
	-156, -153, -150, -147, -145, -142, -139, -136, -133, -130, -127, -124,
	-121, -118, -115, -112, -109, -106, -103, -101, -97, -94, -90, -86,
	-82, -79, -75, -71, -67, -64, -60, -56, -52, -49, -45, -41,
	-37, -34, -30, -26, -22, -19, -15, -11, -7, -4, 0, 4,
	7, 11, 14, 18, 21, 24, 28, 31, 35, 38, 42, 45,
	49, 52, 56, 59, 63, 66, 69, 73, 76, 80, 83, 87,
	90, 94, 97, 101, 103, 105, 107, 109, 111, 113, 115, 118,
	120, 122, 124, 126, 128, 130, 132, 135, 137, 139, 141, 143,
	145, 147, 149, 152, 154, 156, 158, 160, 162, 164, 166, 169,
	171, 173, 175, 177, 179, 181, 183, 186, 188, 190, 192, 194,
	196, 198, 201, 204, 207, 211, 214, 218, 221, 225, 228, 232,
	235, 239, 242, 246, 249, 252, 256, 259, 262, 266, 269, 272,
	275, 279, 282, 285, 288, 292, 295, 298, 301, 303, 306, 308,
	311, 313, 316, 318, 321, 323, 326, 328, 331, 333, 336, 338,
	341, 344, 346, 349, 351, 354, 356, 359, 361, 364, 366, 369,
	371, 374, 376, 379, 381, 384, 386, 389, 391, 394, 396, 399,
	401, 404, 407, 410, 413, 416, 419, 422, 425, 427, 430, 433,
	436, 439, 442, 445, 448, 451, 454, 457, 460, 463, 466, 468,
	471, 474, 477, 480, 483, 486, 489, 492, 495, 498, 501, 503,
	505, 508, 510, 512, 515, 517, 519, 521, 524, 526, 528, 530,
	533, 535, 537, 540, 542, 544, 546, 549, 551, 553, 556, 558,
	560, 562, 565, 567, 569, 571, 574, 576, 578, 581, 583, 585,
	587, 590, 592, 594, 597, 599, 600, 603, 606, 608, 611, 614,
	617, 620, 623, 625, 628, 631, 634, 637, 640, 642, 645, 648,
	651, 654, 657, 659, 662, 665, 668, 671, 673, 676, 679, 682,
	685, 688, 690, 693, 696, 700, 703, 706, 709, 712, 715, 719,
	722, 725, 728, 731, 734, 737, 741, 744, 747, 750, 753, 756,
	759, 763, 766, 769, 772, 775, 778, 781, 784, 788, 791, 794,
	797, 799, 802, 804, 806, 808, 810, 813, 815, 817, 819, 821,
	824, 826, 828, 830, 833, 835, 837, 839, 841, 844, 846, 848,
	850,
};

/*
 * @func : float get_temperature (uint32_t adc_value)
 * @brief: Converts the digital value into a temperature reading
 * @parameter[1] : adc_value  : The digital value obtained from TSENS conversion
 * @return   : temperature
 */
float get_temperature(uint32_t adc_value)
{
	/* check for temperature operating range */
	if (adc_value < ADC_TEMP_MIN || adc_value > ADC_TEMP_MAX) {
		return -255.0f;
	}

	return tempData[adc_value - ADC_TEMP_MIN] / 10.0f;
}
#endif /*TEMPERATURE_H_ */
```
