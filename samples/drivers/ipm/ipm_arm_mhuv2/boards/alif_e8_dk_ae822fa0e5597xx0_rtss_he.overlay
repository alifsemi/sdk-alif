/* Copyright (C) 2026 Alif Semiconductor - All Rights Reserved.
 * Use, distribution and modification of this code is permitted under the
 * terms stated in the Alif Semiconductor Software License Agreement
 *
 * You should have received a copy of the Alif Semiconductor Software
 * License Agreement with this file. If not, please write to:
 * contact@alifsemi.com, or visit: https://alifsemi.com/license
 *
 */
#include "alif_ensemble_dk.overlay"
/*
 * /{
 *	chosen {
 *		zephyr,console = &uart4;
 *		zephyr,shell-uart = &uart4;
 *		zephyr,uart-mcumgr = &uart4;
 *	};
 * };
 *
 * &uart4 {
 *	status = "okay";
 * };
 */
