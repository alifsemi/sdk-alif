## CMakeLists.txt
```
# Copyright (C) 2026 Alif Semiconductor - All Rights Reserved.
# Use, distribution and modification of this code is permitted under the
# terms stated in the Alif Semiconductor Software License Agreement
#
# You should have received a copy of the Alif Semiconductor Software
# License Agreement with this file. If not, please write to:
# contact@alifsemi.com, or visit: https://alifsemi.com/license

cmake_minimum_required(VERSION 3.20.0)

find_package(Zephyr REQUIRED HINTS $ENV{ZEPHYR_BASE})
project(jpeg_test)

target_sources(app PRIVATE
	src/main.c
	src/incbin.c
	src/avi_mux.c
)
target_compile_definitions(app PRIVATE INCBIN_BASE_DIR="${CMAKE_CURRENT_SOURCE_DIR}")
```

## sample.yaml
```
sample:
  name: JPEG Encoder Test
  description: Test application for Alif JPEG hardware encoder
common:
  tags:
    - video
    - jpeg
    - encoder
    - compression
  platform_allow:
    - alif_e8_dk_rtss_hp
    - alif_e8_dk_rtss_he
  integration_platforms:
    - alif_e8_dk_rtss_hp
tests:
  sample.video.jpeg_encoder:
    harness: console
    harness_config:
      type: multi_line
      ordered: true
      regex:
        - "JPEG device ready"
        - "Test completed successfully"
        - "All Tests Completed Successfully"
```

## prj.conf
```kconfig
# Copyright (C) 2026 Alif Semiconductor - All Rights Reserved.
# Use, distribution and modification of this code is permitted under the
# terms stated in the Alif Semiconductor Software License Agreement
#
# You should have received a copy of the Alif Semiconductor Software
# License Agreement with this file. If not, please write to:
# contact@alifsemi.com, or visit: https://alifsemi.com/license

# Video subsystem
CONFIG_VIDEO=y
CONFIG_VIDEO_JPEG_HANTRO_VC9000E=y
CONFIG_VIDEO_BUFFER_POOL_NUM_MAX=3
CONFIG_USE_ALIF_JPEG_SW_LIB=y
CONFIG_VIDEO_BUFFER_POOL_SZ_MAX=1382400
CONFIG_SYS_HEAP_AUTO=y
# Logging
CONFIG_LOG=y
CONFIG_VIDEO_LOG_LEVEL_INF=y
```

## src/avi_mux.c
```c
/* Copyright (C) 2026 Alif Semiconductor - All Rights Reserved.
 * Use, distribution and modification of this code is permitted under the
 * terms stated in the Alif Semiconductor Software License Agreement
 *
 * You should have received a copy of the Alif Semiconductor Software
 * License Agreement with this file. If not, please write to:
 * contact@alifsemi.com, or visit: https://alifsemi.com/license
 */

/**
 * @file avi_mux.c
 * @brief AVI v1 muxer for MJPEG (single video stream, no audio).
 *
 * Layout produced:
 *
 *   RIFF (size) "AVI "
 *     LIST (size) "hdrl"
 *       avih (56)              MainAVIHeader
 *       LIST (size) "strl"
 *         strh (56)            AVIStreamHeader (vids / MJPG)
 *         strf (40)            BITMAPINFOHEADER (MJPG, 24bpp)
 *     LIST (size) "movi"
 *       00dc (size) <jpeg> [pad]   ... per frame
 *     idx1 (size)
 *       16 B per frame: ckid("00dc"), flags(KEYFRAME), offset, size
 *
 * idx1 offsets are relative to the "movi" FOURCC position — the de-facto
 * convention used by ffmpeg/VLC/MediaPlayer.
 */

#include "avi_mux.h"
#include <string.h>
#include <errno.h>

#define AVIF_HASINDEX     0x00000010U
#define AVIIF_KEYFRAME    0x00000010U

/* ---- little-endian writers --------------------------------------------- */

static inline void w_u16(uint8_t *p, uint16_t v)
{
	p[0] = (uint8_t)v;
	p[1] = (uint8_t)(v >> 8);
}

static inline void w_u32(uint8_t *p, uint32_t v)
{
	p[0] = (uint8_t)v;
	p[1] = (uint8_t)(v >> 8);
	p[2] = (uint8_t)(v >> 16);
	p[3] = (uint8_t)(v >> 24);
}

static inline void w_fourcc(uint8_t *p, const char *s)
{
	p[0] = (uint8_t)s[0];
	p[1] = (uint8_t)s[1];
	p[2] = (uint8_t)s[2];
	p[3] = (uint8_t)s[3];
}

/* ---- bounds-checked appenders ------------------------------------------ */

static int put_u16(struct avi_mux *m, uint16_t v)
{
	if (m->pos + 2U > m->cap) {
		return -ENOSPC;
	}
	w_u16(m->buf + m->pos, v);
	m->pos += 2U;
	return 0;
}

static int put_u32(struct avi_mux *m, uint32_t v)
{
	if (m->pos + 4U > m->cap) {
		return -ENOSPC;
	}
	w_u32(m->buf + m->pos, v);
	m->pos += 4U;
	return 0;
}

static int put_fourcc(struct avi_mux *m, const char *s)
{
	if (m->pos + 4U > m->cap) {
		return -ENOSPC;
	}
	w_fourcc(m->buf + m->pos, s);
	m->pos += 4U;
	return 0;
}

static int put_bytes(struct avi_mux *m, const void *data, uint32_t n)
{
	if (m->pos + n > m->cap) {
		return -ENOSPC;
	}
	memcpy(m->buf + m->pos, data, n);
	m->pos += n;
	return 0;
}

static int put_zeros(struct avi_mux *m, uint32_t n)
{
	if (m->pos + n > m->cap) {
		return -ENOSPC;
	}
	memset(m->buf + m->pos, 0, n);
	m->pos += n;
	return 0;
}

/* ---- public API -------------------------------------------------------- */

int avi_mux_init(struct avi_mux *m, uint8_t *buf, uint32_t cap,
		 uint32_t width, uint32_t height, uint32_t fps)
{
	uint32_t hdrl_size_pos;
	uint32_t hdrl_data_pos;
	uint32_t strl_size_pos;
	uint32_t strl_data_pos;
	int ret;

	if (m == NULL || buf == NULL) {
		return -EINVAL;
	}
	if (width == 0U || height == 0U || fps == 0U) {
		return -EINVAL;
	}
	/* Header alone needs ~ 12 + 8 + 4 + 8 + 56 + 8 + 4 + 8 + 56 + 8 + 40 + 12 = 224 B.
	 * Require some breathing room so finalize() can also write idx1.
	 */
	if (cap < 4096U) {
		return -ENOSPC;
	}

	memset(m, 0, sizeof(*m));
	m->buf = buf;
	m->cap = cap;
	m->width = width;
	m->height = height;
	m->fps = fps;

	/* RIFF (size) "AVI " */
	if ((ret = put_fourcc(m, "RIFF"))) {
		return ret;
	}
	m->riff_size_pos = m->pos;
	if ((ret = put_u32(m, 0U))) {            /* backpatched in finalize */
		return ret;
	}
	if ((ret = put_fourcc(m, "AVI "))) {
		return ret;
	}

	/* LIST (size) "hdrl" */
	if ((ret = put_fourcc(m, "LIST"))) {
		return ret;
	}
	hdrl_size_pos = m->pos;
	if ((ret = put_u32(m, 0U))) {            /* backpatched at end of init */
		return ret;
	}
	hdrl_data_pos = m->pos;
	if ((ret = put_fourcc(m, "hdrl"))) {
		return ret;
	}

	/* avih chunk: id + size(56) + 56 bytes of MainAVIHeader */
	if ((ret = put_fourcc(m, "avih"))) {
		return ret;
	}
	if ((ret = put_u32(m, 56U))) {
		return ret;
	}
	if ((ret = put_u32(m, 1000000U / fps))) {       /* dwMicroSecPerFrame */
		return ret;
	}
	m->avih_max_bps_pos = m->pos;
	if ((ret = put_u32(m, 0U))) {                   /* dwMaxBytesPerSec   */
		return ret;
	}
	if ((ret = put_u32(m, 0U))) {                   /* dwPaddingGranularity */
		return ret;
	}
	if ((ret = put_u32(m, AVIF_HASINDEX))) {        /* dwFlags            */
		return ret;
	}
	m->avih_frames_pos = m->pos;
	if ((ret = put_u32(m, 0U))) {                   /* dwTotalFrames      */
		return ret;
	}
	if ((ret = put_u32(m, 0U))) {                   /* dwInitialFrames    */
		return ret;
	}
	if ((ret = put_u32(m, 1U))) {                   /* dwStreams          */
		return ret;
	}
	m->avih_buf_size_pos = m->pos;
	if ((ret = put_u32(m, 0U))) {                   /* dwSuggestedBufferSize */
		return ret;
	}
	if ((ret = put_u32(m, width))) {                /* dwWidth            */
		return ret;
	}
	if ((ret = put_u32(m, height))) {               /* dwHeight           */
		return ret;
	}
	if ((ret = put_zeros(m, 16U))) {                /* dwReserved[4]      */
		return ret;
	}

	/* LIST (size) "strl" */
	if ((ret = put_fourcc(m, "LIST"))) {
		return ret;
	}
	strl_size_pos = m->pos;
	if ((ret = put_u32(m, 0U))) {
		return ret;
	}
	strl_data_pos = m->pos;
	if ((ret = put_fourcc(m, "strl"))) {
		return ret;
	}

	/* strh chunk: id + size(56) + 56 bytes of AVIStreamHeader */
	if ((ret = put_fourcc(m, "strh"))) {
		return ret;
	}
	if ((ret = put_u32(m, 56U))) {
		return ret;
	}
	if ((ret = put_fourcc(m, "vids"))) {            /* fccType            */
		return ret;
	}
	if ((ret = put_fourcc(m, "MJPG"))) {            /* fccHandler         */
		return ret;
	}
	if ((ret = put_u32(m, 0U))) {                   /* dwFlags            */
		return ret;
	}
	if ((ret = put_u16(m, 0U))) {                   /* wPriority          */
		return ret;
	}
	if ((ret = put_u16(m, 0U))) {                   /* wLanguage          */
		return ret;
	}
	if ((ret = put_u32(m, 0U))) {                   /* dwInitialFrames    */
		return ret;
	}
	if ((ret = put_u32(m, 1U))) {                   /* dwScale            */
		return ret;
	}
	if ((ret = put_u32(m, fps))) {                  /* dwRate (= fps)     */
		return ret;
	}
	if ((ret = put_u32(m, 0U))) {                   /* dwStart            */
		return ret;
	}
	m->strh_length_pos = m->pos;
	if ((ret = put_u32(m, 0U))) {                   /* dwLength           */
		return ret;
	}
	m->strh_buf_size_pos = m->pos;
	if ((ret = put_u32(m, 0U))) {                   /* dwSuggestedBufferSize */
		return ret;
	}
	if ((ret = put_u32(m, 0xFFFFFFFFU))) {          /* dwQuality (-1)     */
		return ret;
	}
	if ((ret = put_u32(m, 0U))) {                   /* dwSampleSize       */
		return ret;
	}
	if ((ret = put_u16(m, 0U))) {                   /* rcFrame.left       */
		return ret;
	}
	if ((ret = put_u16(m, 0U))) {                   /* rcFrame.top        */
		return ret;
	}
	if ((ret = put_u16(m, (uint16_t)width))) {      /* rcFrame.right      */
		return ret;
	}
	if ((ret = put_u16(m, (uint16_t)height))) {     /* rcFrame.bottom     */
		return ret;
	}

	/* strf chunk: id + size(40) + BITMAPINFOHEADER */
	if ((ret = put_fourcc(m, "strf"))) {
		return ret;
	}
	if ((ret = put_u32(m, 40U))) {
		return ret;
	}
	if ((ret = put_u32(m, 40U))) {                  /* biSize             */
		return ret;
	}
	if ((ret = put_u32(m, width))) {                /* biWidth            */
		return ret;
	}
	if ((ret = put_u32(m, height))) {               /* biHeight (positive)*/
		return ret;
	}
	if ((ret = put_u16(m, 1U))) {                   /* biPlanes           */
		return ret;
	}
	if ((ret = put_u16(m, 24U))) {                  /* biBitCount         */
		return ret;
	}
	if ((ret = put_fourcc(m, "MJPG"))) {            /* biCompression      */
		return ret;
	}
	if ((ret = put_u32(m, width * height * 3U))) {  /* biSizeImage        */
		return ret;
	}
	if ((ret = put_u32(m, 0U))) {                   /* biXPelsPerMeter    */
		return ret;
	}
	if ((ret = put_u32(m, 0U))) {                   /* biYPelsPerMeter    */
		return ret;
	}
	if ((ret = put_u32(m, 0U))) {                   /* biClrUsed          */
		return ret;
	}
	if ((ret = put_u32(m, 0U))) {                   /* biClrImportant     */
		return ret;
	}

	/* Backpatch strl & hdrl LIST sizes (size = bytes after the size field). */
	w_u32(m->buf + strl_size_pos, m->pos - strl_data_pos);
	w_u32(m->buf + hdrl_size_pos, m->pos - hdrl_data_pos);

	/* LIST (size) "movi" — frames go inside, finalize patches the size. */
	if ((ret = put_fourcc(m, "LIST"))) {
		return ret;
	}
	m->movi_size_pos = m->pos;
	if ((ret = put_u32(m, 0U))) {
		return ret;
	}
	m->movi_data_pos = m->pos;
	if ((ret = put_fourcc(m, "movi"))) {
		return ret;
	}

	return 0;
}

int avi_mux_write_frame(struct avi_mux *m, const void *jpeg, uint32_t size)
{
	uint32_t pad;
	int ret;

	if (m == NULL || jpeg == NULL || size == 0U) {
		return -EINVAL;
	}
	if (m->frames >= AVI_MUX_MAX_FRAMES) {
		return -ENOSPC;
	}

	pad = size & 1U;                                /* AVI chunks pad to even */

	/* Reserve room for chunk header + payload + pad + future idx1 entry +
	 * idx1 chunk header. The +24 covers (16 B for this entry + 8 B idx1 hdr
	 * incremental) so finalize() cannot fail later for *this* frame.
	 */
	if (m->pos + 8U + size + pad + 16U > m->cap) {
		return -ENOSPC;
	}

	/* Index entry: offset relative to "movi" FOURCC (de-facto convention). */
	m->idx[m->frames].offset = m->pos - m->movi_data_pos;
	m->idx[m->frames].size = size;

	if ((ret = put_fourcc(m, "00dc"))) {
		return ret;
	}
	if ((ret = put_u32(m, size))) {
		return ret;
	}
	if ((ret = put_bytes(m, jpeg, size))) {
		return ret;
	}
	if (pad && (ret = put_zeros(m, pad))) {
		return ret;
	}

	if (size > m->max_chunk) {
		m->max_chunk = size;
	}
	m->frames++;
	return 0;
}

int avi_mux_finalize(struct avi_mux *m)
{
	uint32_t idx_bytes;
	uint32_t total_bytes = 0U;
	uint32_t bps;
	uint32_t suggest;
	int ret;

	if (m == NULL) {
		return -EINVAL;
	}
	if (m->frames == 0U) {
		return -EINVAL;
	}

	/* Patch movi LIST size = bytes after its 4-byte size field. */
	w_u32(m->buf + m->movi_size_pos,
	      m->pos - m->movi_size_pos - 4U);

	/* idx1 chunk: 8-byte header + 16 bytes per entry. */
	idx_bytes = m->frames * 16U;
	if (m->pos + 8U + idx_bytes > m->cap) {
		return -ENOSPC;
	}

	if ((ret = put_fourcc(m, "idx1"))) {
		return ret;
	}
	if ((ret = put_u32(m, idx_bytes))) {
		return ret;
	}
	for (uint32_t i = 0U; i < m->frames; i++) {
		if ((ret = put_fourcc(m, "00dc"))) {
			return ret;
		}
		if ((ret = put_u32(m, AVIIF_KEYFRAME))) {
			return ret;
		}
		if ((ret = put_u32(m, m->idx[i].offset))) {
			return ret;
		}
		if ((ret = put_u32(m, m->idx[i].size))) {
			return ret;
		}
		total_bytes += m->idx[i].size;
	}

	/* RIFF size = total file size minus the 8-byte ("RIFF" + size) prefix. */
	w_u32(m->buf + m->riff_size_pos, m->pos - 8U);

	/* Frame counts in avih and strh. */
	w_u32(m->buf + m->avih_frames_pos, m->frames);
	w_u32(m->buf + m->strh_length_pos, m->frames);

	/* Hints (max bytes/sec, suggested buffer size). */
	bps = (total_bytes / m->frames) * m->fps;
	suggest = m->max_chunk + 1024U;
	w_u32(m->buf + m->avih_max_bps_pos, bps);
	w_u32(m->buf + m->avih_buf_size_pos, suggest);
	w_u32(m->buf + m->strh_buf_size_pos, suggest);

	return 0;
}
```

## src/avi_mux.h
```c
/* Copyright (C) 2026 Alif Semiconductor - All Rights Reserved.
 * Use, distribution and modification of this code is permitted under the
 * terms stated in the Alif Semiconductor Software License Agreement
 *
 * You should have received a copy of the Alif Semiconductor Software
 * License Agreement with this file. If not, please write to:
 * contact@alifsemi.com, or visit: https://alifsemi.com/license
 */

/**
 * @file avi_mux.h
 * @brief Tiny in-RAM AVI v1 muxer for MJPEG streams.
 *
 * Builds a Microsoft AVI file (RIFF / hdrl / strl(vids,MJPG) / movi / idx1)
 * directly into a caller-provided buffer. Single video stream, no audio.
 *
 * Usage:
 *   uint8_t *buf = ...; uint32_t cap = ...;
 *   struct avi_mux m;
 *   avi_mux_init(&m, buf, cap, 1280, 720, 30);
 *   for each JPEG frame:
 *       avi_mux_write_frame(&m, jpeg_bytes, jpeg_size);
 *   avi_mux_finalize(&m);    // file is now buf[0..m.pos)
 *
 * Notes:
 * - JPEG bytes passed to write_frame must be a complete Baseline JPEG
 *   (FF D8 ... FF D9), trimmed of trailing padding.
 * - File grows monotonically; nothing is ever moved or rewritten except
 *   four 32-bit size fields backpatched in finalize().
 */

#ifndef AVI_MUX_H_
#define AVI_MUX_H_

#include <stdint.h>
#include <stddef.h>

/** Hard cap on indexed frames; bumps the idx[] table footprint by 8 B each. */
#define AVI_MUX_MAX_FRAMES   32

struct avi_mux {
	uint8_t *buf;                 /**< output buffer base                  */
	uint32_t cap;                 /**< output buffer capacity in bytes     */
	uint32_t pos;                 /**< current write offset                */

	/* Backpatch positions captured during init/write. */
	uint32_t riff_size_pos;       /**< RIFF chunk size field offset        */
	uint32_t movi_size_pos;       /**< 'movi' LIST size field offset       */
	uint32_t movi_data_pos;       /**< offset of "movi" FOURCC (idx anchor)*/
	uint32_t avih_frames_pos;     /**< avih.dwTotalFrames offset           */
	uint32_t avih_max_bps_pos;    /**< avih.dwMaxBytesPerSec offset        */
	uint32_t avih_buf_size_pos;   /**< avih.dwSuggestedBufferSize offset   */
	uint32_t strh_length_pos;     /**< strh.dwLength offset                */
	uint32_t strh_buf_size_pos;   /**< strh.dwSuggestedBufferSize offset   */

	uint32_t frames;              /**< frames written so far               */
	uint32_t width, height, fps;
	uint32_t max_chunk;           /**< largest frame seen (for hints)      */

	struct {
		uint32_t offset;      /**< offset relative to "movi" FOURCC    */
		uint32_t size;        /**< frame payload size (no chunk hdr)   */
	} idx[AVI_MUX_MAX_FRAMES];
};

/**
 * @brief Initialise the muxer and write the AVI header (RIFF + hdrl + movi).
 * @return 0 on success, -EINVAL on bad args, -ENOSPC if @p cap is too small.
 */
int avi_mux_init(struct avi_mux *m, uint8_t *buf, uint32_t cap,
		 uint32_t width, uint32_t height, uint32_t fps);

/**
 * @brief Append one JPEG frame as a `00dc` chunk and record its index entry.
 * @return 0 on success, -ENOSPC if buffer or idx table is full, -EINVAL on bad args.
 */
int avi_mux_write_frame(struct avi_mux *m, const void *jpeg, uint32_t size);

/**
 * @brief Append the `idx1` chunk and backpatch RIFF/movi/frame-count fields.
 *        After this returns, @p m->buf [0 .. m->pos) is the complete AVI file.
 */
int avi_mux_finalize(struct avi_mux *m);

#endif /* AVI_MUX_H_ */
```

## src/incbin.c
```c
/* Copyright (C) 2025 Alif Semiconductor - All Rights Reserved.
 * Use, distribution and modification of this code is permitted under the
 * terms stated in the Alif Semiconductor Software License Agreement
 *
 * You should have received a copy of the Alif Semiconductor Software
 * License Agreement with this file. If not, please write to:
 * contact@alifsemi.com, or visit: https://alifsemi.com/license
 *
 */

#include "stdint.h"

#define INCBIN_DEF(name, path) \
	__asm__( \
	".global "#name"_start\n" \
	".global "#name"_end\n" \
	".section \".rodata\"\n" \
	""#name"_start:\n" \
	".incbin \"" INCBIN_BASE_DIR "/" path "\"\n" \
	""#name"_end:\n" \
	".previous\n" \
	);

INCBIN_DEF(testimg, "src/testing_images/1280x720.bin");
```
