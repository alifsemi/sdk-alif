/*
 * Copyright (C) 2026 Alif Semiconductor - All Rights Reserved.
 * Use, distribution and modification of this code is permitted under the
 * terms stated in the Alif Semiconductor Software License Agreement
 *
 * You should have received a copy of the Alif Semiconductor Software
 * License Agreement with this file. If not, please write to:
 * contact@alifsemi.com, or visit: https://alifsemi.com/license
 *
 */

&jpeg0 {
	status = "okay";
	quality-factor = <75>;
	max-burst-length = <64>;
};

/* Jpeg's AIPM run profile */
&aipm_run_default {
	memory-blocks = < (ALIF_SRAM0_MASK | ALIF_MRAM_MASK) >;
};
