## Kconfig
```
# SPDX-FileCopyrightText: Copyright Alif Semiconductor
# SPDX-License-Identifier: Apache-2.0

menu "MSC sample options"

config APP_WIPE_STORAGE
	bool "Option to clear the flash area before mounting"
	help
	  Use this to force an existing file system to be created.

config APP_MSC_STORAGE_NONE
	bool "Use RAM disk as block device (no file system)"
	help
	  Enable a RAM-based disk without any file system.
	  Useful for basic USB MSC testing.

config APP_MSC_STORAGE_RAM
	bool "Use RAM disk and FAT file system"
	imply FILE_SYSTEM
	imply FAT_FILESYSTEM_ELM

config APP_MSC_STORAGE_FLASH_FATFS
	bool "Use FLASH disk and FAT file system"
	imply DISK_DRIVER_FLASH
	imply FILE_SYSTEM
	imply FAT_FILESYSTEM_ELM

config APP_MSC_STORAGE_FLASH_LITTLEFS
	bool "Use FLASH disk and LittleFS"
	imply DISK_DRIVER_FLASH
	imply FILE_SYSTEM
	imply FILE_SYSTEM_LITTLEFS

config APP_MSC_STORAGE_SDCARD
	bool "Use SDHC and FAT file system"
	imply DISK_DRIVER_SDMMC
	imply FILE_SYSTEM
	imply FAT_FILESYSTEM_ELM

config MASS_STORAGE_DISK_NAME
	default "NAND" if DISK_DRIVER_FLASH
	default "RAM" if DISK_DRIVER_RAM
	default "SD" if DISK_DRIVER_SDMMC

if DISK_DRIVER_FLASH

config FLASH_MAP
	default y

config FLASH_PAGE_LAYOUT
	default y

config FLASH_LOG_LEVEL
	default 3

endif # DISK_DRIVER_FLASH

endmenu

# Source common USB sample options used to initialize new experimental USB
# device stack. The scope of these options is limited to USB samples in project
# tree, you cannot use them in your own application.
source "samples/subsys/usb/common/Kconfig.sample_usbd"

source "Kconfig.zephyr"
```

## sample.yaml
```
sample:
  name: USB Mass Storage (Alif)
tests:
  # Multi-partition: RAM + OSPI flash (FAT) + SD card (FAT) — 3 LUNs
  # Uses the default prj.conf which enables all three back-ends.
  sample.usb.alif_mass_multi_partition:
    min_ram: 128
    modules:
      - fatfs
    depends_on: usbd
    platform_allow:
      - alif_b1_dk/ab1c1f4m51820hh0/rtss_he
      - alif_e7_dk/ae722f80f55d5xx/rtss_hp
      - alif_e8_dk/ae822fa0e5597xx0/rtss_hp
    integration_platforms:
      - alif_e8_dk/ae822fa0e5597xx0/rtss_hp
    extra_args:
      - SNIPPET="alif-msc-ramdisk-ospi-sd"
    extra_configs:
      - CONFIG_LOG_DEFAULT_LEVEL=3
    tags:
      - msd
      - usb
    harness: console
    harness_config:
      type: multi_line
      ordered: true
      regex:
        - "End of files"
        - "The device is put in USB mass storage mode."

  # Single partition: OSPI flash with FAT file system — 1 LUN
  sample.usb.alif_mass_flash_fatfs:
    min_ram: 32
    modules:
      - fatfs
    depends_on: usbd
    platform_allow:
      - alif_b1_dk/ab1c1f4m51820hh0/rtss_he
      - alif_e7_dk/ae722f80f55d5xx/rtss_hp
      - alif_e8_dk/ae822fa0e5597xx0/rtss_hp
    integration_platforms:
      - alif_e8_dk/ae822fa0e5597xx0/rtss_hp
    extra_args:
      - SNIPPET="alif-msc-ramdisk-ospi-sd"
    extra_configs:
      - CONFIG_LOG_DEFAULT_LEVEL=3
      - CONFIG_APP_MSC_STORAGE_FLASH_FATFS=y
      - CONFIG_USBD_MSC_LUNS_PER_INSTANCE=1
      - CONFIG_APP_MSC_STORAGE_SDCARD=n
    tags:
      - msd
      - usb
    harness: console
    harness_config:
      type: multi_line
      ordered: true
      regex:
        - "End of files"
        - "The device is put in USB mass storage mode."

  # Single partition: SD card with FAT file system — 1 LUN
  sample.usb.alif_mass_sdhc_fatfs:
    min_ram: 32
    modules:
      - fatfs
    depends_on: usbd
    platform_allow:
      - alif_b1_dk/ab1c1f4m51820hh0/rtss_he
      - alif_e7_dk/ae722f80f55d5xx/rtss_hp
      - alif_e8_dk/ae822fa0e5597xx0/rtss_hp
    integration_platforms:
      - alif_e8_dk/ae822fa0e5597xx0/rtss_hp
    extra_args:
      - SNIPPET="alif-msc-ramdisk-ospi-sd"
    extra_configs:
      - CONFIG_LOG_DEFAULT_LEVEL=3
      - CONFIG_APP_MSC_STORAGE_SDCARD=y
      - CONFIG_USBD_MSC_LUNS_PER_INSTANCE=1
      - CONFIG_APP_MSC_STORAGE_FLASH_FATFS=n
    tags:
      - msd
      - usb
    harness: console
    harness_config:
      fixture: fixture_sdcard
      type: multi_line
      ordered: true
      regex:
        - "End of files"
        - "The device is put in USB mass storage mode."

  # Single partition: RAM disk with FAT file system — 1 LUN
  sample.usb.alif_mass_ram_fat:
    min_ram: 128
    modules:
      - fatfs
    depends_on: usbd
    platform_allow:
      - alif_b1_dk/ab1c1f4m51820hh0/rtss_he
      - alif_e7_dk/ae722f80f55d5xx/rtss_hp
      - alif_e8_dk/ae822fa0e5597xx0/rtss_hp
    integration_platforms:
      - alif_e8_dk/ae822fa0e5597xx0/rtss_hp
    extra_args:
      - SNIPPET="alif-msc-ramdisk-ospi-sd"
    extra_configs:
      - CONFIG_LOG_DEFAULT_LEVEL=3
      - CONFIG_APP_MSC_STORAGE_RAM=y
      - CONFIG_USBD_MSC_LUNS_PER_INSTANCE=1
      - CONFIG_APP_MSC_STORAGE_FLASH_FATFS=n
      - CONFIG_APP_MSC_STORAGE_SDCARD=n
    tags:
      - msd
      - usb
    harness: console
    harness_config:
      type: multi_line
      ordered: true
      regex:
        - "End of files"
        - "The device is put in USB mass storage mode."
```

## prj.conf
```kconfig
# SPDX-FileCopyrightText: Copyright Alif Semiconductor
# SPDX-License-Identifier: Apache-2.0

# USB device MSC support
CONFIG_USB_DEVICE_STACK_NEXT=y

CONFIG_STDOUT_CONSOLE=y
CONFIG_SERIAL=y
CONFIG_UART_LINE_CTRL=y
CONFIG_USBD_MSC_CLASS=y
CONFIG_USBD_MSC_LUNS_PER_INSTANCE=3

CONFIG_LOG=y
CONFIG_USBD_LOG_LEVEL_WRN=y
CONFIG_UDC_DRIVER_LOG_LEVEL_WRN=y

CONFIG_SAMPLE_USBD_PID=0x0008
CONFIG_SAMPLE_USBD_PRODUCT="USBD MSC sample"
CONFIG_MAIN_STACK_SIZE=2048

# MSC OSPI Flash App Configuration
CONFIG_APP_MSC_STORAGE_FLASH_FATFS=y

# OSPI driver configuration
CONFIG_FLASH=y
# For MRAM boot please enable below two configs
# For TCM boot Disable CONFIG_USE_DT_CODE_PARTITION
CONFIG_USE_DT_CODE_PARTITION=y
CONFIG_FLASH_BASE_ADDRESS=0x80000000

# SD card App support
CONFIG_APP_MSC_STORAGE_SDCARD=y

# FATFS
CONFIG_FS_FATFS_WINDOW_ALIGNMENT=512
CONFIG_FS_FATFS_LFN=y
CONFIG_FS_LOG_LEVEL_INF=y

# SDHC LOG
CONFIG_SDHC_LOG_LEVEL_INF=y

# SDHC DMA
CONFIG_SDHC_DWC=y
CONFIG_SDHC_DWC_ADMA=y
CONFIG_SDHC_RSP_136_HAS_CRC=y

# Regulator < SDHC Init priority <= USB
CONFIG_SDHC_INIT_PRIORITY=80

#SD PWR
CONFIG_REGULATOR=y
```

## src/main.c
```c
/*
 * SPDX-FileCopyrightText: Copyright Alif Semiconductor
 * SPDX-License-Identifier: Apache-2.0
 */

#include <sample_usbd.h>

#include <zephyr/kernel.h>
#include <zephyr/logging/log.h>
#include <zephyr/usb/usbd.h>
#include <zephyr/usb/class/usbd_msc.h>
#include <zephyr/fs/fs.h>

LOG_MODULE_REGISTER(main);

#if CONFIG_DISK_DRIVER_FLASH
#include <zephyr/storage/flash_map.h>
#endif

#if CONFIG_FAT_FILESYSTEM_ELM
#include <ff.h>
#endif

#if CONFIG_FILE_SYSTEM_LITTLEFS
#include <zephyr/fs/littlefs.h>
FS_LITTLEFS_DECLARE_DEFAULT_CONFIG(storage);
#endif

#if !defined(CONFIG_DISK_DRIVER_FLASH) && \
	!defined(CONFIG_DISK_DRIVER_RAM) && \
	!defined(CONFIG_DISK_DRIVER_SDMMC)
#error No supported disk driver enabled
#endif

#if CONFIG_DISK_DRIVER_FLASH
#define STORAGE_PARTITION		ospi_storage_partition
#define STORAGE_PARTITION_ID		FIXED_PARTITION_ID(STORAGE_PARTITION)
#endif

static struct usbd_context *sample_usbd;

#if CONFIG_DISK_DRIVER_RAM
USBD_DEFINE_MSC_LUN(ram, "RAM", "Zephyr", "RAMDisk", "0.00");
#endif

#if CONFIG_DISK_DRIVER_FLASH
USBD_DEFINE_MSC_LUN(nand, "NAND", "Zephyr", "FlashDisk", "0.00");
#endif

#if CONFIG_DISK_DRIVER_SDMMC
USBD_DEFINE_MSC_LUN(sd, "SD", "Zephyr", "SD", "0.00");
#endif

static int enable_usb_device_next(void)
{
	int err;

	sample_usbd = sample_usbd_init_device(NULL);
	if (sample_usbd == NULL) {
		LOG_ERR("Failed to initialize USB device");
		return -ENODEV;
	}

	err = usbd_enable(sample_usbd);
	if (err) {
		LOG_ERR("Failed to enable device support");
		return err;
	}

	LOG_DBG("USB device support enabled");

	return 0;
}

static int setup_flash(void)
{
	int rc = 0;
#if CONFIG_DISK_DRIVER_FLASH
	unsigned int id;
	const struct flash_area *pfa;

	id = STORAGE_PARTITION_ID;

	rc = flash_area_open(id, &pfa);
	if (rc < 0) {
		LOG_ERR("Failed to open flash area %u: %d", id, rc);
		return rc;
	}

	LOG_INF("Area %u at 0x%x on %s for %u bytes",
		id, (unsigned int)pfa->fa_off, pfa->fa_dev->name,
		(unsigned int)pfa->fa_size);

	if (IS_ENABLED(CONFIG_APP_WIPE_STORAGE)) {
		LOG_INF("Erasing flash area ...");
		rc = flash_area_flatten(pfa, 0, pfa->fa_size);
		LOG_INF("Erase result: %d", rc);
	}

	if (rc < 0) {
		flash_area_close(pfa);
	}
#endif
	return rc;
}

struct disk_mount_info {
	const char *mnt_point;
	void *storage_dev;
	struct fs_mount_t mnt;
	union {
#if CONFIG_FAT_FILESYSTEM_ELM
		FATFS fat_fs;
#endif
#if CONFIG_FILE_SYSTEM_LITTLEFS
		struct fs_littlefs lfs_data;
#endif
	} fs_data;
};

static struct disk_mount_info disk_mounts[] = {
#if CONFIG_DISK_DRIVER_RAM
	{ .mnt_point = "/RAM:", .storage_dev = NULL },
#endif
#if CONFIG_DISK_DRIVER_FLASH
	{ .mnt_point = "/NAND:", .storage_dev = (void *)STORAGE_PARTITION_ID },
#endif
#if CONFIG_DISK_DRIVER_SDMMC
	{ .mnt_point = "/SD:", .storage_dev = NULL },
#endif
};

static void mount_and_list(struct disk_mount_info *info)
{
	struct fs_dir_t dir;
	struct fs_statvfs sbuf;
	int rc;

	fs_dir_t_init(&dir);

#if CONFIG_FAT_FILESYSTEM_ELM
	info->mnt.type = FS_FATFS;
	info->mnt.fs_data = &info->fs_data.fat_fs;
#elif CONFIG_FILE_SYSTEM_LITTLEFS
	info->mnt.type = FS_LITTLEFS;
	info->mnt.fs_data = &info->fs_data.lfs_data;
#endif
	info->mnt.mnt_point = info->mnt_point;
	info->mnt.storage_dev = info->storage_dev;

	rc = fs_mount(&info->mnt);
	if (rc < 0) {
		LOG_ERR("Failed to mount %s: %d", info->mnt_point, rc);
		return;
	}

	LOG_INF("Mount %s %d", info->mnt_point, rc);

	rc = fs_statvfs(info->mnt_point, &sbuf);
	if (rc < 0) {
		LOG_ERR("statvfs %s: %d", info->mnt_point, rc);
	} else {
		LOG_INF("%s: bsize = %lu ; frsize = %lu ;"
			" blocks = %lu ; bfree = %lu",
			info->mnt_point,
			sbuf.f_bsize, sbuf.f_frsize,
			sbuf.f_blocks, sbuf.f_bfree);
	}

	rc = fs_opendir(&dir, info->mnt_point);
	LOG_INF("%s opendir: %d", info->mnt_point, rc);

	if (rc < 0) {
		LOG_ERR("Failed to open directory");
		return;
	}

	while (rc >= 0) {
		struct fs_dirent ent = { 0 };

		rc = fs_readdir(&dir, &ent);
		if (rc < 0) {
			LOG_ERR("Failed to read directory entries");
			break;
		}
		if (ent.name[0] == 0) {
			LOG_INF("End of files");
			break;
		}
		LOG_INF("  %c %u %s",
			(ent.type == FS_DIR_ENTRY_FILE) ? 'F' : 'D',
			ent.size,
			ent.name);
	}

	(void)fs_closedir(&dir);
}

static void setup_disk(void)
{
	if (IS_ENABLED(CONFIG_DISK_DRIVER_FLASH)) {
		int rc;

		rc = setup_flash();
		if (rc < 0) {
			LOG_ERR("Failed to setup flash area");
			return;
		}
	}

	if (!IS_ENABLED(CONFIG_FILE_SYSTEM_LITTLEFS) &&
	    !IS_ENABLED(CONFIG_FAT_FILESYSTEM_ELM)) {
		LOG_INF("No file system selected");
		return;
	}

	for (int i = 0; i < ARRAY_SIZE(disk_mounts); i++) {
		mount_and_list(&disk_mounts[i]);
	}
}

int main(void)
{
	int ret;

	setup_disk();

	ret = enable_usb_device_next();
	if (ret != 0) {
		LOG_ERR("Failed to enable USB");
		return 0;
	}

	LOG_INF("The device is put in USB mass storage mode.");
	return 0;
}
```
