## CMakeLists.txt
```
cmake_minimum_required(VERSION 3.20.0)

# Locate the alif-mlek west module. It provides the Vela-compiled models and the
# source-generator CMake helpers used to turn a .tflite into a C array. Ask west
# for the module path instead of hardcoding the workspace layout.
execute_process(
    COMMAND west list --format "{abspath}" alif-mlek
    WORKING_DIRECTORY ${CMAKE_CURRENT_SOURCE_DIR}
    OUTPUT_VARIABLE MLEK_ROOT
    OUTPUT_STRIP_TRAILING_WHITESPACE
    RESULT_VARIABLE MLEK_LIST_RESULT
    ERROR_QUIET
)
if (MLEK_LIST_RESULT OR NOT EXISTS ${MLEK_ROOT})
    message(FATAL_ERROR
        "alif-mlek module not found. Enable and fetch it first:\n"
        "  west config manifest.project-filter -- +alif-mlek\n"
        "  west update\n")
endif()

# Make the MLEK source-generator helpers (setup_source_generator,
# generate_model_code) available without pulling in the full MLEK examples lib.
set(MLEK_SCRIPTS_DIR ${MLEK_ROOT}/scripts)
list(APPEND CMAKE_MODULE_PATH ${MLEK_SCRIPTS_DIR}/cmake)
include(source_gen_utils)

# ---------------------------------------------------------------------------
# Ethos-U NPU selection
# ---------------------------------------------------------------------------
# When ETHOSU_TARGET_NPU_CONFIG is provided on the command line it is the single
# source of truth for the NPU. We must act on it BEFORE find_package(Zephyr) so
# that the matching Kconfig choice (CONFIG_ARM_ETHOS_U<arch>_<macs>) is fed into
# the build and the Ethos-U driver targets the requested NPU. This overrides the
# board default (E8 rtss_hp defaults to Ethos-U55 with 256 MACs).
#
# The parsed value is also used to pick the correct Vela-compiled model below.
# Vela config-ID prefix: U55 -> H, U65 -> Y, U85 -> Z (e.g. ethos-u85-256 -> Z256).
if (DEFINED ETHOSU_TARGET_NPU_CONFIG)
    string(TOLOWER "${ETHOSU_TARGET_NPU_CONFIG}" _npu_cfg)
    if (_npu_cfg MATCHES "^ethos-(u[0-9]+)-([0-9]+)$")
        set(_npu_arch "${CMAKE_MATCH_1}")
        set(_npu_macs "${CMAKE_MATCH_2}")
        if (_npu_arch STREQUAL "u55")
            set(_npu_prefix "H")
        elseif (_npu_arch STREQUAL "u65")
            set(_npu_prefix "Y")
        elseif (_npu_arch STREQUAL "u85")
            set(_npu_prefix "Z")
        else()
            message(FATAL_ERROR
                "Unsupported Ethos-U architecture '${_npu_arch}' in "
                "ETHOSU_TARGET_NPU_CONFIG='${ETHOSU_TARGET_NPU_CONFIG}'")
        endif()
        set(ETHOS_U_NPU_CONFIG_ID "${_npu_prefix}${_npu_macs}")

        # Feed the matching Kconfig choice into the Zephyr configuration.
        string(TOUPPER "${_npu_arch}" _npu_arch_uc)
        set(CONFIG_ARM_ETHOS_${_npu_arch_uc}_${_npu_macs} y
            CACHE INTERNAL "Selected Ethos-U NPU configuration" FORCE)
        message(STATUS
            "Ethos-U: ETHOSU_TARGET_NPU_CONFIG=${ETHOSU_TARGET_NPU_CONFIG} -> "
            "CONFIG_ARM_ETHOS_${_npu_arch_uc}_${_npu_macs}=y, model ID ${ETHOS_U_NPU_CONFIG_ID}")
    else()
        message(FATAL_ERROR
            "Invalid ETHOSU_TARGET_NPU_CONFIG='${ETHOSU_TARGET_NPU_CONFIG}'.\n"
            "Expected format: ethos-u<arch>-<macs>, e.g. ethos-u55-256 or ethos-u85-256")
    endif()
endif()

find_package(Zephyr REQUIRED HINTS $ENV{ZEPHYR_BASE})
project(alif_inference)

# ---------------------------------------------------------------------------
# Build-time model generation from MLEK resources
# ---------------------------------------------------------------------------
set(RESOURCES_PATH ${MLEK_ROOT}/resources_downloaded CACHE PATH
    "Path to MLEK resources (models compiled with Vela)")
setup_source_generator()

# Source generation output directory
set(SRC_GEN_DIR ${CMAKE_CURRENT_BINARY_DIR}/generated/src)
file(MAKE_DIRECTORY ${SRC_GEN_DIR})

# Determine NPU config ID based on Zephyr Kconfig.
# If ETHOSU_TARGET_NPU_CONFIG was supplied on the command line, ETHOS_U_NPU_CONFIG_ID
# has already been computed above. Otherwise fall back to the board Kconfig defaults.
if (NOT DEFINED ETHOS_U_NPU_CONFIG_ID)
    if (CONFIG_ARM_ETHOS_U85_256)
        set(ETHOS_U_NPU_CONFIG_ID "Z256")
    elseif (CONFIG_ARM_ETHOS_U55_256)
        set(ETHOS_U_NPU_CONFIG_ID "H256")
    else()
        set(ETHOS_U_NPU_CONFIG_ID "H128")
    endif()
endif()

# Model file path
set(KWS_MODEL_PATH ${RESOURCES_PATH}/kws/kws_micronet_m_vela_${ETHOS_U_NPU_CONFIG_ID}.tflite
    CACHE FILEPATH "Path to the KWS TFLite model (Vela-compiled)")

if (NOT EXISTS ${KWS_MODEL_PATH})
    message(FATAL_ERROR
        "KWS model not found at ${KWS_MODEL_PATH}\n"
        "Run set_up_default_resources.py first:\n"
        "  python3 ${MLEK_ROOT}/set_up_default_resources.py\n")
endif()

# Validate the generated model C array against the selected NPU.
set(ETHOS_U_NPU_ENABLED ON)

# Generate model C array and parameter constants
set(EXTRA_MODEL_CODE
    "/* Model parameters for alif_inference */"
    "extern const int   g_FrameLength    = 640"
    "extern const int   g_FrameStride    = 320"
    "extern const int   g_AudioRate      = 16000"
    "extern const float g_ScoreThreshold = 0.5"
)

generate_model_code(
    MODEL_PATH  ${KWS_MODEL_PATH}
    DESTINATION ${SRC_GEN_DIR}
    EXPRESSIONS ${EXTRA_MODEL_CODE}
    NAMESPACE   "arm" "app" "kws"
)

# Collect the generated source files
file(GLOB KWS_GENERATED_SOURCES ${SRC_GEN_DIR}/*.cc)

# ---------------------------------------------------------------------------

target_include_directories(app PRIVATE
    src
    ../../alif_common
    ../../alif_common/audio
    ../../alif_common/audio/include
)

target_sources(app PRIVATE
    src/mfcc/PlatformMath.cc
    src/mfcc/KwsProcessing.cc
    src/mfcc/Mfcc.cc
    src/main.cpp
    src/KWSModel.cpp
    src/LiveMicInput.cpp
    ../../alif_common/audio/AudioBackend.cpp
    ${KWS_GENERATED_SOURCES}
)
```

## Kconfig
```
# Copyright (C) 2025 Alif Semiconductor - All Rights Reserved.
# Use, distribution and modification of this code is permitted under the
# terms stated in the Alif Semiconductor Software License Agreement
#
# You should have received a copy of the Alif Semiconductor Software
# License Agreement with this file. If not, please write to:
# contact@alifsemi.com, or visit: https://alifsemi.com/license


config ACTIVATION_BUF_SECTION
	string "Linker section where activation buffer (tensor arena) is placed"
	default ".bss.activation_buf"

config ACTIVATION_BUF_SZ
	hex "Tensor arena size"
	default 0x20000

config MODEL_IN_EXT_FLASH
	bool "Put ML model to external flash"
	select FLASH
	select ALIF_OSPI_FLASH_XIP
	help
		Initialize OSPI controller to XIP mode. Initialize the onboard flash device. Link ML model data to external flash address space.
		In addition to normal zephyr.bin output, ospi1.bin is generated. When enabled, the model memory section is set automatically (See BufAttributes.h)

config MODEL_SECTION
	string "Linker section where ML model is placed"
	depends on !MODEL_IN_EXT_FLASH
	default ".rodata.tflm_model"

config I2S_SAMPLE_RATE
	int "I2S sampling rate"
	default 16000

config I2S_CHANNELS
	int "Number of I2S channels"
	default 2

config I2S_SAMPLES
	int "Number of samples per slab buffer"
	default 400

config I2S_NUM_BUFFERS
	int "Number of I2S slab buffers to allocate"
	default 2

config I2S_GAIN
	int "Fixed linear again applied to I2S samples (e.g 10 = 20dB gain)"
	default 20

# Configuration required by the shared AudioBackend (alif_common/audio)

config AUDIO_CHANNELS
	int "Number of input audio channels"
	default 2

config SAMPLE_CNT
	int "Number of samples per slab buffer"
	default 400

config AUDIO_STRIDE
	int "Number of audio samples in a single stride"
	default 8000

config NUM_BUFFERS
	int "Number of slab buffers to allocate"
	default 2

config THREAD_STACK_SIZE
	int "Stack size of audio thread"
	default 1024

config THREAD_PRIORITY
	int "Priority of audio thread"
	default 0

source "Kconfig.zephyr"
```

## prj.conf
```kconfig
#application default configuration
# include TFLM based on CMSIS NN optimization and ETHOSU acceleration
CONFIG_CPP=y
CONFIG_STD_CPP17=y
CONFIG_TENSORFLOW_LITE_MICRO=y
CONFIG_ARM_ETHOS_U=y
CONFIG_HEAP_MEM_POOL_SIZE=16384
CONFIG_LOG=y
CONFIG_LOG_MODE_IMMEDIATE=y
#CONFIG_ARM_ETHOS_U_LOG_LEVEL_DBG=y
CONFIG_BUILD_NO_GAP_FILL=y
CONFIG_REQUIRES_FULL_LIBC=y
CONFIG_NEWLIB_LIBC=y
CONFIG_REQUIRES_FULL_LIBCPP=y
CONFIG_NEWLIB_LIBC_MIN_REQUIRED_HEAP_SIZE=8192


CONFIG_I2S=y

CONFIG_CMSIS_DSP=y
CONFIG_CMSIS_DSP_TRANSFORM=y
CONFIG_CMSIS_DSP_FASTMATH=y
CONFIG_CMSIS_DSP_COMPLEXMATH=y

CONFIG_MAIN_STACK_SIZE=4096
CONFIG_CBPRINTF_FP_SUPPORT=y
```

## boards/alif_b1_dk_ab1c1f4m51820ph0_rtss_he.conf
```kconfig
# Copyright (C) Alif Semiconductor - All Rights Reserved.
# Use, distribution and modification of this code is permitted under the
# terms stated in the Alif Semiconductor Software License Agreement
# You should have received a copy of the Alif Semiconductor Software
# License Agreement with this file. If not, please write to:
# contact@alifsemi.com, or visit: https: //alifsemi.com/license


CONFIG_AUDIO=y
CONFIG_AUDIO_DMIC=y
```

## boards/alif_e8_ak_ae822fa0e5597xx0_rtss_he.conf
```kconfig
# Copyright (C) Alif Semiconductor - All Rights Reserved.
# Use, distribution and modification of this code is permitted under the
# terms stated in the Alif Semiconductor Software License Agreement
#
# You should have received a copy of the Alif Semiconductor Software
# License Agreement with this file. If not, please write to:
# contact@alifsemi.com, or visit: https: //alifsemi.com/license
#

CONFIG_AUDIO=y
CONFIG_AUDIO_DMIC=y
CONFIG_I2S=n
CONFIG_I2S_GAIN=1
```

## boards/alif_e8_ak_ae822fa0e5597xx0_rtss_hp.conf
```kconfig
# Copyright (C) Alif Semiconductor - All Rights Reserved.
# Use, distribution and modification of this code is permitted under the
# terms stated in the Alif Semiconductor Software License Agreement
#
# You should have received a copy of the Alif Semiconductor Software
# License Agreement with this file. If not, please write to:
# contact@alifsemi.com, or visit: https://alifsemi.com/license
#

CONFIG_AUDIO=y
CONFIG_AUDIO_DMIC=y
```

## boards/alif_e1c_dk_ae1c1f4051920hh_rtss_he.overlay
```dts
/* Copyright (C) Alif Semiconductor - All Rights Reserved.
 * Use, distribution and modification of this code is permitted under the
 * terms stated in the Alif Semiconductor Software License Agreement
 *
 * You should have received a copy of the Alif Semiconductor Software
 * License Agreement with this file. If not, please write to:
 * contact@alifsemi.com, or visit: https: //alifsemi.com/license
 *
 */

/ {
	aliases {
		pdm-audio = &lppdm;
	};
};

&lppdm {
	status = "okay";
};
```

## boards/alif_e7_dk_ae722f80f55d5xx_rtss_he.overlay
```dts
/* Copyright (C) 2025 Alif Semiconductor - All Rights Reserved.
 * Use, distribution and modification of this code is permitted under the
 * terms stated in the Alif Semiconductor Software License Agreement
 *
 * You should have received a copy of the Alif Semiconductor Software
 * License Agreement with this file. If not, please write to:
 * contact@alifsemi.com, or visit: https: //alifsemi.com/license
 *
 */

/ {
	aliases {
		i2s-mic = &i2s3;
	};
};

&i2s3 {
	status = "okay";
};

&ospi1 {
	bus-speed = <100000000>;
	status = "okay";
};
```

## boards/alif_e8_ak_ae822fa0e5597xx0_rtss_he.overlay
```dts
/* Copyright (C) Alif Semiconductor - All Rights Reserved.
 * Use, distribution and modification of this code is permitted under the
 * terms stated in the Alif Semiconductor Software License Agreement
 *
 * You should have received a copy of the Alif Semiconductor Software
 * License Agreement with this file. If not, please write to:
 * contact@alifsemi.com, or visit: https://alifsemi.com/license
 *
 */

/ {
	aliases {
		pdm-audio = &pdm;
	};
};

&pdm {
	status = "okay";
};
```

## boards/alif_e8_dk_ae822fa0e5597xx0_rtss_hp.overlay
```dts
/* Copyright (C) Alif Semiconductor - All Rights Reserved.
 * Use, distribution and modification of this code is permitted under the
 * terms stated in the Alif Semiconductor Software License Agreement
 *
 * You should have received a copy of the Alif Semiconductor Software
 * License Agreement with this file. If not, please write to:
 * contact@alifsemi.com, or visit: https: //alifsemi.com/license
 *
 */

/ {
	aliases {
		i2s-mic = &i2s4;
	};
};

&i2s4 {
	status = "okay";
};
```

## src/main.cpp
```c
#include <zephyr/kernel.h>
#include <zephyr/logging/log.h>

#include <algorithm>
#include <limits>
#include <vector>

#include "KWSModel.h"
#include "LiveMicInput.h"
#include "InferenceRunner.h"

LOG_MODULE_REGISTER(main);


template <typename T>
class PrintHighestConfidence {
public:
    void ProcessOutput(const T& result) {
        const auto it = std::max_element(result.confidences.begin(), result.confidences.end());
        const auto highest_idx = std::distance(result.confidences.begin(), it);

        LOG_INF("%s: %f", T::Result::GetLabelName(highest_idx),
            static_cast<double>(result.confidences[highest_idx]));
    }
};

int main()
{
    InferenceRunner<KWSModel,
        LiveMicInput,
        PrintHighestConfidence<KWSModel::Result>> 
        runner;

    LOG_INF("Starting runner");
    runner.Start();

    while (true) {
        k_usleep(1000);
    }

    return 0;
}
```

## src/BufAttributes.hpp
```c
/*
 * SPDX-FileCopyrightText: Copyright 2021 Arm Limited and/or its affiliates
 * <open-source-office@arm.com> SPDX-License-Identifier: Apache-2.0
 *
 * Licensed under the Apache License, Version 2.0 (the "License");
 * you may not use this file except in compliance with the License.
 * You may obtain a copy of the License at
 *
 *     http://www.apache.org/licenses/LICENSE-2.0
 *
 * Unless required by applicable law or agreed to in writing, software
 * distributed under the License is distributed on an "AS IS" BASIS,
 * WITHOUT WARRANTIES OR CONDITIONS OF ANY KIND, either express or implied.
 * See the License for the specific language governing permissions and
 * limitations under the License.
 */

#ifndef BUF_ATTRIBUTES_HPP
#define BUF_ATTRIBUTES_HPP

#include <zephyr/devicetree.h>

#define BYTE_ALIGNMENT         16
#define ALIGNMENT_REQ          aligned(BYTE_ALIGNMENT)
#define ACTIVATION_BUF_SECTION section(CONFIG_ACTIVATION_BUF_SECTION)

#if CONFIG_MODEL_IN_EXT_FLASH
#define MODEL_SECTION                                                                              \
	section(".alif_extflash_" DT_PROP(DT_NODELABEL(ext_flash_xip), zephyr_memory_region))
#else
#define MODEL_SECTION section(CONFIG_MODEL_SECTION)
#endif

#define MAKE_ATTRIBUTE(x)        __attribute__((ALIGNMENT_REQ, x))
#define MODEL_TFLITE_ATTRIBUTE   MAKE_ATTRIBUTE(MODEL_SECTION)
#define MODEL_SECTION_ATTRIBUTE  MODEL_TFLITE_ATTRIBUTE
#define ACTIVATION_BUF_ATTRIBUTE MAKE_ATTRIBUTE(ACTIVATION_BUF_SECTION)
#define LABELS_ATTRIBUTE

#endif /* BUF_ATTRIBUTES_HPP */
```

## src/InferenceRunner.h
```c
#ifndef INFERENCERUNNER_H
#define INFERENCERUNNER_H

#include <zephyr/kernel.h>

/**
 * @brief InferenceRunner: A reusable threaded inference loop for embedded ML using Zephyr RTOS.
 *
 * This class encapsulates the logic of executing a model inference pipeline in a dedicated Zephyr thread.
 * It handles input collection, preprocessing, model execution, postprocessing, and output handling.
 *
 * @tparam Model          ML model class providing inference logic and buffer access.
 *                        Required interface:
 *                        ----------------------------------------
 *                        static constexpr size_t InputSize;    // In bytes
 *                        bool Init();
 *                        bool PreProcess();
 *                        bool RunInference();
 *                        bool PostProcess();
 *                        void* GetInputBuffer(); // Returns pointer to buffer of InputSize bytes
 *                        auto GetResult();       // Returns processed inference result
 *                        ----------------------------------------
 *                        Notes:
 *                        - InputSize must exactly match Input::OutputSize.
 *
 * @tparam Input          Class responsible for supplying raw input data to the model.
 *                        Required interface:
 *                        ----------------------------------------
 *                        static constexpr size_t OutputSize;   // In bytes
 *                        bool Start(); // Begins input data stream or source
 *                        bool Stop();  // Ends input data stream or source
 *                        bool GetInputData(void* buffer); // Blocks until buffer is filled with OutputSize bytes
 *                        ----------------------------------------
 *
 * @tparam OutputHandler  Class responsible for consuming the model's result.
 *                        Required interface:
 *                        ----------------------------------------
 *                        template<typename T>
 *                        class OutputHandler {
 *                            void ProcessOutput(const T& result);
 *                        };
 *                        ----------------------------------------
 *                        Notes:
 *                        - Called in the inference thread context.
 *                        - Must be fast and **non-blocking**.
 *                        - If multi-threaded communication is required, use queues/semaphores.
 *
 * @tparam StackSize      Size of the Zephyr thread's stack (default: 2024 bytes).
 * @tparam ThreadPriority Zephyr thread priority (default: 10).
 *
 * @note Copy/move constructors and assignment operators are disabled due to internal thread/stack ownership.
 * @note The thread starts once via `Start()` and terminates cleanly in the destructor.
 *
 * @example
 *   using MyRunner = InferenceRunner<MyModel, MyInput, MyOutputHandler<MyModel::Result>>;
 *   MyRunner runner;
 *   runner.Start();
 */

template <typename Model,
    typename Input,
    typename OutputHandler,
    size_t StackSize = 2024,
    int ThreadPriority = 10>
class InferenceRunner {
public:
    static_assert(Model::InputSize == Input::OutputSize);

    InferenceRunner() {
        k_sem_init(&m_inferenceSem, 0, 1);
    }

    // Do not implement copy / move operations as worker thread's stack space is stored within this
    // class
    InferenceRunner(const InferenceRunner&) = delete;
    InferenceRunner& operator=(const InferenceRunner&) = delete;
    InferenceRunner(InferenceRunner&&) = delete;
    InferenceRunner& operator=(InferenceRunner&&) = delete;

    ~InferenceRunner() {
        k_sem_give(&m_inferenceSem);
	    k_thread_join(&m_inferenceThread, K_FOREVER);
    }

    void Start() {
        if (m_started) {
            return;
        }

        m_started = true;

        k_thread_create(&m_inferenceThread, m_stack, K_THREAD_STACK_SIZEOF(m_stack),
            ThreadEntry, this, NULL, NULL, ThreadPriority,
            0, K_NO_WAIT);
    }

private:
    static void ThreadEntry(void* ctx, void*, void*) {
        static_cast<InferenceRunner*>(ctx)->Run();
    }

    void Run() {
        if (!m_model.Init()) {
            return;
        }

        if (!m_input.Start()) {
            return;
        }

        while (true) {
            // Check if we need to exit with K_NO_WAIT, expect that GetInputData will
            // block for a short time (but not K_FORVER), so we can exit this thread when
            // deconstructor is hit
            if (k_sem_take(&m_inferenceSem, K_NO_WAIT) == 0) {
			    break;
		    }

            if (!m_input.GetInputData(m_model.GetInputBuffer())) {
                return;
            }

            if (!m_model.PreProcess()) {
                return;
            }

            if (!m_model.RunInference()) {
                return;
            }

            if (!m_model.PostProcess()) {
                return;
            }
            
            // Modern C++ compiler should be able to do RVO here, so copying should not be a issue.
            // Model implementation can return pointers / references if copies MUST be avoided,
            // and OutputHandler can be implemented so that it accepts pointers if needed.
            m_outputHandler.ProcessOutput(m_model.GetResult());
        }

        m_input.Stop();
    }

private:
    // TODO: should these be passed as references, so that caller is responsible for their
    // lifetime? This way is cleaner (so far), but if caller needs to access any of these classes
    // then reference might be a good idea
    Model m_model;
    Input m_input;
    OutputHandler m_outputHandler;

    // Using K_KERNEL_STACK_MEMBER will cause this class to use a lot of stack space
    // (if allocated to stack to begin with)
    K_KERNEL_STACK_MEMBER(m_stack, StackSize);
    struct k_thread m_inferenceThread;
    struct k_sem m_inferenceSem;
    bool m_started = false;
};

#endif  // INFERENCERUNNER_H
```

## src/KWSModel.cpp
```c
#include <zephyr/logging/log.h>

#include "KWSModel.h"

#include "mfcc/PlatformMath.hpp"
#include "mfcc/MicroNetKwsModel.hpp"
#include "BufAttributes.hpp"

LOG_MODULE_REGISTER(KWSModel);

// TODO: by having these as global state prevents us from having multiple instances of KWSModel
// these can be move into the class, but then these must be allocated dynamically
static uint8_t tensorArena[CONFIG_ACTIVATION_BUF_SZ] ACTIVATION_BUF_ATTRIBUTE;

// Full 1 second sample buffer
static int16_t audio_inf[CONFIG_I2S_SAMPLE_RATE];

static const char *labelsVec[] LABELS_ATTRIBUTE = {
	"down",  "go",   "left", "no",  "off",       "on",
	"right", "stop", "up",   "yes", "_silence_", "_unknown_",
};

namespace arm::app::kws {
    extern uint8_t *GetModelPointer();
    extern const int g_FrameLength;
    extern const int g_FrameStride;
}

const char* KWSModel::Result::GetLabelName(size_t index) {
    return labelsVec[index];
}

bool KWSModel::Init() {
    m_resolver.AddEthosU();

    m_pInterpreter = std::make_unique<tflite::MicroInterpreter>(
        tflite::GetModel(arm::app::kws::GetModelPointer()),
        m_resolver,
        tensorArena,
        CONFIG_ACTIVATION_BUF_SZ
    );

    const auto rc = m_pInterpreter->AllocateTensors();
    if (rc != kTfLiteOk) {
        LOG_ERR("failed to AllocateTensors");
        return false;
    }

    auto* inputTensor = m_pInterpreter->input(0);
    size_t numMfccFeatures = inputTensor->dims->data[arm::app::MicroNetKwsModel::ms_inputColsIdx];
    size_t numMfccFrames = inputTensor->dims->data[arm::app::MicroNetKwsModel::ms_inputRowsIdx];
    int mfccFrameLength = arm::app::kws::g_FrameLength;
    int mfccFrameStride = arm::app::kws::g_FrameStride;

    m_preProcess = std::make_unique<arm::app::KwsPreProcess>(
        inputTensor, numMfccFeatures, numMfccFrames, mfccFrameLength, mfccFrameStride);

    return true;
}

bool KWSModel::PreProcess() {
    if (!m_preProcess->DoPreProcess(audio_inf, m_index)) {
        LOG_ERR("preProcess.DoPreProcess failed");
        return false;
    }

    ++m_index;

    // move buffer down by one stride, clearing space at the end for the next stride
    std::copy(audio_inf + (CONFIG_I2S_SAMPLE_RATE / 2), audio_inf + CONFIG_I2S_SAMPLE_RATE,
        audio_inf);

    return true;
}

bool KWSModel::RunInference() {
    const auto rc = m_pInterpreter->Invoke();
    if (rc != kTfLiteOk) {
        LOG_ERR("Failed to run inference");
        return false;
    }

    return true;
}

bool KWSModel::PostProcess() {
    m_output.confidences.clear();

    const auto* tensor = m_pInterpreter->output(0);

    // int8 dequantize, does not work if per-axis quantization is used.
    for (size_t i = 0; i < tensor->bytes; i++) {
        float value = tensor->params.scale * (static_cast<float>(tensor->data.int8[i]) -
            tensor->params.zero_point);
        m_output.confidences.push_back(value);
    }

    arm::app::math::MathUtils::SoftmaxF32(m_output.confidences);

    return true;
}

void* KWSModel::GetInputBuffer() {
    // Fill input data to last stride in the buffer
    return &audio_inf[CONFIG_I2S_SAMPLE_RATE / 2];
}

KWSModel::Result KWSModel::GetResult() {
    return m_output;
}
```

## src/KWSModel.h
```c
#ifndef KWSMODEL_H
#define KWSMODEL_H

#include <memory>
#include <vector>

#include <tensorflow/lite/micro/micro_interpreter.h>
#include <tensorflow/lite/micro/micro_mutable_op_resolver.h>

#include "mfcc/KwsProcessing.hpp"

class KWSModel {
public:
    class Result {
    public:
        std::vector<float> confidences;
        static const char* GetLabelName(size_t index);
    };  

    // 0.5 sec stride
    static constexpr size_t InputSize = (CONFIG_I2S_SAMPLE_RATE / 2) * sizeof(int16_t);

    bool Init();
    bool PreProcess();
    bool RunInference();
    bool PostProcess();
    void* GetInputBuffer();
    Result GetResult();

private:
    std::unique_ptr<tflite::MicroInterpreter> m_pInterpreter;
    std::unique_ptr<arm::app::KwsPreProcess> m_preProcess;
    tflite::MicroMutableOpResolver<1> m_resolver;
    int m_index = 0;
    Result m_output;
};

#endif
```

## src/LiveMicInput.cpp
```c
#include "LiveMicInput.h"

#include "AudioBackend.hpp"

bool LiveMicInput::Start()
{
	return audio_init(CONFIG_I2S_SAMPLE_RATE) == 0;
}

bool LiveMicInput::Stop()
{
	audio_uninit();
	return true;
}

bool LiveMicInput::GetInputData(void *buffer)
{
	int16_t *output_buffer = static_cast<int16_t *>(buffer);
	int num_samples = OutputSize / sizeof(int16_t);

	if (get_audio_data(output_buffer, num_samples) != 0) {
		return false;
	}

	if (wait_for_audio() != 0) {
		return false;
	}

	audio_preprocessing(output_buffer, num_samples);

	return true;
}
```

## src/LiveMicInput.h
```c
#ifndef LIVEMICINPUT_H
#define LIVEMICINPUT_H

#include <cstddef>
#include <cstdint>


class LiveMicInput
{
public:
	/* 0.5 sec stride (in bytes) */
	static constexpr size_t OutputSize = (CONFIG_I2S_SAMPLE_RATE / 2) * sizeof(int16_t);

	bool Start();
	bool Stop();
	bool GetInputData(void *buffer);
};

#endif /* LIVEMICINPUT_H */
```
