## CMakeLists.txt
```
# Copyright 2021-2022 Arm Limited and/or its affiliates <open-source-office@arm.com>
#
# SPDX-License-Identifier: Apache-2.0

cmake_minimum_required(VERSION 3.20.0)

find_package(Zephyr REQUIRED HINTS $ENV{ZEPHYR_BASE})

# Detect NPU architecture from ETHOSU_TARGET_NPU_CONFIG
# This application requires Ethos-U85 with 256 MACs
if(ETHOSU_TARGET_NPU_CONFIG MATCHES "^ethos-(u[0-9]+)-([0-9]+)$")
    set(ETHOSU_ARCH "${CMAKE_MATCH_1}")
    set(ETHOSU_MACS "${CMAKE_MATCH_2}")

    message(STATUS "ETHOSU_TARGET_NPU_CONFIG: ${ETHOSU_TARGET_NPU_CONFIG}")
    message(STATUS "Detected NPU Architecture: ${ETHOSU_ARCH}, MACs: ${ETHOSU_MACS}")

    # Validate for U85 only
    if(ETHOSU_ARCH STREQUAL "u85")
        # Validate board supports U85 (E4, E8 boards)
        if(NOT (CONFIG_SOC_SERIES_E8 OR CONFIG_SOC_SERIES_E4))
            message(FATAL_ERROR 
                "BERT-Tiny transformer application requires Ethos-U85 on E4/E8 boards.\n"
                "Current board does not support U85.\n"
                "For this board, use the standard tflm_ethosu application instead.")
        endif()

        # Validate MAC configuration - U85 only supports 256 MACs on Alif boards
        if(NOT (ETHOSU_MACS STREQUAL "256"))
            message(FATAL_ERROR 
                "Unsupported U85 MAC configuration: ${ETHOSU_MACS}\n"
                "Alif Ensemble boards only support Ethos-U85 with 256 MACs.\n"
                "Use: -DETHOSU_TARGET_NPU_CONFIG=ethos-u85-256")
        endif()

        # Validate overlay file matches NPU type
        if(DEFINED EXTRA_DTC_OVERLAY_FILE)
            if(EXTRA_DTC_OVERLAY_FILE MATCHES "ethosu55\\.overlay")
                message(FATAL_ERROR 
                    "Overlay mismatch: ETHOSU_TARGET_NPU_CONFIG='${ETHOSU_TARGET_NPU_CONFIG}' (U85) "
                    "but using U55 overlay '${EXTRA_DTC_OVERLAY_FILE}'.\n"
                    "For U85, use: -DEXTRA_DTC_OVERLAY_FILE=\"boards/enable_ethosu85.overlay\"")
            endif()
        endif()

        # Set architecture flag
        set(ETHOSU_ARCH_U85 y CACHE BOOL "U85 Flag")
        add_compile_definitions(ETHOSU_ARCH_U85="${ETHOSU_ARCH_U85}")

        # Automatically set CONFIG_ARM_ETHOS_U85_256
        set(CONFIG_ARM_ETHOS_U85_256 y CACHE BOOL "U85 256 MACs" FORCE)
        message(STATUS "Auto-configured: CONFIG_ARM_ETHOS_U85_256=y")

        message(STATUS "Building BERT-Tiny for Ethos-U85 with ${ETHOSU_MACS} MACs")

    else()
        message(FATAL_ERROR 
            "BERT-Tiny transformer application requires Ethos-U85 NPU.\n"
            "Current NPU architecture: ${ETHOSU_ARCH}\n"
            "Use: -DETHOSU_TARGET_NPU_CONFIG=ethos-u85-256\n"
            "For U55 boards, please use the standard tflm_ethosu application.")
    endif()

else()
    message(FATAL_ERROR 
        "Invalid or missing ETHOSU_TARGET_NPU_CONFIG: '${ETHOSU_TARGET_NPU_CONFIG}'\n"
        "BERT-Tiny requires: -DETHOSU_TARGET_NPU_CONFIG=ethos-u85-256")
endif()

project(tflm_bert_tiny_app)

# Include directories
target_include_directories(app PRIVATE ../../../../include)
target_include_directories(app PRIVATE ../../../../include/ethosu/models/bert_tiny/u85)
target_include_directories(app PRIVATE ../../../../lib/ethosu_utils)

# Application sources (includes custom BERT-optimized inference_process)
target_sources(app PRIVATE 
    src/main.cpp
    src/inference_process_bert.cpp
)

# BERT-Tiny model sources
target_sources(app PRIVATE
    ../../../../include/ethosu/models/bert_tiny/u85/model_u85_256.c
    ../../../../include/ethosu/models/bert_tiny/u85/input.c
    ../../../../include/ethosu/models/bert_tiny/u85/output.c
)
```

## Kconfig
```
# Copyright 2021-2022 Arm Limited and/or its affiliates <open-source-office@arm.com>
#
# SPDX-License-Identifier: Apache-2.0

config TFLM_TRANSFORMER_TAINT_BLOBS
	bool
	default y
	select TAINT_BLOBS

config ETHOS_U_AXI0_ONLY
	bool "Only use AXI0 port on the Ethos-U NPU"
	default false

config MODEL_IN_EXT_FLASH
	bool "Put ML model to external flash"
	select FLASH
	select ALIF_OSPI_FLASH_XIP
	help
		Initialize OSPI controller to XIP mode. Initialize the onboard flash device. 
		Link ML model data to external flash address space.
		In addition to normal zephyr.bin output, ospi1.bin is generated.

source "Kconfig.zephyr"
```

## sample.yaml
```
sample:
  name: BERT-Tiny Transformer Model with TensorFlow Lite Micro
  description: BERT-Tiny transformer model running on ARM Ethos-U85 NPU
tests:
  sample.modules.tflite-micro.bert_tiny:
    platform_allow: alif_e8_dk_rtss_he alif_e8_dk_rtss_hp alif_e8_ak_rtss_he alif_e8_ak_rtss_hp
    tags: tflite-micro ethos-u85 transformer bert
    harness: console
    harness_config:
      type: one_line
      regex:
        - "Starting BERT-Tiny Transformer Model Demo"
```

## prj.conf
```kconfig
#application default configuration
# include TFLM based on CMSIS NN optimization and ETHOSU acceleration
CONFIG_CPP=y
CONFIG_STD_CPP17=y
CONFIG_TENSORFLOW_LITE_MICRO=y
CONFIG_ARM_ETHOS_U=y
CONFIG_HEAP_MEM_POOL_SIZE=16384
CONFIG_LOG=y
CONFIG_LOG_MODE_IMMEDIATE=y
CONFIG_ARM_ETHOS_U_LOG_LEVEL_DBG=y

# Build output configuration (Zephyr 4.1 compatible - replaces deprecated BUILD_NO_GAP_FILL)
CONFIG_BUILD_OUTPUT_HEX_GAP_FILL=n
CONFIG_BUILD_OUTPUT_S19_GAP_FILL=n

CONFIG_REQUIRES_FULL_LIBC=y
CONFIG_NEWLIB_LIBC=y
CONFIG_REQUIRES_FULL_LIBCPP=y
CONFIG_NEWLIB_LIBC_MIN_REQUIRED_HEAP_SIZE=8192

# Application stack sizes for BERT-Tiny model (reduced to fit DTCM)
CONFIG_MAIN_STACK_SIZE=4096
CONFIG_SYSTEM_WORKQUEUE_STACK_SIZE=2048
```

## boards/alif_e8_ak_rtss_he.overlay
```dts
/* Copyright (C) Alif Semiconductor - All Rights Reserved.
 * Use, distribution and modification of this code is permitted under the
 * terms stated in the Alif Semiconductor Software License Agreement
 *
 * You should have received a copy of the Alif Semiconductor Software
 * License Agreement with this file. If not, please write to:
 * contact@alifsemi.com, or visit: https://alifsemi.com/license
 *
 */

#include "alif_e8_common.overlay"
```

## boards/alif_e8_common.overlay
```dts
/* Copyright (C) Alif Semiconductor - All Rights Reserved.
 * Use, distribution and modification of this code is permitted under the
 * terms stated in the Alif Semiconductor Software License Agreement
 *
 * You should have received a copy of the Alif Semiconductor Software
 * License Agreement with this file. If not, please write to:
 * contact@alifsemi.com, or visit: https://alifsemi.com/license
 *
 */

/* Use SRAM1 for additional memory - E8 has 4MB SRAM1 */
&sram1 {
	status = "okay";
};

&ospi1 {
	bus-speed = <100000000>;
	status = "okay";
};
```

## boards/alif_e8_dk_rtss_hp.overlay
```dts
/* Copyright (C) 2025 Alif Semiconductor - All Rights Reserved.
 * Use, distribution and modification of this code is permitted under the
 * terms stated in the Alif Semiconductor Software License Agreement
 *
 * You should have received a copy of the Alif Semiconductor Software
 * License Agreement with this file. If not, please write to:
 * contact@alifsemi.com, or visit: https://alifsemi.com/license
 *
 */

/* Use SRAM1 for additional memory - E8 has 4MB SRAM1 */
&sram1 {
	status = "okay";
};

&ospi1 {
	bus-speed = <100000000>;
	status = "okay";
};
```

## boards/enable_ethosu85.overlay
```dts
/* Copyright (C) 2025 Alif Semiconductor - All Rights Reserved.
 * Use, distribution and modification of this code is permitted under the
 * terms stated in the Alif Semiconductor Software License Agreement
 *
 * You should have received a copy of the Alif Semiconductor Software
 * License Agreement with this file. If not, please write to:
 * contact@alifsemi.com, or visit: https://alifsemi.com/license
 *
 */

/*
 * Ethos-U85 NPU Enable Overlay
 * 
 * This overlay enables the Ethos-U85 NPU (ethosu1) for boards that support it.
 * 
 * Applicable Boards (have both U55 and U85):
 *   - E8 (alif_e8_dk) - has U55 + U85
 *
 * NOT applicable to:
 *   - B1, E1C, E7 (have U55 only, no U85)
 * 
 * Note: E4, E8 boards have BOTH ethosu0 (U55) and ethosu1 (U85).
 *       Use this overlay to enable the U85 NPU on these boards.
 * 
 * Usage:
 *   west build -b alif_e8_dk/<variant>/<core> <app_path> -- \
 *     -DEXTRA_DTC_OVERLAY_FILE="boards/enable_ethosu85.overlay"
 * 
 * Build-time Safety Check:
 *   If this overlay is applied to a board without U85 support (B1, E1C, E3, E7),
 *   the build will fail with an error message indicating that ethosu1 node
 *   does not exist on this board.
 */

/ {
	/* Compile-time assertion: ethosu1 must exist */
	ethosu_u85_check {
		compatible = "vnd,ethosu-u85-check";
		ethosu-node = <&ethosu1>;
	};
};

&ethosu1 {
	status = "okay";
};
```

## src/main.cpp
```c
/*
 * Copyright 2019-2022 Arm Limited and/or its affiliates <open-source-office@arm.com>
 *
 * SPDX-License-Identifier: Apache-2.0
 */

/****************************************************************************
 * Includes
 ****************************************************************************/

#include "inference_process.hpp"

#include <inttypes.h>
#include <string>
#include <stdio.h>
#include <vector>
#include <zephyr/kernel.h>

/* Model data - Ethos-U85 on E4/E8 boards only */
#if defined(ETHOSU_ARCH_U85)
#include "ethosu/models/bert_tiny/u85/model_u85_256.h"
#include "ethosu/models/bert_tiny/u85/input.h"
#include "ethosu/models/bert_tiny/u85/output.h"
#else
#error "This application is designed for Ethos-U85 NPU on Ensemble E4/E8 boards only"
#endif

using namespace std;
using namespace InferenceProcess;

/****************************************************************************
 * Defines
 ****************************************************************************/

/* Number of worker threads running the inferences. There should typically be
 * one worker thread per NPU. */
#ifndef NUM_INFERENCE_TASKS
#define NUM_INFERENCE_TASKS 1
#endif

/* Number of sender tasks, that post inference requests to the worker threads. */
#ifndef NUM_JOB_TASKS
#define NUM_JOB_TASKS 2
#endif

/* Number of inferences per sender task. */
#ifndef NUM_JOBS_PER_TASK
#define NUM_JOBS_PER_TASK 2
#endif

/****************************************************************************
 * InferenceJob
 ****************************************************************************/

namespace
{
struct InferenceProcessParams {
	InferenceProcessParams() : tensorArena(nullptr), arenaSize(0)
	{
	}

	InferenceProcessParams(k_queue *_queue, uint8_t *_tensorArena, size_t _arenaSize)
		: queueHandle(_queue), tensorArena(_tensorArena), arenaSize(_arenaSize)
	{
	}

	k_queue *queueHandle;
	uint8_t *tensorArena;
	size_t arenaSize;
};

/* Wrapper around InferenceProcess::InferenceJob. Adds responseQueue and status
 * for Zephyr multi-tasking purposes. */
struct xInferenceJob : public InferenceJob {
	xInferenceJob() : InferenceJob(), responseQueue(nullptr), status(false)
	{
	}

	xInferenceJob(const string &_name, const DataPtr &_networkModel,
		      const vector<DataPtr> &_input, const vector<DataPtr> &_output,
		      const vector<DataPtr> &_expectedOutput, k_queue *_queue)
		: InferenceJob(_name, _networkModel, _input, _output, _expectedOutput),
		  responseQueue(_queue), status(false)
	{
	}

	k_queue *responseQueue;
	bool status;
};

/* Number of total completed jobs, needed to exit application correctly if
 * NUM_JOB_TASKS > 1 */
volatile int totalCompletedJobs = 0;

/* TensorArena static initialisation - use TENSOR_ARENA_SIZE from model header
 * Place in standard BSS section (will use SRAM1 when enabled) */
__attribute__((section(".bss.tflm_arena"), aligned(16)))
uint8_t inferenceProcessTensorArena[NUM_INFERENCE_TASKS][TENSOR_ARENA_SIZE];

/* Allocate and initialize heap */
void *allocateHeap(const size_t size)
{
	k_heap *heap = static_cast<k_heap *>(k_malloc(sizeof(k_heap)));
	uint8_t *buf = static_cast<uint8_t *>(k_malloc(size));

	if ((buf == nullptr) || (heap == nullptr)) {
		printk("Heap allocation failed. heap=%p, buf=%p, size=%zu\n", heap, buf, size);
		exit(1);
	}

	k_heap_init(heap, buf, size);

	return static_cast<void *>(heap);
}

/* inferenceProcessTask - Run jobs from queue with available driver */
void inferenceProcessTask(void *_name, void *heap, void *_params)
{
	string *name = static_cast<string *>(_name);
	InferenceProcessParams *params = static_cast<InferenceProcessParams *>(_params);

	/* Assign the pre allocated heap - used in the k_queue_alloc_append */
	k_thread_heap_assign(k_current_get(), static_cast<k_heap *>(heap));

	class InferenceProcess inferenceProcess(params->tensorArena, params->arenaSize);

	for (;;) {
		/* Receive inference job */
		xInferenceJob *job =
			static_cast<xInferenceJob *>(k_queue_get(params->queueHandle, K_FOREVER));

		printk("%s: Received inference job. job=%p\n", name->c_str(), job);

		/* Run inference */
		job->status = inferenceProcess.runJob(*job);

		printk("%s: Sending inference response. job=%p\n", name->c_str(), job);

		/* Return inference message */
		int ret = k_queue_alloc_append(job->responseQueue, job);
		if (0 != ret) {
			printk("%s: Failed to send message\n", name->c_str());
			exit(1);
		}
	}

	k_thread_abort(k_current_get());

	CODE_UNREACHABLE;
}

/* inferenceSenderTask - Creates NUM_INFERENCE_JOBS jobs, queues them, and then
 * listens for completion status */
void inferenceSenderTask(void *_name, void *heap, void *_queue)
{
	string *name = static_cast<string *>(_name);
	k_queue *inferenceQueue = static_cast<k_queue *>(_queue);
	int ret = 0;

	/* Assign the pre allocated heap - used in the k_queue_alloc_append */
	k_thread_heap_assign(k_current_get(), static_cast<k_heap *>(heap));

	/* Create queue for response messages */
	k_queue senderQueue;
	k_queue_init(&senderQueue);

	/* Loop over all jobs and push them to inference queue */
	xInferenceJob jobs[NUM_JOBS_PER_TASK];
	for (int n = 0; n < NUM_JOBS_PER_TASK; n++) {
		auto &job = jobs[n];
		job = xInferenceJob(modelName,
				    DataPtr((void*)networkModelData, networkModelDataSize),
				    { DataPtr((void*)inputData, inputDataSize) },
				    {},
				    { DataPtr((void*)expectedOutputData, expectedOutputDataSize) },
				    &senderQueue);

		printk("%s: Sending inference. job=%p, name=%s\n", name->c_str(), &job,
		       job.name.c_str());

		/* Queue job */
		ret = k_queue_alloc_append(inferenceQueue, &job);
		if (0 != ret) {
			printk("%s: Failed to send message\n", name->c_str());
			exit(1);
		}
	}

	/* Listen for completion status */
	do {
		xInferenceJob *job =
			static_cast<xInferenceJob *>(k_queue_get(&senderQueue, K_FOREVER));

		printk("%s: Received job response. job=%p, status=%u\n", name->c_str(), job,
		       job->status);

		totalCompletedJobs++;

		ret |= job->status;
		if (job->status != 0) {
			break;
		}
	} while (totalCompletedJobs < NUM_JOBS_PER_TASK * NUM_JOB_TASKS);

	exit(ret);
}

} /* namespace */

/* Zephyr application. NOTE: Additional tasks may require increased heap size. */
int main()
{
	struct {
		k_thread thread;
		k_tid_t id;
	} threads[NUM_JOB_TASKS + NUM_INFERENCE_TASKS];
	size_t nthreads = 0;

	printk("Starting BERT-Tiny Transformer Model Demo on Ethos-U85 NPU\n");
	printk("Model: %s\n", modelName);
	printk("Tensor arena size: %zu bytes\n", tensorArenaSize);
	printk("Number of inference tasks: %d\n", NUM_INFERENCE_TASKS);
	printk("Number of job tasks: %d\n", NUM_JOB_TASKS);

	/* Allocate one global heap for all threads (1KB for k_queue allocations) */
	void *heapPtr = allocateHeap(1024);

	k_queue inferenceQueue;
	k_queue_init(&inferenceQueue);

	/* inferenceSender tasks to create and queue the jobs */
	for (int n = 0; n < NUM_JOB_TASKS; n++) {
		const size_t stackSize = 2048;
		k_thread_stack_t *stack = static_cast<k_thread_stack_t *>(k_malloc(stackSize));
		if (stack == nullptr) {
			printk("Failed to allocate stack to 'inferenceSenderTask%i'\n", n);
			exit(1);
		}

		auto &thread = threads[nthreads];
		string *name = new string("sender " + to_string(n));

		thread.id = k_thread_create(&thread.thread, stack, stackSize, inferenceSenderTask,
					    name, heapPtr, &inferenceQueue, 3, 0, K_FOREVER);
		if (thread.id == 0) {
			printk("Failed to create 'inferenceSenderTask%i'\n", n);
			exit(1);
		}

		nthreads++;
	}

	/* Create inferenceProcess tasks to process the queued jobs */
	InferenceProcessParams taskParams[NUM_INFERENCE_TASKS];
	for (int n = 0; n < NUM_INFERENCE_TASKS; n++) {
		const size_t stackSize = 8192;
		k_thread_stack_t *stack = static_cast<k_thread_stack_t *>(k_malloc(stackSize));
		if (stack == nullptr) {
			printk("Failed to allocate stack to 'inferenceProcessTask%i'\n", n);
			exit(1);
		}

		auto &thread = threads[nthreads];
		auto &taskParam = taskParams[n];
		taskParam = InferenceProcessParams(&inferenceQueue, inferenceProcessTensorArena[n],
						   tensorArenaSize);
		string *name = new string("runner " + to_string(n));

		thread.id = k_thread_create(&thread.thread, stack, stackSize, inferenceProcessTask,
					    name, heapPtr, &taskParam, 2, 0, K_FOREVER);
		if (thread.id == 0) {
			printk("Failed to create 'inferenceProcessTask%i'\n", n);
			exit(1);
		}

		nthreads++;
	}

	/* start Scheduler */
	for (size_t n = 0; n < nthreads; n++) {
		k_thread_start(threads[n].id);
	}

	/* put the task in the lowest priority */
	k_thread_priority_set(k_current_get(), 4);

	/* Safety belt */
	k_thread_suspend(k_current_get());

	printk("Zephyr application failed to initialise \n");

	return 1;
}
```

## src/inference_process_bert.cpp
```c
/*
 * Copyright 2019-2022 Arm Limited and/or its affiliates <open-source-office@arm.com>
 *
 * SPDX-License-Identifier: Apache-2.0
 */

#include "inference_process.hpp"

#include <tensorflow/lite/micro/micro_mutable_op_resolver.h>
#include <tensorflow/lite/micro/cortex_m_generic/debug_log_callback.h>
#include <tensorflow/lite/micro/micro_log.h>
#include <tensorflow/lite/micro/micro_interpreter.h>
#include <tensorflow/lite/micro/micro_profiler.h>
#include <tensorflow/lite/schema/schema_generated.h>

#include <cmsis_compiler.h>
#include <inttypes.h>
#include <zephyr/kernel.h>

using namespace std;

namespace
{
bool copyOutput(const TfLiteTensor &src, InferenceProcess::DataPtr &dst)
{
	if (dst.data == nullptr) {
		return true;
	}

	if (src.bytes > dst.size) {
		printk("Tensor size mismatch (bytes): actual=%d, expected=%d.\n", src.bytes,
		       dst.size);
		return true;
	}

	copy(src.data.uint8, src.data.uint8 + src.bytes, static_cast<uint8_t *>(dst.data));
	dst.size = src.bytes;

	return false;
}

} /* namespace */

namespace InferenceProcess
{
DataPtr::DataPtr(void *_data, size_t _size) : data(_data), size(_size)
{
}

void DataPtr::invalidate()
{
#if defined(__DCACHE_PRESENT) && (__DCACHE_PRESENT == 1U)
	SCB_InvalidateDCache_by_Addr(reinterpret_cast<uint32_t *>(data), size);
#endif
}

void DataPtr::clean()
{
#if defined(__DCACHE_PRESENT) && (__DCACHE_PRESENT == 1U)
	SCB_CleanDCache_by_Addr(reinterpret_cast<uint32_t *>(data), size);
#endif
}

InferenceJob::InferenceJob()
{
}

InferenceJob::InferenceJob(const string &_name, const DataPtr &_networkModel,
			   const vector<DataPtr> &_input, const vector<DataPtr> &_output,
			   const vector<DataPtr> &_expectedOutput)
	: name(_name), networkModel(_networkModel), input(_input), output(_output),
	  expectedOutput(_expectedOutput)
{
}

void InferenceJob::invalidate()
{
	networkModel.invalidate();

	for (auto &it : input) {
		it.invalidate();
	}

	for (auto &it : output) {
		it.invalidate();
	}

	for (auto &it : expectedOutput) {
		it.invalidate();
	}
}

void InferenceJob::clean()
{
	networkModel.clean();

	for (auto &it : input) {
		it.clean();
	}

	for (auto &it : output) {
		it.clean();
	}

	for (auto &it : expectedOutput) {
		it.clean();
	}
}

bool InferenceProcess::runJob(InferenceJob &job)
{
	/* Get model handle and verify that the version is correct */
	const tflite::Model *model = ::tflite::GetModel(job.networkModel.data);
	if (model->version() != TFLITE_SCHEMA_VERSION) {
		printk("Model schema version unsupported: version=%" PRIu32 ", supported=%d.\n",
		       model->version(), TFLITE_SCHEMA_VERSION);
		return true;
	}

	/* Create the TFL micro interpreter with BERT-Tiny required operators */
	tflite::MicroMutableOpResolver <15> resolver;
	resolver.AddEthosU();
	resolver.AddLess();
	resolver.AddGreater();
	resolver.AddEqual();
	resolver.AddNotEqual();
	resolver.AddLogicalAnd();
	resolver.AddLogicalOr();
	resolver.AddLogicalNot();
	/* BERT-tiny required operators */
	resolver.AddAdd();
	resolver.AddFullyConnected();
	resolver.AddGather();
	resolver.AddMean();
	resolver.AddSelectV2();

	tflite::MicroInterpreter interpreter(model, resolver, tensorArena, tensorArenaSize);

	/* Allocate tensors */
	TfLiteStatus allocate_status = interpreter.AllocateTensors();
	if (allocate_status != kTfLiteOk) {
		printk("Failed to allocate tensors for inference. job=%p\n", &job);
		return true;
	}

	if (job.input.size() != interpreter.inputs_size()) {
		printk("Number of job and network inputs do not match. input=%zu, network=%zu\n",
		       job.input.size(), interpreter.inputs_size());
		return true;
	}

	/* Copy input data */
	for (size_t i = 0; i < interpreter.inputs_size(); ++i) {
		const DataPtr &input = job.input[i];
		const TfLiteTensor *tensor = interpreter.input(i);

		if (input.size != tensor->bytes) {
			printk("Input tensor size mismatch. index=%zu, input=%zu, network=%u\n", i,
			       input.size, tensor->bytes);
			return true;
		}

		copy(static_cast<char *>(input.data), static_cast<char *>(input.data) + input.size,
		     tensor->data.uint8);
	}

	/* Run the inference */
	TfLiteStatus invoke_status = interpreter.Invoke();
	if (invoke_status != kTfLiteOk) {
		printk("Invoke failed for inference. job=%s\n", job.name.c_str());
		return true;
	}

	/* Copy output data */
	if (job.output.size() > 0) {
		if (interpreter.outputs_size() != job.output.size()) {
			printk("Number of job and network outputs do not match. job=%zu, network=%u\n",
			       job.output.size(), interpreter.outputs_size());
			return true;
		}

		for (unsigned i = 0; i < interpreter.outputs_size(); ++i) {
			if (copyOutput(*interpreter.output(i), job.output[i])) {
				return true;
			}
		}
	}

	if (job.expectedOutput.size() > 0) {
		if (job.expectedOutput.size() != interpreter.outputs_size()) {
			printk("Number of job and network expected outputs do not match. job=%zu, network=%zu\n",
			       job.expectedOutput.size(), interpreter.outputs_size());
			return true;
		}

		for (unsigned int i = 0; i < interpreter.outputs_size(); i++) {
			const DataPtr &expected = job.expectedOutput[i];
			const TfLiteTensor *output = interpreter.output(i);

			if (expected.size != output->bytes) {
				printk("Expected output tensor size mismatch. index=%u, expected=%zu, network=%zu\n",
				       i, expected.size, output->bytes);
				return true;
			}

			for (unsigned int j = 0; j < output->bytes; ++j) {
				uint8_t expected_val = static_cast<uint8_t *>(expected.data)[j];
				uint8_t actual_val = output->data.uint8[j];

				/* Tolerance-based validation: allow ±3 difference for quantized models */
				int diff = abs((int)actual_val - (int)expected_val);
				if (diff > 3) {
					printk("Expected output tensor data mismatch (tolerance=±3). index=%u, offset=%u, expected=%02x, network=%02x, diff=%d\n",
					       i, j, expected_val, actual_val, diff);
					return true;
				}
			}
		}
	}

	return false;
}

} /* namespace InferenceProcess */
```
