/* Copyright (C) Alif Semiconductor - All Rights Reserved.
 * Use, distribution and modification of this code is permitted under the
 * terms stated in the Alif Semiconductor Software License Agreement
 *
 * You should have received a copy of the Alif Semiconductor Software
 * License Agreement with this file. If not, please write to:
 * contact@alifsemi.com, or visit: https://alifsemi.com/license
 *
 */

#include <zephyr/dt-bindings/gpio/gpio.h>

#include "common.overlay"

&gpio6 {
	status = "okay";

	gt911_touch_reset_hold {
		gpio-hog;
		gpios = <5 GPIO_ACTIVE_LOW>;
		output-high;
	};
};
