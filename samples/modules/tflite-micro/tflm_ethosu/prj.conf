## CMakeLists.txt
```
# Copyright 2021-2022 Arm Limited and/or its affiliates <open-source-office@arm.com>
#
# SPDX-License-Identifier: Apache-2.0

cmake_minimum_required(VERSION 3.20.0)

find_package(Zephyr REQUIRED HINTS $ENV{ZEPHYR_BASE})

# Detect NPU architecture from ETHOSU_TARGET_NPU_CONFIG
# This is the SINGLE SOURCE OF TRUTH for NPU configuration
if(ETHOSU_TARGET_NPU_CONFIG MATCHES "^ethos-(u[0-9]+)-([0-9]+)$")
    set(ETHOSU_ARCH "${CMAKE_MATCH_1}")
    set(ETHOSU_MACS "${CMAKE_MATCH_2}")

    message(STATUS "ETHOSU_TARGET_NPU_CONFIG: ${ETHOSU_TARGET_NPU_CONFIG}")
    message(STATUS "Detected NPU Architecture: ${ETHOSU_ARCH}, MACs: ${ETHOSU_MACS}")

    # Validate and configure for U55/U65
    if((ETHOSU_ARCH STREQUAL "u55") OR (ETHOSU_ARCH STREQUAL "u65"))
        # Validate MAC configuration based on core type (HE vs HP)
        if(CONFIG_RTSS_HE)
            # HE core only supports 128 MACs for U55
            if(NOT (ETHOSU_MACS STREQUAL "128"))
                message(FATAL_ERROR 
                    "Core type mismatch: RTSS_HE core with U55 only supports 128 MACs.\n"
                    "You specified: ${ETHOSU_MACS} MACs\n"
                    "For HE core, use: -DETHOSU_TARGET_NPU_CONFIG=ethos-u55-128\n"
                    "For 256 MACs, use HP core board variant (rtss_hp)")
            endif()
            message(STATUS "Detected RTSS_HE core - U55 restricted to 128 MACs")
        elseif(CONFIG_RTSS_HP)
            # HP core only supports 256 MACs for U55
            if(NOT (ETHOSU_MACS STREQUAL "256"))
                message(FATAL_ERROR 
                    "Core type mismatch: RTSS_HP core with U55 only supports 256 MACs.\n"
                    "You specified: ${ETHOSU_MACS} MACs\n"
                    "For HP core, use: -DETHOSU_TARGET_NPU_CONFIG=ethos-u55-256\n"
                    "For 128 MACs, use HE core board variant (rtss_he)")
            endif()
            message(STATUS "Detected RTSS_HP core - U55 restricted to 256 MACs")
        elseif(CONFIG_APSS)
            message(FATAL_ERROR
                "Ethos-U55 is not directly accessible from APSS (Cortex-A32).\n"
                "Use Ethos-U85 instead: -DETHOSU_TARGET_NPU_CONFIG=ethos-u85-256")
        else()
            # Fallback validation for other core types
            if(NOT (ETHOSU_MACS STREQUAL "64" OR ETHOSU_MACS STREQUAL "128" OR ETHOSU_MACS STREQUAL "256"))
                message(FATAL_ERROR "Unsupported U55/U65 MAC configuration: ${ETHOSU_MACS}. Valid: 64, 128, 256")
            endif()
        endif()

        # Validate overlay file matches NPU type
        if(DEFINED EXTRA_DTC_OVERLAY_FILE)
            if(EXTRA_DTC_OVERLAY_FILE MATCHES "ethosu85\\.overlay")
                message(FATAL_ERROR 
                    "Overlay mismatch: ETHOSU_TARGET_NPU_CONFIG='${ETHOSU_TARGET_NPU_CONFIG}' (U55) "
                    "but using U85 overlay '${EXTRA_DTC_OVERLAY_FILE}'.\n"
                    "For U55, use: -DEXTRA_DTC_OVERLAY_FILE=\"boards/enable_ethosu55.overlay\"")
            endif()
        endif()

        # Set architecture flag
        set(ETHOSU_ARCH_U55 y CACHE BOOL "U55 Flag")
        add_compile_definitions(ETHOSU_ARCH_U55="${ETHOSU_ARCH_U55}")

        # Automatically set the appropriate CONFIG_ARM_ETHOS_U55_* based on MACS
        if(ETHOSU_MACS STREQUAL "256")
            set(CONFIG_ARM_ETHOS_U55_256 y CACHE BOOL "U55 256 MACs" FORCE)
            message(STATUS "Auto-configured: CONFIG_ARM_ETHOS_U55_256=y")
        elseif(ETHOSU_MACS STREQUAL "128")
            set(CONFIG_ARM_ETHOS_U55_128 y CACHE BOOL "U55 128 MACs" FORCE)
            message(STATUS "Auto-configured: CONFIG_ARM_ETHOS_U55_128=y")
        elseif(ETHOSU_MACS STREQUAL "64")
            set(CONFIG_ARM_ETHOS_U55_64 y CACHE BOOL "U55 64 MACs" FORCE)
            message(STATUS "Auto-configured: CONFIG_ARM_ETHOS_U55_64=y")
        endif()

        message(STATUS "Building for Ethos-U55 with ${ETHOSU_MACS} MACs")

    # Validate and configure for U85
    elseif(ETHOSU_ARCH STREQUAL "u85")
        # Validate board supports U85 FIRST (before MAC check)
        # Note: E4, E8 boards have dual NPUs (U55 + U85)
        if(NOT (CONFIG_SOC_SERIES_E8 OR CONFIG_SOC_SERIES_E4))
            message(FATAL_ERROR 
                "Ethos-U85 is only available on E4, E8 boards.\n"
                "Current board does not support U85.\n"
                "For this board, use: -DETHOSU_TARGET_NPU_CONFIG=ethos-u55-256")
        endif()

        # Validate MAC configuration - U85 only supports 256 MACs on Alif boards
        if(NOT (ETHOSU_MACS STREQUAL "256"))
            message(FATAL_ERROR 
                "Unsupported U85 MAC configuration: ${ETHOSU_MACS}\n"
                "Alif Ensemble boards only support Ethos-U85 with 256 MACs.\n"
                "Use: -DETHOSU_TARGET_NPU_CONFIG=ethos-u85-256")
        endif()

        # Validate overlay file matches NPU type (catches accidental U55 overlay with U85 config)
        if(DEFINED EXTRA_DTC_OVERLAY_FILE)
            if(EXTRA_DTC_OVERLAY_FILE MATCHES "ethosu55\\.overlay")
                message(FATAL_ERROR 
                    "Overlay mismatch: ETHOSU_TARGET_NPU_CONFIG='${ETHOSU_TARGET_NPU_CONFIG}' (U85) "
                    "but using U55 overlay '${EXTRA_DTC_OVERLAY_FILE}'.\n"
                    "For U85 on RTSS, use: -S ethos-u85-enable\n"
                    "For U85 on APSS,  use: -S ethos-u85-apss-enable")
            endif()
        endif()

        # Set architecture flag
        set(ETHOSU_ARCH_U85 y CACHE BOOL "U85 Flag")
        add_compile_definitions(ETHOSU_ARCH_U85="${ETHOSU_ARCH_U85}")

        # Automatically set CONFIG_ARM_ETHOS_U85_256 (only 256 MACs supported)
        set(CONFIG_ARM_ETHOS_U85_256 y CACHE BOOL "U85 256 MACs" FORCE)
        message(STATUS "Auto-configured: CONFIG_ARM_ETHOS_U85_256=y")

        message(STATUS "Building for Ethos-U85 with ${ETHOSU_MACS} MACs")

    else()
        message(FATAL_ERROR "Unsupported NPU architecture: ${ETHOSU_ARCH}. Valid: u55, u65, u85")
    endif()

else()
    message(FATAL_ERROR 
        "Invalid or missing ETHOSU_TARGET_NPU_CONFIG: '${ETHOSU_TARGET_NPU_CONFIG}'\n"
        "Required format: ethos-u<arch>-<macs>\n"
        "Examples:\n"
        "  -DETHOSU_TARGET_NPU_CONFIG=ethos-u55-128\n"
        "  -DETHOSU_TARGET_NPU_CONFIG=ethos-u55-256\n"
        "  -DETHOSU_TARGET_NPU_CONFIG=ethos-u85-256")
endif()

if(CONFIG_TFLM_ETHOSU_IMAGE_IN_OSPI)
    message(STATUS "Image executes from OSPI XIP at ${CONFIG_FLASH_BASE_ADDRESS}")
endif()

project(tflm_ethosu_app)

target_include_directories(app PRIVATE ../../../../include)

add_subdirectory(
    ../../../../lib/ethosu_utils
    ${CMAKE_BINARY_DIR}/lib/ethosu_utils
)

target_sources(app PRIVATE src/main.cpp)

# APSS (Cortex-A32): include the SRAM1 linker snippet so the tensor arena
# is placed into the non-cacheable SRAM1 memory region defined in the overlay.
if(CONFIG_APSS)
    zephyr_linker_sources(SECTIONS boards/apss_sram1_sections.ld)
endif()
```

## Kconfig
```
# Copyright 2022 Arm Limited and/or its affiliates <open-source-office@arm.com>
# SPDX-License-Identifier: Apache-2.0

config TFLM_ETHOSU_TAINT_BLOBS
	bool
	default y
	select TAINT_BLOBS

config TENSORFLOW_LITE_MICRO
	bool
	default y

config ETHOS_U_AXI0_ONLY
	bool "Only use AXI0 port on the Ethos"
	default false

config ETHOSU_ARCH_U55
	bool "Ethos NPU U55"
	default n
	help
		Enable support for Ethos-U55 NPU architecture.
		This is set automatically by CMakeLists.txt based on ETHOSU_TARGET_NPU_CONFIG.

config ETHOSU_ARCH_U85
	bool "Ethos NPU U85"
	default n
	help
		Enable support for Ethos-U85 NPU architecture.
		This is set automatically by CMakeLists.txt based on ETHOSU_TARGET_NPU_CONFIG.

config TFLM_ETHOSU_IMAGE_IN_OSPI
	bool
	default y if FLASH_BASE_ADDRESS >= 0xa0000000 && FLASH_BASE_ADDRESS < 0xe0000000
	help
		Set when the application image is linked to execute in place from
		an OSPI XIP window (OSPI0 at 0xA0000000 or OSPI1 at 0xC0000000),
		i.e. the Secure Enclave boots the image directly from OSPI flash.

config MODEL_IN_EXT_FLASH
	bool "Put ML model to external flash"
	select FLASH
	select ALIF_OSPI_FLASH_XIP
	help
		Initialize OSPI controller to XIP mode. Initialize the onboard flash device. Link ML model data to external flash address space.
		In addition to normal zephyr.bin output, ospi1.bin is generated.

config TFLM_ETHOSU_MODEL_COPY_TO_RAM
	bool "Copy the ML model to RAM before running inference"
	default y if TFLM_ETHOSU_IMAGE_IN_OSPI
	help
		Copy the Vela-compiled model (command stream and weights) from its
		link location to a RAM buffer at startup and hand the RAM copy to
		the NPU. Enabled by default when the image executes from OSPI XIP:
		Ethos-U fetches from the OSPI XIP window set up by the boot
		firmware end in an NPU command stream parse error, so the NPU
		must only see the RAM copy.

config TFLM_ETHOSU_MODEL_RAM_SECTION
	string "Linker section of the RAM model copy"
	depends on TFLM_ETHOSU_MODEL_COPY_TO_RAM
	default ".bss.tflm_model_ram"
	help
		Linker input section for the RAM copy of the model. The default
		places it in the core's DTCM together with the tensor arena.

source "Kconfig.zephyr"
```

## prj.conf
```kconfig
#application default configuration
# include TFLM based on CMSIS NN optimization and ETHOSU acceleration
CONFIG_CPP=y
CONFIG_STD_CPP17=y
CONFIG_TENSORFLOW_LITE_MICRO=y
CONFIG_ARM_ETHOS_U=y
CONFIG_HEAP_MEM_POOL_SIZE=16384
CONFIG_MAIN_STACK_SIZE=4096
CONFIG_LOG=y
CONFIG_LOG_MODE_IMMEDIATE=y
CONFIG_ARM_ETHOS_U_LOG_LEVEL_DBG=y

# Build output configuration (replaces deprecated BUILD_NO_GAP_FILL)
CONFIG_BUILD_OUTPUT_HEX_GAP_FILL=n
CONFIG_BUILD_OUTPUT_S19_GAP_FILL=n

CONFIG_REQUIRES_FULL_LIBC=y
CONFIG_NEWLIB_LIBC=y
CONFIG_REQUIRES_FULL_LIBCPP=y
CONFIG_NEWLIB_LIBC_MIN_REQUIRED_HEAP_SIZE=8192
```

## boards/alif_e3_dk_rtss_he.conf
```kconfig
CONFIG_ETHOS_U_AXI0_ONLY=y
```

## boards/alif_e8_dk_ae822fa0e5597xx0_apss.conf
```kconfig
# Copyright (C) 2026 Alif Semiconductor - All Rights Reserved.
# SPDX-License-Identifier: Apache-2.0
#
# APSS (Cortex-A32) board-specific Kconfig for tflm_ethosu sample.
# Auto-selected when building for alif_e8_dk/ae822fa0e5597xx0/apss.

# NPU configuration — Ethos-U85 with 256 MACs
CONFIG_ARM_ETHOS_U85_256=y

# Multithreading required by Ethos-U driver
CONFIG_MULTITHREADING=y

# Heap for k_malloc / k_queue_alloc_append
CONFIG_HEAP_MEM_POOL_SIZE=65536
```

## boards/alif_b1_dk_rtss_he.overlay
```dts
/* Copyright (C) 2025 Alif Semiconductor - All Rights Reserved.
 * Use, distribution and modification of this code is permitted under the
 * terms stated in the Alif Semiconductor Software License Agreement
 *
 * You should have received a copy of the Alif Semiconductor Software
 * License Agreement with this file. If not, please write to:
 * contact@alifsemi.com, or visit: https: //alifsemi.com/license
 *
 */

&ospi0 {
	bus-speed = <40000000>;
	status = "okay";
};
```

## boards/enable_ethosu55.overlay
```dts
/* Copyright (C) 2025 Alif Semiconductor - All Rights Reserved.
 * Use, distribution and modification of this code is permitted under the
 * terms stated in the Alif Semiconductor Software License Agreement
 *
 * You should have received a copy of the Alif Semiconductor Software
 * License Agreement with this file. If not, please write to:
 * contact@alifsemi.com, or visit: https://alifsemi.com/license
 *
 */

/*
 * Ethos-U55 NPU Enable Overlay
 * 
 * This overlay enables the Ethos-U55 NPU (ethosu0) for all boards.
 * 
 * Applicable to ALL Boards:
 *   - B1 (alif_b1_dk)      - U55 only
 *   - E1C (alif_e1c_dk)    - U55 only
 *   - E7 (alif_e7_dk)      - U55 only
 *   - E8 (alif_e8_dk)      - U55 + U85
 *
 * Note: All boards have ethosu0 (U55). E8 additionally has ethosu1 (U85).
 * 
 * Usage:
 *   west build -b <board> <app_path> -- \
 *     -DEXTRA_DTC_OVERLAY_FILE="boards/enable_ethosu55.overlay"
 * 
 * Build-time Safety Check:
 *   If this overlay is applied to a board without U55 support,
 *   the build will fail with an error message indicating that ethosu0 node
 *   does not exist on this board.
 */

/ {
	/* Compile-time assertion: ethosu0 must exist */
	ethosu_u55_check {
		compatible = "vnd,ethosu-u55-check";
		ethosu-node = <&ethosu0>;
	};
};

&ethosu0 {
	status = "okay";
};
```

## boards/enable_ethosu85.overlay
```dts
/* Copyright (C) 2025 Alif Semiconductor - All Rights Reserved.
 * Use, distribution and modification of this code is permitted under the
 * terms stated in the Alif Semiconductor Software License Agreement
 *
 * You should have received a copy of the Alif Semiconductor Software
 * License Agreement with this file. If not, please write to:
 * contact@alifsemi.com, or visit: https://alifsemi.com/license
 *
 */

/*
 * Ethos-U85 NPU Enable Overlay
 * 
 * This overlay enables the Ethos-U85 NPU (ethosu1) for boards that support it.
 * 
 * Applicable Boards (have both U55 and U85):
 *   - E8 (alif_e8_dk) - has U55 + U85
 *
 * NOT applicable to:
 *   - B1, E1C, E7 (have U55 only, no U85)
 * 
 * Note: E8 board has BOTH ethosu0 (U55) and ethosu1 (U85).
 *       Use this overlay to enable the U85 NPU on these boards.
 * 
 * Usage:
 *   west build -b alif_e8_dk/<variant>/<core> <app_path> -- \
 *     -DEXTRA_DTC_OVERLAY_FILE="boards/enable_ethosu85.overlay"
 * 
 * Build-time Safety Check:
 *   If this overlay is applied to a board without U85 support (B1, E1C, E3, E7),
 *   the build will fail with an error message indicating that ethosu1 node
 *   does not exist on this board.
 */

/ {
	/* Compile-time assertion: ethosu1 must exist */
	ethosu_u85_check {
		compatible = "vnd,ethosu-u85-check";
		ethosu-node = <&ethosu1>;
	};
};

&ethosu1 {
	status = "okay";
};
```

## src/main.cpp
```c
/*
 * Copyright 2019-2022 Arm Limited and/or its affiliates <open-source-office@arm.com>
 *
 * SPDX-License-Identifier: Apache-2.0
 */

/****************************************************************************
 * Includes
 ****************************************************************************/

#include "inference_process.hpp"

#include <inttypes.h>
#include <string>
#include <string.h>
#include <stdio.h>
#include <vector>
#include <zephyr/kernel.h>

/* Model data - Conditional compilation for U55/U85 */
#if defined(ETHOSU_ARCH_U85)
#include "ethosu/models/keyword_spotting_cnn_small_int8/u85/input.h"
#include "ethosu/models/keyword_spotting_cnn_small_int8/u85/output.h"
#include "ethosu/models/keyword_spotting_cnn_small_int8/u85/model_u85_256.h"
#endif

#if defined(ETHOSU_ARCH_U55)
#include "ethosu/models/keyword_spotting_cnn_small_int8/u55/input.h"
#include "ethosu/models/keyword_spotting_cnn_small_int8/u55/output.h"
#if defined(CONFIG_ARM_ETHOS_U55_256)
#include "ethosu/models/keyword_spotting_cnn_small_int8/u55/model_u55_256.h"
#else
#include "ethosu/models/keyword_spotting_cnn_small_int8/u55/model_u55_128.h"
#endif
#endif

using namespace std;
using namespace InferenceProcess;

/****************************************************************************
 * Defines
 ****************************************************************************/

/* Number of worker threads running the inferences. There should typically be
 * one worker thread per NPU. */
#ifndef NUM_INFERENCE_TASKS
#define NUM_INFERENCE_TASKS 1
#endif

/* Number of sender tasks, that post inference requests to the worker threads. */
#ifndef NUM_JOB_TASKS
#define NUM_JOB_TASKS 2
#endif

/* Number of inferences per sender task. */
#ifndef NUM_JOBS_PER_TASK
#define NUM_JOBS_PER_TASK 2
#endif

/* Tensor arena size - use the model's tensorArenaSize variable */
/* Note: tensorArenaSize is defined in the model header file */

/****************************************************************************
 * InferenceJob
 ****************************************************************************/

namespace
{
struct InferenceProcessParams {
	InferenceProcessParams() : tensorArena(nullptr), arenaSize(0)
	{
	}

	InferenceProcessParams(k_queue *_queue, uint8_t *_tensorArena, size_t _arenaSize)
		: queueHandle(_queue), tensorArena(_tensorArena), arenaSize(_arenaSize)
	{
	}

	k_queue *queueHandle;
	uint8_t *tensorArena;
	size_t arenaSize;
};

/* Wrapper around InferenceProcess::InferenceJob. Adds responseQueue and status
 * for Zephyr multi-tasking purposes.& */
struct xInferenceJob : public InferenceJob {
	xInferenceJob() : InferenceJob(), responseQueue(nullptr), status(false)
	{
	}

	xInferenceJob(const string &_name, const DataPtr &_networkModel,
		      const vector<DataPtr> &_input, const vector<DataPtr> &_output,
		      const vector<DataPtr> &_expectedOutput, k_queue *_queue)
		: InferenceJob(_name, _networkModel, _input, _output, _expectedOutput),
		  responseQueue(_queue), status(false)
	{
	}

	k_queue *responseQueue;
	bool status;
};

/* Number of total completed jobs, needed to exit application correctly if
 * NUM_JOB_TASKS > 1 */
volatile int totalCompletedJobs = 0;

/* TensorArena allocation using TENSOR_ARENA_SIZE from model header
 * Note: TENSOR_ARENA_SIZE macro is defined in model headers (e.g., model_u85_256.h)
 * For keyword_spotting: U55 uses ~50KB, U85 uses ~50KB
 *
 * On APSS (Cortex-A32) the arena is placed into SRAM1 which is mapped
 * non-cacheable by the MMU, ensuring coherency with the Ethos-U85 NPU.
 * On RTSS (Cortex-M55) the arena goes into .bss.tflm_arena (DTCM/SRAM0).
 */
#if defined(CONFIG_APSS)
__attribute__((section("SRAM1.tflm_arena"), aligned(16)))
#else
__attribute__((section(".bss.tflm_arena"), aligned(16)))
#endif
uint8_t inferenceProcessTensorArena[NUM_INFERENCE_TASKS][TENSOR_ARENA_SIZE];

#if defined(CONFIG_TFLM_ETHOSU_MODEL_COPY_TO_RAM)
__attribute__((section(CONFIG_TFLM_ETHOSU_MODEL_RAM_SECTION), aligned(16)))
uint8_t networkModelRam[sizeof(networkModelData)];
#endif

/* Model buffer handed to the NPU */
const void *networkModel()
{
#if defined(CONFIG_TFLM_ETHOSU_MODEL_COPY_TO_RAM)
	return networkModelRam;
#else
	return networkModelData;
#endif
}

/* Allocate and initialize heap */
void *allocateHeap(const size_t size)
{
	k_heap *heap = static_cast<k_heap *>(k_malloc(sizeof(k_heap)));
	uint8_t *buf = static_cast<uint8_t *>(k_malloc(size));

	if ((buf == nullptr) || (heap == nullptr)) {
		printk("Heap allocation failed. heap=%p, buf=%p, size=%zu\n", heap, buf, size);
		exit(1);
	}

	k_heap_init(heap, buf, size);

	return static_cast<void *>(heap);
}

/* inferenceProcessTask - Run jobs from queue with available driver */
void inferenceProcessTask(void *_name, void *heap, void *_params)
{
	string *name = static_cast<string *>(_name);
	InferenceProcessParams *params = static_cast<InferenceProcessParams *>(_params);

	/* Assign the pre allocated heap - used in the k_queue_alloc_append */
	k_thread_heap_assign(k_current_get(), static_cast<k_heap *>(heap));

	class InferenceProcess inferenceProcess(params->tensorArena, params->arenaSize);

	for (;;) {
		/* Receive inference job */
		xInferenceJob *job =
			static_cast<xInferenceJob *>(k_queue_get(params->queueHandle, Z_FOREVER));

		printk("%s: Received inference job. job=%p\n", name->c_str(), job);

		/* Run inference */
		job->status = inferenceProcess.runJob(*job);

		printk("%s: Sending inference response. job=%p\n", name->c_str(), job);

		/* Return inference message */
		int ret = k_queue_alloc_append(job->responseQueue, job);
		if (0 != ret) {
			printk("%s: Failed to send message\n", name->c_str());
			exit(1);
		}
	}

	k_thread_abort(k_current_get());

	CODE_UNREACHABLE;
}

/* inferenceSenderTask - Creates NUM_INFERENCE_JOBS jobs, queues them, and then
 * listens for completion status */
void inferenceSenderTask(void *_name, void *heap, void *_queue)
{
	string *name = static_cast<string *>(_name);
	k_queue *inferenceQueue = static_cast<k_queue *>(_queue);
	int ret = 0;

	/* Assign the pre allocated heap - used in the k_queue_alloc_append */
	k_thread_heap_assign(k_current_get(), static_cast<k_heap *>(heap));

	/* Create queue for response messages */
	k_queue senderQueue;
	k_queue_init(&senderQueue);

	/* Loop over all jobs and push them to inference queue */
	xInferenceJob jobs[NUM_JOBS_PER_TASK];
	for (int n = 0; n < NUM_JOBS_PER_TASK; n++) {
		auto &job = jobs[n];
		job = xInferenceJob(modelName, DataPtr((void*)networkModel(), sizeof(networkModelData)),
				    { DataPtr((void*)inputData, sizeof(inputData)) }, {},
				    { DataPtr((void*)expectedOutputData, sizeof(expectedOutputData)) },
				    &senderQueue);

		printk("%s: Sending inference. job=%p, name=%s\n", name->c_str(), &job,
		       job.name.c_str());

		/* Queue job */
		ret = k_queue_alloc_append(inferenceQueue, &job);
		if (0 != ret) {
			printk("%s: Failed to send message\n", name->c_str());
			exit(1);
		}
	}

	/* Listen for completion status */
	do {
		xInferenceJob *job =
			static_cast<xInferenceJob *>(k_queue_get(&senderQueue, Z_FOREVER));

		printk("%s: Received job response. job=%p, status=%u\n", name->c_str(), job,
		       job->status);

		totalCompletedJobs++;

		ret += job->status;
		if (job->status != 0) {
			break;
		}
	} while (totalCompletedJobs < NUM_JOBS_PER_TASK * NUM_JOB_TASKS);

	exit(ret);
}

} /* namespace */

/* Zephyr application. NOTE: Additional tasks may require increased heap size. */
int main()
{
	struct {
		k_thread thread;
		k_tid_t id;
	} threads[NUM_JOB_TASKS + NUM_INFERENCE_TASKS];
	size_t nthreads = 0;

#if defined(CONFIG_TFLM_ETHOSU_MODEL_COPY_TO_RAM)
	memcpy(networkModelRam, networkModelData, sizeof(networkModelData));
	printk("Model copied to RAM: %p -> %p (%zu bytes)\n", (const void *)networkModelData,
	       (void *)networkModelRam, sizeof(networkModelData));
#else
	printk("Model location: %p (%zu bytes)\n", (const void *)networkModelData,
	       sizeof(networkModelData));
#endif

	/* Allocate one global heap for all threads */
	void *heapPtr = allocateHeap(256);

	k_queue inferenceQueue;
	k_queue_init(&inferenceQueue);

	/* inferenceSender tasks to create and queue the jobs */
	for (int n = 0; n < NUM_JOB_TASKS; n++) {
		const size_t stackSize = 2048;
		k_thread_stack_t *stack = static_cast<k_thread_stack_t *>(k_malloc(stackSize));
		if (stack == nullptr) {
			printk("Failed to allocate stack to 'inferenceSenderTask%i'\n", n);
			exit(1);
		}

		auto &thread = threads[nthreads];
		string *name = new string("sender " + to_string(n));

		thread.id = k_thread_create(&thread.thread, stack, stackSize, inferenceSenderTask,
					    name, heapPtr, &inferenceQueue, 3, 0, K_FOREVER);
		if (thread.id == 0) {
			printk("Failed to create 'inferenceSenderTask%i'\n", n);
			exit(1);
		}

		nthreads++;
	}

	/* Create inferenceProcess tasks to process the queued jobs */
	InferenceProcessParams taskParams[NUM_INFERENCE_TASKS];
	for (int n = 0; n < NUM_INFERENCE_TASKS; n++) {
		const size_t stackSize = 8192;
		k_thread_stack_t *stack = static_cast<k_thread_stack_t *>(k_malloc(stackSize));
		if (stack == nullptr) {
			printk("Failed to allocate stack to 'inferenceSenderTask%i'\n", n);
			exit(1);
		}

		auto &thread = threads[nthreads];
		auto &taskParam = taskParams[n];
		taskParam = InferenceProcessParams(&inferenceQueue, inferenceProcessTensorArena[n],
						   tensorArenaSize);
		string *name = new string("runner " + to_string(n));

		thread.id = k_thread_create(&thread.thread, stack, stackSize, inferenceProcessTask,
					    name, heapPtr, &taskParam, 2, 0, K_FOREVER);
		if (thread.id == 0) {
			printk("Failed to create 'inferenceProcessTask%i'\n", n);
			exit(1);
		}

		nthreads++;
	}

	/* start Scheduler */
	for (size_t n = 0; n < nthreads; n++) {
		k_thread_start(threads[n].id);
	}

	/* put the task in the lowest priority */
	k_thread_priority_set(k_current_get(), 4);

	/* Safety belt */
	k_thread_suspend(k_current_get());

	printk("Zephyr application failed to initialise \n");

	return 1;
}
```
