## CMakeLists.txt
```
# Copyright 2026 Alif Semiconductor
# Copyright (c) Meta Platforms, Inc. and affiliates.
# Copyright 2025 Arm Limited and/or its affiliates.
#
# SPDX-License-Identifier: Apache-2.0

cmake_minimum_required(VERSION 3.20)

set(CMAKE_SKIP_INSTALL_RULES ON CACHE BOOL "" FORCE)

set(ET_PTE_FILE_PATH
    ""
    CACHE FILEPATH "Path to the ExecuTorch .pte model for KWS"
)
set(ET_PTE_SECTION
    ".rodata.model"
    CACHE STRING "Section attribute used for the generated model data"
)

if(NOT ET_PTE_FILE_PATH)
  message(
    FATAL_ERROR
      "ET_PTE_FILE_PATH must point to the ExecuTorch .pte model.\n"
      "Example: -DET_PTE_FILE_PATH=./kws_model.pte"
  )
endif()

if(NOT IS_ABSOLUTE "${ET_PTE_FILE_PATH}")
  get_filename_component(
    ET_PTE_FILE_PATH "${ET_PTE_FILE_PATH}" ABSOLUTE BASE_DIR
    "${CMAKE_CURRENT_SOURCE_DIR}"
  )
endif()

if(NOT EXISTS "${ET_PTE_FILE_PATH}")
  message(
    FATAL_ERROR
      "Could not find ExecuTorch model at ET_PTE_FILE_PATH: ${ET_PTE_FILE_PATH}"
  )
endif()

set(ET_PTE_FILE_PATH
    "${ET_PTE_FILE_PATH}"
    CACHE FILEPATH "Path to the ExecuTorch .pte model"
    FORCE
)

# Detect NPU architecture from ETHOSU_TARGET_NPU_CONFIG
if(ETHOSU_TARGET_NPU_CONFIG MATCHES "^ethos-(u[0-9]+)-([0-9]+)$")
    set(ETHOSU_ARCH "${CMAKE_MATCH_1}")
    set(ETHOSU_MACS "${CMAKE_MATCH_2}")

    message(STATUS "ETHOSU_TARGET_NPU_CONFIG: ${ETHOSU_TARGET_NPU_CONFIG}")
    message(STATUS "Detected NPU Architecture: ${ETHOSU_ARCH}, MACs: ${ETHOSU_MACS}")

    if((ETHOSU_ARCH STREQUAL "u55") OR (ETHOSU_ARCH STREQUAL "u65"))
        set(ETHOSU_ARCH_U55 y CACHE BOOL "U55 Flag")
        add_compile_definitions(ETHOSU_ARCH_U55="${ETHOSU_ARCH_U55}")

        if(ETHOSU_MACS STREQUAL "256")
            set(CONFIG_ARM_ETHOS_U55_256 y CACHE BOOL "U55 256 MACs" FORCE)
            message(STATUS "Auto-configured: CONFIG_ARM_ETHOS_U55_256=y")
        elseif(ETHOSU_MACS STREQUAL "128")
            set(CONFIG_ARM_ETHOS_U55_128 y CACHE BOOL "U55 128 MACs" FORCE)
            message(STATUS "Auto-configured: CONFIG_ARM_ETHOS_U55_128=y")
        endif()

        message(STATUS "Building for Ethos-U55 with ${ETHOSU_MACS} MACs")

    elseif(ETHOSU_ARCH STREQUAL "u85")
        set(ETHOSU_ARCH_U85 y CACHE BOOL "U85 Flag")
        add_compile_definitions(ETHOSU_ARCH_U85="${ETHOSU_ARCH_U85}")

        set(CONFIG_ARM_ETHOS_U85_256 y CACHE BOOL "U85 256 MACs" FORCE)
        message(STATUS "Auto-configured: CONFIG_ARM_ETHOS_U85_256=y")
        message(STATUS "Building for Ethos-U85 with ${ETHOSU_MACS} MACs")
    else()
        message(FATAL_ERROR "Unsupported NPU architecture: ${ETHOSU_ARCH}. Valid: u55, u65, u85")
    endif()
else()
    message(FATAL_ERROR
        "Invalid or missing ETHOSU_TARGET_NPU_CONFIG: '${ETHOSU_TARGET_NPU_CONFIG}'\n"
        "Required format: ethos-u<arch>-<macs>\n"
        "Examples:\n"
        "  -DETHOSU_TARGET_NPU_CONFIG=ethos-u55-128\n"
        "  -DETHOSU_TARGET_NPU_CONFIG=ethos-u55-256\n"
        "  -DETHOSU_TARGET_NPU_CONFIG=ethos-u85-256")
endif()

set(CONF_FILE "${CMAKE_CURRENT_SOURCE_DIR}/prj.conf")

find_package(Zephyr REQUIRED HINTS $ENV{ZEPHYR_BASE})
project(executorch_kws_ethosu)

if(CONFIG_KWS_ETHOSU_IMAGE_IN_OSPI)
  message(STATUS "Image executes from OSPI XIP at ${CONFIG_FLASH_BASE_ADDRESS}")
endif()

# Core-type checks that need Kconfig, so they have to run after find_package().
# The CONFIG_ARM_ETHOS_U* forcing above must stay before it, since Zephyr turns
# CONFIG_-prefixed CMake cache variables into Kconfig assignments while
# configuring.
if(CONFIG_APSS)
  if(ETHOSU_ARCH STREQUAL "u55" OR ETHOSU_ARCH STREQUAL "u65")
    message(FATAL_ERROR
        "Ethos-U55/U65 is not reachable from APSS (Cortex-A32).\n"
        "Use Ethos-U85 instead: -DETHOSU_TARGET_NPU_CONFIG=ethos-u85-256")
  endif()

  # Only E8 pairs an APSS core with an Ethos-U85, so it is the only board this
  # combination can target. Checked before the SRAM1 check below, which would
  # otherwise point at a snippet that does not cover this board.
  if(NOT CONFIG_SOC_SERIES_E8)
    message(FATAL_ERROR
        "Ethos-U85 on APSS (Cortex-A32) is only available on the E8 boards.\n"
        "This board's APSS core has no U85 to drive.")
  endif()

  # The NPU and the non-cacheable SRAM1 region both come from the
  # ethos-u85-apss-enable snippet; without it there is no ethosu1 node to bind
  # the driver to and no SRAM1 region for GROUP_LINK_IN() below to target.
  dt_nodelabel(_apss_sram1 NODELABEL "sram1")
  if(NOT _apss_sram1)
    message(FATAL_ERROR
        "APSS build is missing the SRAM1 memory region.\n"
        "Add the APSS NPU snippet: -S ethos-u85-apss-enable")
  endif()
endif()

find_package(Python3 COMPONENTS Interpreter REQUIRED)

# Detect the correct Python executable for executorch scripts.
# Priority: 1) VIRTUAL_ENV/bin/python3 (if venv is active)
#           2) Python3_EXECUTABLE from find_package
# Note: WEST_PYTHON is unreliable as it reflects where west was installed,
# not the currently active virtual environment.
if(DEFINED ENV{VIRTUAL_ENV} AND EXISTS "$ENV{VIRTUAL_ENV}/bin/python3")
  set(ET_PYTHON_EXECUTABLE "$ENV{VIRTUAL_ENV}/bin/python3")
  message(STATUS "Using venv Python for executorch scripts: ${ET_PYTHON_EXECUTABLE}")
else()
  set(ET_PYTHON_EXECUTABLE "${Python3_EXECUTABLE}")
  message(STATUS "Using system Python for executorch scripts: ${ET_PYTHON_EXECUTABLE}")
  message(WARNING "No virtual environment detected. If executorch module is not found, "
                  "ensure you activate the venv before running west build.")
endif()

# ExecuTorch's codegen helpers (tools/cmake/Codegen.cmake) hardcode
# ${PYTHON_EXECUTABLE}, which Zephyr sets from find_package(Python3). That can
# resolve to a bare system interpreter even with the venv active -- this venv's
# bin/python3 is a symlink to /usr/bin/python3, and a venv is only entered when
# the interpreter is invoked *through* its own bin directory. The system
# interpreter cannot "import executorch", so gen_oplist fails at build time
# rather than configure time. Point PYTHON_EXECUTABLE at the interpreter
# resolved above for the rest of this file; Zephyr's own build steps are
# unaffected, because kernel.cmake already added ${ZEPHYR_BASE} as a
# subdirectory from inside find_package(Zephyr), capturing its own value.
set(PYTHON_EXECUTABLE "${ET_PYTHON_EXECUTABLE}")

set(CMAKE_CXX_FLAGS
    "${CMAKE_CXX_FLAGS} -Wall -Wno-switch -Wno-float-conversion -Wno-double-promotion -ffunction-sections -fdata-sections"
)

# Check for operators in the model
execute_process(
  COMMAND
    ${ET_PYTHON_EXECUTABLE} "${ZEPHYR_EXECUTORCH_MODULE_DIR}/codegen/tools/gen_oplist.py"
    --model_file_path=${ET_PTE_FILE_PATH}
    --output_path=${CMAKE_CURRENT_BINARY_DIR}/temp.yaml
  OUTPUT_VARIABLE CMD_RESULT
  RESULT_VARIABLE CMD_RESULT_CODE
  ERROR_VARIABLE CMD_ERROR
)

if(CMD_RESULT_CODE AND NOT CMD_RESULT_CODE EQUAL 0)
  # By far the most common cause, so name it rather than only dumping the
  # traceback: the same failure would otherwise reappear later inside codegen.
  if(CMD_ERROR MATCHES "No module named 'executorch'")
    message(FATAL_ERROR
        "'${ET_PYTHON_EXECUTABLE}' cannot import the executorch Python "
        "package, which this sample needs to read the operator list out of "
        "the .pte.\n"
        "Activate the workspace virtual environment before building:\n"
        "  source <workspace>/.zephyr_venv/bin/activate")
  endif()
  message(FATAL_ERROR "Failed to generate operator list: ${CMD_ERROR}")
endif()

if(CMD_RESULT MATCHES "aten::" OR CMD_RESULT MATCHES "dim_order_ops::")
  set(FOUND_OPS_IN_FILE "true")
else()
  set(FOUND_OPS_IN_FILE "false")
endif()

if(NOT DEFINED EXECUTORCH_DIR)
  if(DEFINED ZEPHYR_EXECUTORCH_MODULE_DIR)
    set(EXECUTORCH_DIR ${ZEPHYR_EXECUTORCH_MODULE_DIR})
    message(STATUS "Using Zephyr module: EXECUTORCH_DIR=${EXECUTORCH_DIR}")
  else()
    message(FATAL_ERROR "executorch module not found.")
  endif()
endif()

set(EXECUTORCH_ROOT ${EXECUTORCH_DIR})

if(NOT TARGET portable_kernels)
  set(EXECUTORCH_PORTABLE_BUILD_KERNELS_ONLY ON)
  add_subdirectory(
    ${EXECUTORCH_DIR}/kernels/portable
    ${CMAKE_CURRENT_BINARY_DIR}/executorch/kernels/portable
  )
  unset(EXECUTORCH_PORTABLE_BUILD_KERNELS_ONLY)
endif()

set(EXECUTORCH_OPS_LIB "")
if(${FOUND_OPS_IN_FILE})
  include(${EXECUTORCH_DIR}/tools/cmake/Utils.cmake)
  include(${EXECUTORCH_DIR}/tools/cmake/Codegen.cmake)
  if(NOT DEFINED EXECUTORCH_ENABLE_DTYPE_SELECTIVE_BUILD)
    set(EXECUTORCH_ENABLE_DTYPE_SELECTIVE_BUILD "")
  endif()
  gen_selected_ops(
    LIB_NAME "cpu_portable_ops_lib"
    OPS_SCHEMA_YAML ""
    ROOT_OPS ""
    INCLUDE_ALL_OPS ""
    OPS_FROM_MODEL "${ET_PTE_FILE_PATH}"
    DTYPE_SELECTIVE_BUILD "${EXECUTORCH_ENABLE_DTYPE_SELECTIVE_BUILD}"
  )
  generate_bindings_for_kernels(
    LIB_NAME "cpu_portable_ops_lib"
    FUNCTIONS_YAML ${EXECUTORCH_DIR}/kernels/portable/functions.yaml
    DTYPE_SELECTIVE_BUILD "${EXECUTORCH_ENABLE_DTYPE_SELECTIVE_BUILD}"
  )
  gen_operators_lib(
    LIB_NAME "cpu_portable_ops_lib"
    KERNEL_LIBS portable_kernels
    DEPS executorch
    DTYPE_SELECTIVE_BUILD "${EXECUTORCH_ENABLE_DTYPE_SELECTIVE_BUILD}"
  )
  set(EXECUTORCH_OPS_LIB "cpu_portable_ops_lib")
endif()

set(_local_flatcc_root ${CMAKE_BINARY_DIR}/flatcc_src)
if(NOT EXISTS ${_local_flatcc_root}/CMakeLists.txt)
  file(MAKE_DIRECTORY ${_local_flatcc_root})
  execute_process(
    COMMAND ${CMAKE_COMMAND} -E copy_directory
            ${EXECUTORCH_DIR}/third-party/flatcc ${_local_flatcc_root}
  )
endif()
set(EXECUTORCH_FLATCC_SOURCE_ROOT ${_local_flatcc_root} CACHE PATH "" FORCE)
set(EXECUTORCH_FLATCC_INSTALL_ROOT ${_local_flatcc_root} CACHE PATH "" FORCE)

set(app_sources
    src/main.cpp
    ${EXECUTORCH_DIR}/examples/arm/executor_runner/arm_memory_allocator.cpp
)
target_sources(app PRIVATE ${app_sources})

set(_model_pte_header ${CMAKE_CURRENT_BINARY_DIR}/model_pte.h)
add_custom_command(
  OUTPUT ${_model_pte_header}
  COMMAND
    ${ET_PYTHON_EXECUTABLE}
    ${EXECUTORCH_DIR}/examples/arm/executor_runner/pte_to_header.py
    --pte ${ET_PTE_FILE_PATH}
    --outdir ${CMAKE_CURRENT_BINARY_DIR}
    --section ${ET_PTE_SECTION}
  DEPENDS ${ET_PTE_FILE_PATH}
          ${EXECUTORCH_DIR}/examples/arm/executor_runner/pte_to_header.py
  COMMENT "Converting ${ET_PTE_FILE_PATH} to model_pte.h"
)
add_custom_target(gen_model_header DEPENDS ${_model_pte_header})
add_dependencies(app gen_model_header)

# Memory pool sizes — Kconfig is the single source of truth.
# NPU scratch (temp pool) is always placed in DTCM for all boards (E7, E8, E1C, B1).
# Method pool uses .alif_sram0 on boards that have it; see main.cpp for details.
target_compile_definitions(
  app PRIVATE
  ET_ARM_METHOD_ALLOCATOR_POOL_SIZE=${CONFIG_EXECUTORCH_METHOD_ALLOCATOR_POOL_SIZE}
  ET_ARM_BAREMETAL_SCRATCH_TEMP_ALLOCATOR_POOL_SIZE=${CONFIG_EXECUTORCH_TEMP_ALLOCATOR_POOL_SIZE}
)

message(STATUS "ExecutorTorch: Method pool: ${CONFIG_EXECUTORCH_METHOD_ALLOCATOR_POOL_SIZE} bytes")
message(STATUS "ExecutorTorch: Temp pool:   ${CONFIG_EXECUTORCH_TEMP_ALLOCATOR_POOL_SIZE} bytes")

target_link_libraries(app PRIVATE libexecutorch)
if(EXECUTORCH_OPS_LIB)
  target_link_libraries(app PRIVATE ${EXECUTORCH_OPS_LIB})
endif()

# The cortex_m operators the model calls.
#
# aot_arm_compiler applies ReplaceQuantNodesPass to every Ethos-U export, so the
# int8 boundary around the delegated subgraph is always expressed as
# cortex_m::quantize_per_tensor.out / cortex_m::dequantize_per_tensor.out rather
# than the quantized_decomposed equivalents. Those kernels must be registered or
# Method::load() aborts with "Missing operator" (Error::NotFound, 0x14) -- the
# .pte itself is core-agnostic, only the kernel registry is not.
#
# On RTSS the executorch Zephyr module builds the whole cortex_m backend, so the
# kernels come from there. It gates that on CONFIG_CPU_CORTEX_M because most of
# the backend's kernels are CMSIS-NN wrappers, and CMSIS-NN is Cortex-M only.
# quantize/dequantize_per_tensor are the two exceptions: they are plain C++ that
# includes nothing beyond kernel_includes.h, with an MVE fast path behind
# __ARM_FEATURE_MVE and a scalar fallback for everything else. So on APSS
# (Cortex-A32) we compile just those two and generate a registration lib for
# them, which keeps one .pte working across both core types.
if(TARGET cortex_m_ops_lib)
  target_link_libraries(app PRIVATE cortex_m_ops_lib)
  if(TARGET cortex_m_kernels)
    target_link_libraries(app PRIVATE cortex_m_kernels)
  endif()
elseif(CMD_RESULT MATCHES "cortex_m::")
  # Anything outside the CMSIS-NN-free pair cannot be served here. Catch it now
  # rather than at method load on the target.
  set(_cortex_m_standalone_ops "cortex_m::quantize_per_tensor.out"
                               "cortex_m::dequantize_per_tensor.out"
  )
  string(REGEX MATCHALL "cortex_m::[A-Za-z0-9_]+\\.[A-Za-z0-9_]+" _model_cortex_m_ops
         "${CMD_RESULT}"
  )
  list(REMOVE_DUPLICATES _model_cortex_m_ops)
  foreach(_op IN LISTS _model_cortex_m_ops)
    if(NOT _op IN_LIST _cortex_m_standalone_ops)
      message(FATAL_ERROR
          "The model needs the operator '${_op}', which the cortex_m backend "
          "implements on top of CMSIS-NN and is therefore available on the "
          "RTSS (Cortex-M) cores only.\n"
          "Re-export the model so that this operator is delegated to the "
          "Ethos-U, or run it on an RTSS core.")
    endif()
  endforeach()

  include(${EXECUTORCH_DIR}/tools/cmake/Utils.cmake)
  include(${EXECUTORCH_DIR}/tools/cmake/Codegen.cmake)

  # The kernel sources are taken from the backend as-is; only the CMSIS-NN
  # dependency is dropped. Compiled with zephyr_interface so they pick up this
  # core's -mcpu/ABI flags and autoconf.h.
  add_library(cortex_m_standalone_kernels
              ${EXECUTORCH_DIR}/backends/cortex_m/ops/op_quantize_per_tensor.cpp
              ${EXECUTORCH_DIR}/backends/cortex_m/ops/op_dequantize_per_tensor.cpp
  )
  get_filename_component(_executorch_parent_dir ${EXECUTORCH_DIR} DIRECTORY)
  target_include_directories(
    cortex_m_standalone_kernels
    PRIVATE ${_executorch_parent_dir}
            ${EXECUTORCH_DIR}/runtime/core/portable_type/c10
  )
  # kernels_util_all_deps provides resize_tensor(), used by both kernels.
  target_link_libraries(
    cortex_m_standalone_kernels PRIVATE zephyr_interface executorch
                                        kernels_util_all_deps
  )

  # Select from the model, so only the operators it actually calls get
  # registered, while the schema still comes from the backend's own yaml.
  gen_selected_ops(
    LIB_NAME "cortex_m_standalone_ops_lib"
    OPS_SCHEMA_YAML ""
    ROOT_OPS ""
    INCLUDE_ALL_OPS ""
    OPS_FROM_MODEL "${ET_PTE_FILE_PATH}"
    DTYPE_SELECTIVE_BUILD ""
  )
  generate_bindings_for_kernels(
    LIB_NAME "cortex_m_standalone_ops_lib"
    CUSTOM_OPS_YAML ${EXECUTORCH_DIR}/backends/cortex_m/ops/operators.yaml
    DTYPE_SELECTIVE_BUILD ""
  )
  gen_operators_lib(
    LIB_NAME "cortex_m_standalone_ops_lib" KERNEL_LIBS
    cortex_m_standalone_kernels DEPS executorch
  )
  target_link_libraries(cortex_m_standalone_ops_lib PRIVATE zephyr_interface)
  target_link_libraries(app PRIVATE cortex_m_standalone_ops_lib)

  message(STATUS
      "ExecuTorch: registering cortex_m quantize/dequantize kernels locally "
      "(cortex_m backend not built for this core)")
endif()
if(TARGET executorch_delegate_ethos_u)
  target_link_libraries(app PRIVATE executorch_delegate_ethos_u)
endif()
if(TARGET ethosu_core_driver)
  target_link_libraries(app PRIVATE ethosu_core_driver)
endif()

target_include_directories(app PRIVATE src ${CMAKE_CURRENT_BINARY_DIR})

# APSS (Cortex-A32): add the SRAM1 output section that holds the NPU-visible
# buffers. SRAM1 is non-cacheable in the MMU, which is what keeps the CPU and
# the NPU coherent on this core; see src/main.cpp and the snippet itself.
if(CONFIG_APSS)
  zephyr_linker_sources(SECTIONS boards/apss_sram1_sections.ld)
endif()

message(STATUS "executorch KWS application configured successfully")
message(STATUS "  Model: ${ET_PTE_FILE_PATH}")
message(STATUS "  NPU: ${ETHOSU_TARGET_NPU_CONFIG}")
```

## Kconfig
```
# Copyright 2026 Alif Semiconductor
# Copyright (c) Meta Platforms, Inc. and affiliates.
# Copyright 2026 Arm Limited and/or its affiliates.
#
# SPDX-License-Identifier: Apache-2.0

source "Kconfig.zephyr"

# Enable the FPU for the Helium/MVE optimisations, but only where one exists:
# CONFIG_FPU depends on CPU_HAS_FPU, which the RTSS (Cortex-M55) cores select
# and APSS (Cortex-A32) does not. Assigning it from prj.conf would abort the
# APSS build, because Zephyr promotes "assigned 'y' but got 'n'" Kconfig
# warnings to errors. The hard-float ABI needs no assignment of its own --
# FP_HARDABI is already the default of the "Floating point ABI" choice, which
# becomes active as soon as FPU is set.
configdefault FPU
	default y if CPU_HAS_FPU

menu "executorch KWS sample configuration"

config EXECUTORCH_METHOD_ALLOCATOR_POOL_SIZE
	int "Method allocator pool size in bytes"
	default 65536 if SOC_FAMILY_BALLETTO
	default 65536 if SOC_SERIES_E1C
	default 1572864
	depends on EXECUTORCH
	help
	  Size of the method allocator pool in bytes. This memory is used
	  for allocating ExecuTorch method instances and their metadata.
	  Default is 64KB for boards without SRAM0 (B1, E1C) which use DTCM,
	  and 1.5MB for boards with SRAM0 (E7/E8).

	  On APSS (Cortex-A32) the pool lives in .bss, which the linker places
	  in SRAM0, so the 1.5MB default applies there too.

config EXECUTORCH_TEMP_ALLOCATOR_POOL_SIZE
	int "Temporary allocator pool size in bytes"
	default 32768 if SOC_FAMILY_BALLETTO
	default 32768 if SOC_SERIES_E1C
	default 32768
	depends on EXECUTORCH
	help
	  Size of the temporary allocator pool in bytes. This memory is used
	  for temporary allocations during model execution such as Ethos-U
	  scratch memory. 32KB is sufficient; the NPU needs ~22KB scratch for
	  the KWS model.

	  On RTSS this must be in DTCM for all boards, because the NPU reaches
	  it through the global alias that local_to_global() computes. On APSS
	  it is placed in non-cacheable SRAM1 instead; see src/main.cpp.

config KWS_ETHOSU_IMAGE_IN_OSPI
	bool
	default y if FLASH_BASE_ADDRESS >= 0xa0000000 && FLASH_BASE_ADDRESS < 0xe0000000
	help
	  Set when the application image is linked to execute in place from
	  an OSPI XIP window (OSPI0 at 0xA0000000 or OSPI1 at 0xC0000000),
	  i.e. the Secure Enclave boots the image directly from OSPI flash.

config KWS_ETHOSU_MODEL_COPY_TO_RAM
	bool "Copy the .pte model to RAM before loading it"
	default y if KWS_ETHOSU_IMAGE_IN_OSPI
	help
	  Copy the .pte (including the Vela command stream and weights of the
	  Ethos-U delegate) from its link location to a RAM buffer at startup,
	  and load the ExecuTorch program from the RAM copy. The delegate hands
	  the NPU pointers into the loaded program, so the NPU then only reads
	  RAM. Enabled by default when the image executes from OSPI XIP:
	  Ethos-U fetches from the OSPI XIP window set up by the boot firmware
	  end in an NPU command stream parse error.

config KWS_ETHOSU_MODEL_RAM_SECTION
	string "Linker section of the RAM model copy"
	depends on KWS_ETHOSU_MODEL_COPY_TO_RAM
	default "SRAM1.et_npu" if APSS
	default ".bss.et_model_ram"
	help
	  Linker input section for the RAM copy of the model. On RTSS the
	  default places it in DTCM together with the Ethos-U scratch, which
	  the NPU reaches through the global alias. On APSS it goes into the
	  non-cacheable SRAM1 region used for the other NPU-visible buffers.

endmenu
```

## sample.yaml
```
sample:
  name: ExecutorTorch Keyword Spotting with Ethos-U
  description: Keyword spotting using ExecutorTorch with Ethos-U NPU acceleration
common:
  tags: executorch ml npu ethos-u kws
  depends_on: executorch arm_ethos_u
tests:
  # Ensemble boards with SRAM0 (E7/E8) - 1.5MB method pool in SRAM0
  # E8: has both U55 (ethosu0) and U85 (ethosu1)
  sample.executorch.kws_ethosu.e8_hp_u55:
    build_only: true
    platform_allow: alif_e8_dk/ae822fa0e5597xx0/rtss_hp
    extra_args:
      - SNIPPET=ethos-u55-enable
      - ET_PTE_FILE_PATH=./kws_u55_256.pte
      - ET_PTE_SECTION=.rodata.model
      - ETHOSU_TARGET_NPU_CONFIG=ethos-u55-256
  sample.executorch.kws_ethosu.e8_hp_u85:
    build_only: true
    platform_allow: alif_e8_dk/ae822fa0e5597xx0/rtss_hp
    extra_args:
      - SNIPPET=ethos-u85-enable
      - ET_PTE_FILE_PATH=./kws_u85_256.pte
      - ET_PTE_SECTION=.rodata.model
      - ETHOSU_TARGET_NPU_CONFIG=ethos-u85-256
  sample.executorch.kws_ethosu.e8_he_u55:
    build_only: true
    platform_allow: alif_e8_dk/ae822fa0e5597xx0/rtss_he
    extra_args:
      - SNIPPET=ethos-u55-enable
      - ET_PTE_FILE_PATH=./kws_u55_128.pte
      - ET_PTE_SECTION=.rodata.model
      - ETHOSU_TARGET_NPU_CONFIG=ethos-u55-128
  sample.executorch.kws_ethosu.e8_he_u85:
    build_only: true
    platform_allow: alif_e8_dk/ae822fa0e5597xx0/rtss_he
    extra_args:
      - SNIPPET=ethos-u85-enable
      - ET_PTE_FILE_PATH=./kws_u85_256.pte
      - ET_PTE_SECTION=.rodata.model
      - ETHOSU_TARGET_NPU_CONFIG=ethos-u85-256
  # E8 APSS (Cortex-A32): U85 only -- the U55 is not reachable from APSS.
  # NPU-visible buffers go to non-cacheable SRAM1; the .pte is shared with the
  # RTSS U85 configurations above.
  sample.executorch.kws_ethosu.e8_apss_u85:
    build_only: true
    platform_allow:
      - alif_e8_dk/ae822fa0e5597xx0/apss
      - alif_e8_ak/ae822fa0e5597xx0/apss
    extra_args:
      - SNIPPET=ethos-u85-apss-enable
      - ET_PTE_FILE_PATH=./kws_u85_256.pte
      - ET_PTE_SECTION=.rodata.model
      - ETHOSU_TARGET_NPU_CONFIG=ethos-u85-256
  # E7: U55 only (no U85)
  sample.executorch.kws_ethosu.e7_hp_u55:
    build_only: true
    platform_allow: alif_e7_dk/ae722f80f55d5xx/rtss_hp
    extra_args:
      - SNIPPET=ethos-u55-enable
      - ET_PTE_FILE_PATH=./kws_u55_256.pte
      - ET_PTE_SECTION=.rodata.model
      - ETHOSU_TARGET_NPU_CONFIG=ethos-u55-256
  sample.executorch.kws_ethosu.e7_he_u55:
    build_only: true
    platform_allow: alif_e7_dk/ae722f80f55d5xx/rtss_he
    extra_args:
      - SNIPPET=ethos-u55-enable
      - ET_PTE_FILE_PATH=./kws_u55_128.pte
      - ET_PTE_SECTION=.rodata.model
      - ETHOSU_TARGET_NPU_CONFIG=ethos-u55-128
  # Boards without SRAM0 (E1C, B1) - 64KB pools in DTCM, U55 only
  sample.executorch.kws_ethosu.e1c_he_u55:
    build_only: true
    platform_allow: alif_e1c_dk/ae1c1f4051920hh/rtss_he
    extra_args:
      - SNIPPET=ethos-u55-enable
      - ET_PTE_FILE_PATH=./kws_u55_128.pte
      - ET_PTE_SECTION=.rodata.model
      - ETHOSU_TARGET_NPU_CONFIG=ethos-u55-128
  sample.executorch.kws_ethosu.b1_he_u55:
    build_only: true
    platform_allow: alif_b1_dk/ab1c1f4m51820ph0/rtss_he
    extra_args:
      - SNIPPET=ethos-u55-enable
      - ET_PTE_FILE_PATH=./kws_u55_128.pte
      - ET_PTE_SECTION=.rodata.model
      - ETHOSU_TARGET_NPU_CONFIG=ethos-u55-128
```

## prj.conf
```kconfig
# Copyright 2026 Alif Semiconductor
# SPDX-License-Identifier: Apache-2.0
#
# executorch Keyword Spotting Application Configuration

# Enable ExecuTorch
CONFIG_EXECUTORCH=y

# C++ Configuration
CONFIG_CPP=y
CONFIG_STD_CPP17=y

# Memory Configuration - increased for executorch requirements
CONFIG_MAIN_STACK_SIZE=8192
CONFIG_HEAP_MEM_POOL_SIZE=32768

# Logging
CONFIG_REQUIRES_FLOAT_PRINTF=y

# Ethos-U NPU Driver
CONFIG_ARM_ETHOS_U=y
CONFIG_ARM_ETHOS_U_LOG_LEVEL_DBG=y

# executorch Memory Pool Configuration
# Pool sizes are set by Kconfig board-conditional defaults:
#   E7/E8 (SRAM0 boards): METHOD=1.5MB (in SRAM0), TEMP=32KB (in DTCM)
#   E1C/B1 (DTCM-only):   METHOD=64KB  (in DTCM), TEMP=32KB (in DTCM)
# Override here only if board default is insufficient.

# Selective operator build - only include ops needed by the model
CONFIG_EXECUTORCH_BUILD_PORTABLE_OPS=n

# FPU/hard-float ABI for the Helium/MVE optimizations is enabled from this
# sample's Kconfig with configdefault, so that the APSS (Cortex-A32) build --
# which has no FPU -- does not fail on an unsatisfiable assignment.
```

## boards/enable_ethosu55.overlay
```dts
/* Copyright (C) 2025 Alif Semiconductor - All Rights Reserved.
 * Use, distribution and modification of this code is permitted under the
 * terms stated in the Alif Semiconductor Software License Agreement
 *
 * You should have received a copy of the Alif Semiconductor Software
 * License Agreement with this file. If not, please write to:
 * contact@alifsemi.com, or visit: https://alifsemi.com/license
 *
 */

/*
 * Ethos-U55 NPU Enable Overlay for ExecutorTorch KWS Application
 *
 * This overlay enables the Ethos-U55 NPU (ethosu0) for all boards.
 *
 * Applicable to ALL Boards:
 *   - B1 (alif_b1_dk)      - U55 only
 *   - E1C (alif_e1c_dk)    - U55 only
 *   - E3 (alif_e3_dk)      - U55 only
 *   - E4 (alif_e4_dk)      - U55 + U85
 *   - E7 (alif_e7_dk)      - U55 only
 *   - E8 (alif_e8_dk)      - U55 + U85
 *
 * Usage:
 *   west build -b <board> <app_path> -- \
 *     -DEXTRA_DTC_OVERLAY_FILE="boards/enable_ethosu55.overlay"
 */

/ {
	ethosu_u55_check {
		compatible = "vnd,ethosu-u55-check";
		ethosu-node = <&ethosu0>;
	};
};

&ethosu0 {
	status = "okay";
};
```

## boards/enable_ethosu85.overlay
```dts
/* Copyright (C) 2025 Alif Semiconductor - All Rights Reserved.
 * Use, distribution and modification of this code is permitted under the
 * terms stated in the Alif Semiconductor Software License Agreement
 *
 * You should have received a copy of the Alif Semiconductor Software
 * License Agreement with this file. If not, please write to:
 * contact@alifsemi.com, or visit: https://alifsemi.com/license
 *
 */

/*
 * Ethos-U85 NPU Enable Overlay for ExecutorTorch KWS Application
 *
 * This overlay enables the Ethos-U85 NPU (ethosu1) for E4/E8 boards.
 *
 * Applicable Boards:
 *   - E4 (alif_e4_dk)      - U55 + U85
 *   - E8 (alif_e8_dk)      - U55 + U85
 *
 * Note: Only E4 and E8 boards have ethosu1 (U85).
 *
 * Usage:
 *   west build -b alif_e8_dk/... <app_path> -- \
 *     -DEXTRA_DTC_OVERLAY_FILE="boards/enable_ethosu85.overlay" \
 *     -DETHOSU_TARGET_NPU_CONFIG=ethos-u85-256
 */

/ {
	ethosu_u85_check {
		compatible = "vnd,ethosu-u85-check";
		ethosu-node = <&ethosu1>;
	};
};

&ethosu1 {
	status = "okay";
};
```

## src/main.cpp
```c
/*
 * Copyright 2026 Alif Semiconductor
 * Copyright (c) Meta Platforms, Inc. and affiliates.
 * Copyright 2025 Arm Limited and/or its affiliates.
 *
 * SPDX-License-Identifier: Apache-2.0
 *
 * Keyword Spotting (KWS) Application using executorch with Ethos-U NPU
 *
 * This application demonstrates running a keyword spotting CNN model
 * on the Ethos-U NPU using executorch runtime with static input data.
 */

#include <errno.h>
#include <executorch/examples/arm/executor_runner/arm_memory_allocator.h>
#include <executorch/extension/data_loader/buffer_data_loader.h>
#include <executorch/extension/runner_util/inputs.h>
#include <executorch/runtime/core/memory_allocator.h>
#include <executorch/runtime/executor/program.h>
#include <executorch/runtime/platform/log.h>
#include <executorch/runtime/platform/platform.h>
#include <executorch/runtime/platform/runtime.h>
#include <math.h>
#include <stdio.h>
#include <zephyr/devicetree.h>
#include <zephyr/kernel.h>
#include <zephyr/sys/printk.h>
#include <cstring>
#include <memory>
#include <vector>

#include "model_pte.h"
#include "kws_input.h"
#include "kws_output.h"

using executorch::aten::ScalarType;
using executorch::aten::Tensor;
using executorch::aten::TensorImpl;
using executorch::extension::BufferCleanup;
using executorch::extension::BufferDataLoader;
using executorch::runtime::Error;
using executorch::runtime::EValue;
using executorch::runtime::HierarchicalAllocator;
using executorch::runtime::MemoryAllocator;
using executorch::runtime::MemoryManager;
using executorch::runtime::Method;
using executorch::runtime::MethodMeta;
using executorch::runtime::Program;
using executorch::runtime::Result;
using executorch::runtime::Span;
using executorch::runtime::Tag;
using executorch::runtime::TensorInfo;

#if defined(CONFIG_ARM_ETHOS_U)
extern "C" executorch::runtime::Error
executorch_delegate_EthosUBackend_registered(void);
#endif

/*
 * method_allocation_pool holds the memory-planned activation buffers and the
 * input/output tensors. Only the CPU touches it -- the Ethos-U delegate copies
 * I/O between these tensors and its own scratch -- so it belongs in cacheable
 * memory.
 *
 * RTSS (Cortex-M55): the default .bss lands in DTCM, so boards that have SRAM0
 * get an explicit .alif_sram0 placement to keep the 1.5MB pool out of DTCM.
 * Boards without sram0 (E1C, B1) fall back to DTCM so the linker does not emit
 * an orphan section.
 *
 * APSS (Cortex-A32): SRAM0 already *is* the linker's RAM region
 * (zephyr,sram = &sram0), so plain .bss is the right home. It is also the only
 * option: the .alif_sram0 output section is defined in
 * soc/alif/ensemble/common/sram.ld, which is included only by the RTSS linker
 * script (linker.ld), not the APSS one (linker_a.ld).
 */
#if !defined(CONFIG_APSS) && DT_NODE_HAS_STATUS(DT_NODELABEL(sram0), okay)
#define ET_METHOD_POOL_ATTR __attribute__((section(".alif_sram0.tensor_arena"), aligned(16)))
#else
#define ET_METHOD_POOL_ATTR __attribute__((aligned(16)))
#endif

/*
 * Buffers that the NPU itself reads and writes: the Ethos-U scratch, which the
 * delegate carves out of the temp allocator, and the fast-scratch region used
 * by Vela's Dedicated_Sram memory mode.
 *
 * RTSS (Cortex-M55): these stay in DTCM (plain .bss). DTCM is never cached, and
 * Alif's ethosu_address_remap() rewrites DTCM addresses to their global alias
 * (0x50800000 + offset) so the NPU can reach them over the AXI fabric. Note
 * that the Ethos-U55 on E8 cannot reach SRAM0 (0x02000000) directly at all, so
 * these must not follow method_allocation_pool into SRAM0.
 *
 * APSS (Cortex-A32): there is no DTCM, local_to_global() is the identity, and
 * Alif's Ethos-U cache callbacks are compiled for Cortex-M only
 * (modules/hal/alif/drivers/ethos_u/CMakeLists.txt gates on CONFIG_CPU_CORTEX_M),
 * which leaves the core driver's weak no-op flush/invalidate hooks in place.
 * Coherency therefore has to come from the memory type rather than from cache
 * maintenance, so these buffers go into SRAM1, which mmu_regions.c maps as
 * non-cacheable normal memory. This also matches the NPU_MEM_ATTR_* settings
 * that zephyr/modules/hal_ethos_u applies for U85 (Normal Non-cacheable
 * Non-bufferable).
 */
#if defined(CONFIG_APSS)
#define ET_NPU_BUF_ATTR __attribute__((section("SRAM1.et_npu"), aligned(16)))
#else
#define ET_NPU_BUF_ATTR __attribute__((aligned(16)))
#endif

#if !defined(ET_ARM_METHOD_ALLOCATOR_POOL_SIZE)
#define ET_ARM_METHOD_ALLOCATOR_POOL_SIZE (1572864)
#endif
const size_t method_allocation_pool_size = ET_ARM_METHOD_ALLOCATOR_POOL_SIZE;
ET_METHOD_POOL_ATTR
unsigned char method_allocation_pool[ET_ARM_METHOD_ALLOCATOR_POOL_SIZE];

#if !defined(ET_ARM_BAREMETAL_SCRATCH_TEMP_ALLOCATOR_POOL_SIZE)
#define ET_ARM_BAREMETAL_SCRATCH_TEMP_ALLOCATOR_POOL_SIZE (32768)
#endif

#if !defined(ET_ARM_BAREMETAL_FAST_SCRATCH_TEMP_ALLOCATOR_POOL_SIZE)
#define ET_ARM_BAREMETAL_FAST_SCRATCH_TEMP_ALLOCATOR_POOL_SIZE 0x600
#endif

const size_t temp_allocation_pool_size =
    ET_ARM_BAREMETAL_SCRATCH_TEMP_ALLOCATOR_POOL_SIZE;
ET_NPU_BUF_ATTR
unsigned char temp_allocation_pool[temp_allocation_pool_size];

#if defined(ET_ARM_BAREMETAL_FAST_SCRATCH_TEMP_ALLOCATOR_POOL_SIZE)
extern "C" {
size_t ethosu_fast_scratch_size =
    ET_ARM_BAREMETAL_FAST_SCRATCH_TEMP_ALLOCATOR_POOL_SIZE;
ET_NPU_BUF_ATTR unsigned char
    ethosu_scratch_pool[ET_ARM_BAREMETAL_FAST_SCRATCH_TEMP_ALLOCATOR_POOL_SIZE];
unsigned char* ethosu_fast_scratch = ethosu_scratch_pool;
}
#endif

/*
 * The Ethos-U delegate passes the NPU pointers into the loaded .pte for the
 * Vela command stream and weights, and BufferDataLoader does not copy. When
 * the image executes from OSPI XIP, NPU reads of that window fail, so the
 * program is loaded from this RAM copy instead.
 */
#if defined(CONFIG_KWS_ETHOSU_MODEL_COPY_TO_RAM)
__attribute__((section(CONFIG_KWS_ETHOSU_MODEL_RAM_SECTION), aligned(16)))
unsigned char model_pte_ram[sizeof(model_pte)];
#endif

namespace {

static const char* kws_labels[] = {
    "silence", "unknown", "yes", "no", "up", "down",
    "left", "right", "on", "off", "stop", "go"
};
static const int kws_num_labels = sizeof(kws_labels) / sizeof(kws_labels[0]);

Result<BufferCleanup> prepare_input_tensors(
    Method& method,
    MemoryAllocator& allocator,
    const uint8_t* input_data,
    size_t input_size) {
  MethodMeta method_meta = method.method_meta();
  size_t num_inputs = method_meta.num_inputs();
  size_t num_allocated = 0;

  void** inputs =
      static_cast<void**>(allocator.allocate(num_inputs * sizeof(void*)));
  ET_CHECK_OR_RETURN_ERROR(
      inputs != nullptr,
      MemoryAllocationFailed,
      "Could not allocate memory for pointers to input buffers.");

  for (size_t i = 0; i < num_inputs; i++) {
    auto tag = method_meta.input_tag(i);
    ET_CHECK_OK_OR_RETURN_ERROR(tag.error());

    if (tag.get() != Tag::Tensor) {
      ET_LOG(Debug, "Skipping non-tensor input %zu", i);
      continue;
    }
    Result<TensorInfo> tensor_meta = method_meta.input_tensor_meta(i);
    ET_CHECK_OK_OR_RETURN_ERROR(tensor_meta.error());

    void* data_ptr = allocator.allocate(tensor_meta->nbytes());
    ET_CHECK_OR_RETURN_ERROR(
        data_ptr != nullptr,
        MemoryAllocationFailed,
        "Could not allocate memory for input buffers.");
    inputs[num_allocated++] = data_ptr;

    Error err = Error::Ok;
    ScalarType scalar_type = tensor_meta->scalar_type();
    size_t num_elements = 1;
    auto sizes = tensor_meta->sizes();
    for (size_t k = 0; k < sizes.size(); k++) {
      num_elements *= sizes[k];
    }

    ET_LOG(Info, "Input tensor: scalar_type=%s, numel=%zu, nbytes=%zu",
           executorch::runtime::toString(scalar_type), num_elements, tensor_meta->nbytes());

    if (scalar_type == ScalarType::Float && input_size == num_elements) {
      ET_LOG(Info, "Converting uint8 input (%zu elements) to float32", input_size);
      float* float_data = static_cast<float*>(data_ptr);
      for (size_t j = 0; j < input_size; j++) {
        float_data[j] = (static_cast<float>(input_data[j]) - 128.0f) / 128.0f;
      }
    } else if (input_size == tensor_meta->nbytes()) {
      ET_LOG(Info, "Copying input data to tensor (%zu bytes)", input_size);
      std::memcpy(data_ptr, input_data, input_size);
    } else {
      ET_LOG(
          Error,
          "Input size (%zu) and tensor size (%zu elements, %zu bytes) mismatch!",
          input_size, num_elements,
          tensor_meta->nbytes());
      err = Error::InvalidArgument;
    }

    TensorImpl impl = TensorImpl(
        tensor_meta.get().scalar_type(),
        tensor_meta.get().sizes().size(),
        const_cast<TensorImpl::SizesType*>(tensor_meta.get().sizes().data()),
        data_ptr,
        const_cast<TensorImpl::DimOrderType*>(
            tensor_meta.get().dim_order().data()));
    Tensor t(&impl);

    err = method.set_input(t, i);

    if (err != Error::Ok) {
      ET_LOG(
          Error, "Failed to prepare input %zu: 0x%" PRIx32, i, (uint32_t)err);
      BufferCleanup cleanup({inputs, num_allocated});
      return err;
    }
  }
  return BufferCleanup({inputs, num_allocated});
}

bool verify_output(
    const std::vector<EValue>& outputs,
    const uint8_t* expected_output,
    size_t expected_size) {
  if (outputs.empty() || !outputs[0].isTensor()) {
    ET_LOG(Error, "Output is not a tensor");
    return false;
  }

  Tensor output_tensor = outputs[0].toTensor();
  ScalarType scalar_type = output_tensor.scalar_type();
  size_t num_elements = output_tensor.numel();

  ET_LOG(Info, "Output tensor: scalar_type=%s, numel=%zu",
         executorch::runtime::toString(scalar_type), num_elements);

  if (num_elements != expected_size) {
    ET_LOG(Error, "Output element count mismatch: got %zu, expected %zu",
           num_elements, expected_size);
    return false;
  }

  bool match = true;

  if (scalar_type == ScalarType::Float) {
    const float* float_data = output_tensor.const_data_ptr<float>();
    for (size_t i = 0; i < expected_size; i++) {
      uint8_t quantized = static_cast<uint8_t>(
          std::max(0.0f, std::min(255.0f, float_data[i] * 128.0f + 128.0f)));
      if (quantized != expected_output[i]) {
        ET_LOG(Info, "Output mismatch at [%zu]: got 0x%02x (float %.4f), expected 0x%02x",
               i, quantized, float_data[i], expected_output[i]);
        match = false;
      }
    }
  } else {
    const uint8_t* output_data = output_tensor.const_data_ptr<uint8_t>();
    for (size_t i = 0; i < expected_size; i++) {
      if (output_data[i] != expected_output[i]) {
        ET_LOG(Info, "Output mismatch at index %zu: got 0x%02x, expected 0x%02x",
               i, output_data[i], expected_output[i]);
        match = false;
      }
    }
  }

  return match;
}

int get_top_prediction(const std::vector<EValue>& outputs) {
  if (outputs.empty() || !outputs[0].isTensor()) {
    return -1;
  }

  Tensor output_tensor = outputs[0].toTensor();
  ScalarType scalar_type = output_tensor.scalar_type();
  size_t num_classes = output_tensor.numel();

  int max_idx = 0;

  if (scalar_type == ScalarType::Float) {
    const float* float_data = output_tensor.const_data_ptr<float>();
    float max_val = float_data[0];
    for (size_t i = 1; i < num_classes && i < (size_t)kws_num_labels; i++) {
      if (float_data[i] > max_val) {
        max_val = float_data[i];
        max_idx = i;
      }
    }
  } else {
    const uint8_t* output_data = output_tensor.const_data_ptr<uint8_t>();
    uint8_t max_val = output_data[0];
    for (size_t i = 1; i < num_classes && i < (size_t)kws_num_labels; i++) {
      if (output_data[i] > max_val) {
        max_val = output_data[i];
        max_idx = i;
      }
    }
  }

  return max_idx;
}

} // namespace

int main(void) {
  printk("\n========================================\n");
  printk("executorch Keyword Spotting Demo\n");
  printk("========================================\n\n");

#if defined(CONFIG_ARM_ETHOS_U)
  if (executorch_delegate_EthosUBackend_registered() != Error::Ok) {
    ET_LOG(
        Error,
        "Ethos-U backend registration failed; model execution cannot continue");
    return 1;
  }
  ET_LOG(Info, "Ethos-U backend registered successfully");
#endif

  /*
   * The NPU reads and writes the temp/fast scratch pools directly, so a port to
   * a new core stands or falls on where they were linked. Report it once at
   * boot: on APSS both must be inside the non-cacheable SRAM1 window, and on
   * RTSS both must be in DTCM.
   */
  ET_LOG(Info, "Method pool  %p (%zu bytes)", method_allocation_pool,
         method_allocation_pool_size);
  ET_LOG(Info, "NPU scratch  %p (%zu bytes)", temp_allocation_pool,
         temp_allocation_pool_size);
#if defined(ET_ARM_BAREMETAL_FAST_SCRATCH_TEMP_ALLOCATOR_POOL_SIZE)
  ET_LOG(Info, "NPU fast scr %p (%zu bytes)", ethosu_fast_scratch,
         ethosu_fast_scratch_size);
#endif

  executorch::runtime::runtime_init();

  size_t pte_size = sizeof(model_pte);
  ET_LOG(Info, "Model PTE at %p, Size: %lu bytes", model_pte, pte_size);

#if defined(CONFIG_KWS_ETHOSU_MODEL_COPY_TO_RAM)
  std::memcpy(model_pte_ram, model_pte, pte_size);
  ET_LOG(Info, "Model copied to RAM: %p -> %p (%zu bytes)", model_pte,
         model_pte_ram, pte_size);
  const void* program_data = model_pte_ram;
#else
  const void* program_data = model_pte;
#endif
  size_t program_data_len = pte_size;

  auto loader = BufferDataLoader(program_data, program_data_len);
  ET_LOG(Info, "Model data loaded. Size: %lu bytes.", program_data_len);

  Result<Program> program = Program::load(&loader);
  if (!program.ok()) {
    ET_LOG(
        Error,
        "Program loading failed @ 0x%p: 0x%" PRIx32,
        program_data,
        program.error());
    return 1;
  }

  ET_LOG(Info, "Model loaded, has %zu methods", program->num_methods());

  const char* method_name = nullptr;
  {
    const auto method_name_result = program->get_method_name(0);
    ET_CHECK_MSG(method_name_result.ok(), "Program has no methods");
    method_name = *method_name_result;
  }
  ET_LOG(Info, "Running method: %s", method_name);

  Result<MethodMeta> method_meta = program->method_meta(method_name);
  if (!method_meta.ok()) {
    ET_LOG(
        Error,
        "Failed to get method_meta for %s: 0x%x",
        method_name,
        (unsigned int)method_meta.error());
    return 1;
  }

  ET_LOG(
      Info,
      "Method allocator pool size: %zu bytes",
      method_allocation_pool_size);

  ArmMemoryAllocator method_allocator(
      method_allocation_pool_size, method_allocation_pool);

  std::vector<uint8_t*> planned_buffers;
  std::vector<Span<uint8_t>> planned_spans;
  size_t num_memory_planned_buffers = method_meta->num_memory_planned_buffers();

  for (size_t id = 0; id < num_memory_planned_buffers; ++id) {
    size_t buffer_size =
        static_cast<size_t>(method_meta->memory_planned_buffer_size(id).get());
    ET_LOG(Info, "Setting up planned buffer %zu, size %zu.", id, buffer_size);

    uint8_t* buffer =
        reinterpret_cast<uint8_t*>(method_allocator.allocate(buffer_size));
    ET_CHECK_MSG(
        buffer != nullptr,
        "Could not allocate memory for memory planned buffer size %zu",
        buffer_size);
    planned_buffers.push_back(buffer);
    planned_spans.push_back({planned_buffers.back(), buffer_size});
  }

  HierarchicalAllocator planned_memory(
      {planned_spans.data(), planned_spans.size()});

  ArmMemoryAllocator temp_allocator(
      temp_allocation_pool_size, temp_allocation_pool);

  MemoryManager memory_manager(
      &method_allocator, &planned_memory, &temp_allocator);

  ET_LOG(Info, "Loading method...");
  executorch::runtime::EventTracer* event_tracer_ptr = nullptr;

  Result<Method> method =
      program->load_method(method_name, &memory_manager, event_tracer_ptr);

  if (!method.ok()) {
    ET_LOG(
        Error,
        "Loading of method %s failed with status 0x%" PRIx32,
        method_name,
        method.error());
    return 1;
  }
  ET_LOG(Info, "Method '%s' loaded successfully", method_name);

  ET_LOG(Info, "Preparing input tensor with static KWS data...");
  ET_LOG(Info, "Input data size: %zu bytes", sizeof(kws_input_data));

  {
    static auto prepared_inputs = ::prepare_input_tensors(
        *method, method_allocator, kws_input_data, sizeof(kws_input_data));

    if (!prepared_inputs.ok()) {
      ET_LOG(
          Error,
          "Preparing input tensors failed with status 0x%" PRIx32,
          prepared_inputs.error());
      return 1;
    }
  }
  ET_LOG(Info, "Input prepared successfully");

  ET_LOG(Info, "\n--- Starting inference ---");
  uint32_t start_time = k_uptime_get_32();

  Error status = method->execute();

  uint32_t end_time = k_uptime_get_32();
  uint32_t inference_time = end_time - start_time;

  if (status != Error::Ok) {
    ET_LOG(
        Error,
        "Execution of method %s failed with status 0x%" PRIx32,
        method_name,
        status);
    return 1;
  }
  ET_LOG(Info, "Inference completed in %u ms", inference_time);

  std::vector<EValue> outputs(method->outputs_size());
  status = method->get_outputs(outputs.data(), outputs.size());
  ET_CHECK(status == Error::Ok);

  ET_LOG(Info, "\n--- Inference Results ---");

  int predicted_class = get_top_prediction(outputs);
  if (predicted_class >= 0 && predicted_class < kws_num_labels) {
    ET_LOG(Info, "Predicted keyword: \"%s\" (class %d)",
           kws_labels[predicted_class], predicted_class);
  }

  ET_LOG(Info, "\nOutput tensor values:");
  for (size_t i = 0; i < outputs.size(); ++i) {
    if (!outputs[i].isTensor()) {
      ET_LOG(Info, "  output[%zu]: non-tensor value", i);
      continue;
    }
    Tensor tensor = outputs[i].toTensor();
    ScalarType scalar_type = tensor.scalar_type();
    ET_LOG(
        Info,
        "  output[%zu]: scalar_type=%s numel=%zd",
        i,
        executorch::runtime::toString(scalar_type),
        tensor.numel());

    if (scalar_type == ScalarType::Float) {
      const float* float_data = tensor.const_data_ptr<float>();
      for (ssize_t j = 0; j < tensor.numel() && j < kws_num_labels; ++j) {
        uint8_t quantized = static_cast<uint8_t>(
            std::max(0.0f, std::min(255.0f, float_data[j] * 128.0f + 128.0f)));
        ET_LOG(Info, "    [%zd] %s: %.4f (q: 0x%02x)",
               j, kws_labels[j], float_data[j], quantized);
      }
    } else {
      const uint8_t* data = tensor.const_data_ptr<uint8_t>();
      for (ssize_t j = 0; j < tensor.numel() && j < kws_num_labels; ++j) {
        ET_LOG(Info, "    [%zd] %s: 0x%02x (%d)",
               j, kws_labels[j], data[j], data[j]);
      }
    }
  }

  ET_LOG(Info, "\n--- Verification ---");
#if SKIP_OUTPUT_VERIFICATION
  bool output_match = true;
  if (!outputs.empty() && outputs[0].isTensor()) {
    Tensor out_tensor = outputs[0].toTensor();
    if (out_tensor.numel() == KWS_NUM_OUTPUT_CLASSES) {
      ET_LOG(Info, "SUCCESS: Output shape verified (12 classes)");
      ET_LOG(Info, "(Value verification skipped - using untrained model)");
    } else {
      ET_LOG(Error, "FAIL: Output shape mismatch (expected %d, got %zd)",
             KWS_NUM_OUTPUT_CLASSES, out_tensor.numel());
      output_match = false;
    }
  } else {
    ET_LOG(Error, "FAIL: No tensor output");
    output_match = false;
  }
#else
  bool output_match = verify_output(outputs, kws_expected_output, sizeof(kws_expected_output));
  if (output_match) {
    ET_LOG(Info, "SUCCESS: Output matches expected values!");
  } else {
    ET_LOG(Info, "WARNING: Output differs from expected values");
    ET_LOG(Info, "Expected output:");
    for (size_t i = 0; i < sizeof(kws_expected_output); i++) {
      ET_LOG(Info, "  [%zu]: 0x%02x", i, kws_expected_output[i]);
    }
  }
#endif

  ET_LOG(Info, "\n========================================");
  ET_LOG(Info, "Keyword Spotting Demo Complete");
  ET_LOG(Info, "Inference time: %u ms", inference_time);
  ET_LOG(Info, "Result: %s", output_match ? "PASS" : "FAIL");
  ET_LOG(Info, "========================================\n");

  return output_match ? 0 : 1;
}
```

## src/kws_input.h
```c
/*
 * Copyright 2026 Alif Semiconductor
 * Copyright 2022 Arm Limited and/or its affiliates <open-source-office@arm.com>
 *
 * SPDX-License-Identifier: Apache-2.0
 *
 * Static input data for Keyword Spotting CNN Small INT8 model
 * Input shape: [1, 490] - MFCC features for audio sample
 */

#ifndef KWS_INPUT_H
#define KWS_INPUT_H

#include <stdint.h>

__aligned(4) static const uint8_t kws_input_data[]
__attribute__((section(".rodata.kws_input"))) = {
	0x2c, 0x8a, 0xff, 0x0c, 0xaf, 0x2a, 0x44, 0x17, 0xf5, 0x26, 0x96, 0x37, 0x40, 0x4c, 0xa1,
	0x58, 0xc3, 0x33, 0xce, 0x1a, 0x7b, 0xd2, 0x22, 0x5b, 0x43, 0xf6, 0xfd, 0x0b, 0xe7, 0xfd,
	0x65, 0x58, 0x89, 0x24, 0xf4, 0xec, 0x53, 0x5e, 0x21, 0x1f, 0x95, 0xd1, 0xd9, 0x25, 0x72,
	0x56, 0xe6, 0xe2, 0xa4, 0x37, 0x85, 0xf0, 0xd7, 0xba, 0xab, 0xcc, 0xc6, 0xbc, 0xcb, 0x64,
	0x58, 0x3d, 0x04, 0x8e, 0xd8, 0x1a, 0x32, 0x76, 0x0c, 0x4d, 0x4c, 0xc5, 0xba, 0xb9, 0xa9,
	0xe2, 0x41, 0xc2, 0xc8, 0xfa, 0x66, 0xfd, 0x2e, 0x4a, 0xa7, 0xca, 0x6a, 0x4f, 0xd7, 0x28,
	0xe5, 0x07, 0x2e, 0x48, 0x5f, 0xfa, 0xd8, 0xde, 0xeb, 0x11, 0xd1, 0x0b, 0x0d, 0xe4, 0x25,
	0x66, 0x73, 0x6c, 0x99, 0xc2, 0x89, 0x56, 0xcd, 0xeb, 0xaf, 0x92, 0xc8, 0x18, 0xdf, 0xd6,
	0x89, 0x9b, 0xce, 0x96, 0x14, 0x17, 0x6e, 0x25, 0xf3, 0x88, 0xad, 0x85, 0x50, 0x93, 0xc5,
	0xde, 0x73, 0x12, 0xa6, 0x55, 0x45, 0x9e, 0x88, 0x75, 0x7e, 0xc7, 0xb5, 0x47, 0xcf, 0x87,
	0x6e, 0xa3, 0x2f, 0x9d, 0x39, 0x5e, 0x40, 0x89, 0x3e, 0x5e, 0xd2, 0x3b, 0x06, 0x7a, 0xe3,
	0xe0, 0xbe, 0xf9, 0x58, 0x27, 0x15, 0x4c, 0x31, 0xfc, 0x88, 0x4d, 0x73, 0x02, 0xa3, 0xf6,
	0x9d, 0x83, 0xbe, 0x05, 0x13, 0x42, 0x50, 0x47, 0x13, 0x8c, 0x4b, 0x2d, 0x0e, 0xbb, 0xc7,
	0x9e, 0x27, 0xe1, 0xfb, 0x38, 0xa0, 0x5d, 0x51, 0x23, 0x41, 0xbf, 0x7f, 0x14, 0x89, 0x4d,
	0x32, 0xa4, 0x39, 0xca, 0x11, 0x09, 0xff, 0x52, 0x55, 0x71, 0xa0, 0x22, 0xb4, 0x42, 0x9f,
	0x5a, 0x17, 0x05, 0x4a, 0x42, 0x9c, 0x9b, 0x74, 0xc8, 0xa7, 0xea, 0x17, 0x60, 0xbd, 0xf9,
	0x23, 0x6a, 0x39, 0xc3, 0x7e, 0xf9, 0x33, 0xaf, 0x4b, 0xad, 0xb4, 0x46, 0xf2, 0x2b, 0x26,
	0x3c, 0x37, 0xc4, 0x46, 0xf4, 0x9c, 0x58, 0xef, 0xb7, 0xa2, 0x63, 0x04, 0x11, 0x00, 0x28,
	0x1d, 0xa2, 0x00, 0xe8, 0x4f, 0x84, 0x24, 0x67, 0x7a, 0xd2, 0xb5, 0xdc, 0x9d, 0x1e, 0x05,
	0x97, 0xd1, 0xa6, 0xa6, 0xce, 0x32, 0x1c, 0x68, 0x8d, 0x6a, 0xb8, 0x74, 0xe2, 0x6f, 0x1d,
	0x91, 0x71, 0x70, 0xe2, 0xcf, 0xf9, 0x19, 0x71, 0x04, 0x31, 0x90, 0x67, 0xe9, 0x46, 0x0b,
	0x2e, 0xaa, 0x6c, 0xaf, 0xf3, 0x3a, 0x35, 0x88, 0xdc, 0x9f, 0x3a, 0x71, 0x1c, 0xf8, 0xd3,
	0x61, 0xef, 0x81, 0xd1, 0x80, 0x67, 0xc1, 0x75, 0x17, 0x32, 0x67, 0xef, 0xea, 0x99, 0x29,
	0x6f, 0xea, 0x8f, 0xb9, 0xe8, 0xc5, 0x78, 0xa3, 0xb9, 0x31, 0x2a, 0xe6, 0xaf, 0xb4, 0x27,
	0xf7, 0x6c, 0x2e, 0x2b, 0x8b, 0x3b, 0x40, 0xab, 0x2e, 0x21, 0x5b, 0xb5, 0xd2, 0x5c, 0x2f,
	0xdb, 0xdb, 0xd0, 0x81, 0xa1, 0x00, 0x77, 0xac, 0x40, 0x0e, 0x69, 0x3f, 0xd0, 0xe3, 0x4a,
	0x1a, 0x1b, 0xb5, 0xa6, 0x9c, 0xdd, 0x0c, 0xcb, 0xb6, 0xd3, 0xf9, 0xea, 0x78, 0x11, 0x2a,
	0xbf, 0x56, 0x89, 0xd4, 0xb0, 0xc8, 0xf0, 0x4b, 0x48, 0xdf, 0x22, 0xc4, 0x91, 0x86, 0x7d,
	0x86, 0x33, 0xfd, 0x75, 0x44, 0x1b, 0x9f, 0x9a, 0xaf, 0xc4, 0x9d, 0x27, 0xff, 0x72, 0xf8,
	0xb5, 0x74, 0xb7, 0x13, 0x22, 0x03, 0x14, 0xcb, 0xa9, 0x4c, 0x73, 0x4b, 0x7e, 0xe4, 0x9b,
	0xb2, 0x27, 0x34, 0xa4, 0x74, 0x14, 0x68, 0x37, 0x57, 0xc0, 0xce, 0x8f, 0x94, 0xea, 0x0f,
	0xa4, 0xe0, 0xf7, 0x14, 0x46, 0x05, 0xf9, 0x63, 0x2c, 0x12, 0xbe, 0x3a, 0xdb, 0x1e, 0x1f,
	0x97, 0xbb, 0x32, 0xa8, 0x4f, 0x2a, 0x07, 0xd6, 0x0d, 0x0b
};

#endif /* KWS_INPUT_H */
```
