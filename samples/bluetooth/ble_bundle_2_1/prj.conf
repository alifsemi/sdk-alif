## CMakeLists.txt
```
# Copyright (C) 2024 Alif Semiconductor - All Rights Reserved.
# Use, distribution and modification of this code is permitted under the
# terms stated in the Alif Semiconductor Software License Agreement
#
# You should have received a copy of the Alif Semiconductor Software
# License Agreement with this file. If not, please write to:
# contact@alifsemi.com, or visit: https://alifsemi.com/license

cmake_minimum_required(VERSION 3.20.0)
find_package(Zephyr REQUIRED HINTS $ENV{ZEPHYR_BASE})
project(le_periph_hr)

include(${CMAKE_CURRENT_SOURCE_DIR}/../common/CMakeLists.txt)

# Include directories
target_include_directories(app PRIVATE
	${COMMON_INC}
)

target_sources(app PRIVATE
    src/main.c
    src/rtc_emulator.c
    src/prxp_rom_1_2.c
    src/cgms_rom_1_2.c
    ${COMMON_SRCS}
)
```

## prj.conf
```kconfig
# Logging
CONFIG_LOG=y
CONFIG_LOG_DEFAULT_LEVEL=3
CONFIG_PRINTK=y
CONFIG_ASSERT=y

# Console output over UART
CONFIG_UART_CONSOLE=y
CONFIG_STDOUT_CONSOLE=y

# BLE ROM-related
CONFIG_BT=y
CONFIG_BT_CUSTOM=y

# Entropy
CONFIG_ENTROPY_GENERATOR=y
CONFIG_TEST_RANDOM_GENERATOR=y

# Device name
CONFIG_BLE_DEVICE_NAME="ALIF_MULTI"

# Stack
CONFIG_MAIN_STACK_SIZE=4096
CONFIG_SYSTEM_WORKQUEUE_STACK_SIZE=4096
CONFIG_HEAP_MEM_POOL_SIZE=4096

# Enable the Settings subsystem
CONFIG_SETTINGS=y

# Enable NVS as the backend for Settings
CONFIG_SETTINGS_NVS=y

# Enable flash support
CONFIG_FLASH=y
CONFIG_FLASH_MAP=y

# Enable NVS
CONFIG_NVS=y

# Optional: Enable runtime API for Settings (may be required for some functions)
CONFIG_SETTINGS_RUNTIME=y

CONFIG_MPU_ALLOW_FLASH_WRITE=y
```

## src/main.c
```c
/* Copyright (C) 2024 Alif Semiconductor - All Rights Reserved.
 * Use, distribution and modification of this code is permitted under the
 * terms stated in the Alif Semiconductor Software License Agreement
 *
 * You should have received a copy of the Alif Semiconductor Software
 * License Agreement with this file. If not, please write to:
 * contact@alifsemi.com, or visit: https://alifsemi.com/license
 */

/*
 * Combined HRPS + BLPS example:
 * - Exposes Heart Rate + Blood Pressure + Battery services simultaneously
 * - Sends dummy measurements periodically, gated by CCCD enable from the phone
 */

#include <zephyr/kernel.h>
#include <zephyr/logging/log.h>

#include "alif_ble.h"
#include "gapm.h"
#include "gap_le.h"
#include "gapc_le.h"
#include "gapc_sec.h"
#include "gapm_le.h"
#include "gapm_le_adv.h"
#include "co_buf.h"
#include "address_verification.h"

#include "shared_control.h"
#include "batt_svc.h"

#include "prf.h"

/* HRPS */
#include "hrp_common.h"
#include "hrps.h"

/* BLPS */
#include "blps.h"
#include "blps_msg.h"
#include "prf_types.h"
#include "rwprf_config.h"

//HTPT
#include "htpt.h"
#include "htpt_msg.h"

enum hrps_feat_bf {
    HRPS_BODY_SENSOR_LOC_CHAR_SUP_POS = 0,
    HRPS_BODY_SENSOR_LOC_CHAR_SUP_BIT = CO_BIT(HRPS_BODY_SENSOR_LOC_CHAR_SUP_POS),
    HRPS_ENGY_EXP_FEAT_SUP_POS = 1,
    HRPS_ENGY_EXP_FEAT_SUP_BIT = CO_BIT(HRPS_ENGY_EXP_FEAT_SUP_POS),
    HRPS_HR_MEAS_NTF_CFG_POS = 2,
    HRPS_HR_MEAS_NTF_CFG_BIT = CO_BIT(HRPS_HR_MEAS_NTF_CFG_POS),
};

/* HTPT config values not exported by headers */
#define HTPT_CFG_STABLE_MEAS_IND_DIS 0
static uint32_t ht_temp_value = 35;   // dummy starting temp
static int8_t ht_direction = 1;

#define BODY_SENSOR_LOCATION_CHEST 0x01

/* Define advertising address type */
#define SAMPLE_ADDR_TYPE    ALIF_STATIC_RAND_ADDR

/* Store and share advertising address type */
static uint8_t adv_type;

struct shared_control ctrl = { false, 0, 0 };

/* Initial dummy value */
static uint16_t current_value = 70;

/* Separate readiness flags for each service (set by CCCD enable + send complete) */
static bool hr_ready_to_send;
static bool bp_ready_to_send;
static bool ht_ready_to_send;


K_SEM_DEFINE(init_sem, 0, 1);
K_SEM_DEFINE(conn_sem, 0, 1);

LOG_MODULE_REGISTER(main, LOG_LEVEL_DBG);

/**
 * Bluetooth stack configuration
 */
static gapm_config_t gapm_cfg = {
    .role = GAP_ROLE_LE_PERIPHERAL,
    .pairing_mode = GAPM_PAIRING_DISABLE,
    .privacy_cfg = 0,
    .renew_dur = 1500,
    .private_identity.addr = {0xCA, 0xFE, 0xFB, 0xDE, 0x11, 0x07},
    .irk.key = {0, 0, 0, 0, 0, 0, 0, 0, 0, 0, 0, 0, 0, 0, 0, 0},
    .gap_start_hdl = 0,
    .gatt_start_hdl = 0,
    .att_cfg = 0,
    .sugg_max_tx_octets = GAP_LE_MIN_OCTETS,
    .sugg_max_tx_time = GAP_LE_MIN_TIME,
    .tx_pref_phy = GAP_PHY_ANY,
    .rx_pref_phy = GAP_PHY_ANY,
    .tx_path_comp = 0,
    .rx_path_comp = 0,
    .class_of_device = 0,  /* BT Classic only */
    .dflt_link_policy = 0, /* BT Classic only */
};

/* Load name from configuration file */
#define DEVICE_NAME CONFIG_BLE_DEVICE_NAME
static const char device_name[] = DEVICE_NAME;

/* Store advertising activity index for re-starting after disconnection */
static uint8_t adv_actv_idx;

static uint16_t start_le_adv(uint8_t actv_idx)
{
    uint16_t err;

    gapm_le_adv_param_t adv_params = {
        .duration = 0, /* Advertise indefinitely */
    };

    err = gapm_le_start_adv(actv_idx, &adv_params);
    if (err) {
        LOG_ERR("Failed to start LE advertising with error %u", err);
    }
    return err;
}

/**
 * Bluetooth GAPM callbacks
 */
static void on_le_connection_req(uint8_t conidx, uint32_t metainfo, uint8_t actv_idx, uint8_t role,
                                 const gap_bdaddr_t *p_peer_addr,
                                 const gapc_le_con_param_t *p_con_params, uint8_t clk_accuracy)
{
    LOG_INF("Connection request on index %u", conidx);
    gapc_le_connection_cfm(conidx, 0, NULL);

    LOG_DBG("Connection parameters: interval %u, latency %u, supervision timeout %u",
            p_con_params->interval, p_con_params->latency, p_con_params->sup_to);

    LOG_HEXDUMP_DBG(p_peer_addr->addr, GAP_BD_ADDR_LEN, "Peer BD address");

    ctrl.connected = true;

    k_sem_give(&conn_sem);

    LOG_DBG("Please enable notifications/indications on peer device..");
}

static void on_key_received(uint8_t conidx, uint32_t metainfo, const gapc_pairing_keys_t *p_keys)
{
    LOG_WRN("Unexpected key received on conidx %u", conidx);
}

static void on_disconnection(uint8_t conidx, uint32_t metainfo, uint16_t reason)
{
    uint16_t err;

    LOG_INF("Connection index %u disconnected for reason %u", conidx, reason);

    err = start_le_adv(adv_actv_idx);
    if (err) {
        LOG_ERR("Error restarting advertising: %u", err);
    } else {
        LOG_DBG("Restarting advertising");
    }

    ctrl.connected = false;

    /* Reset both service gates; phone must re-enable CCCDs after reconnect */
    hr_ready_to_send = false;
    bp_ready_to_send = false;
    ht_ready_to_send = false;

}

static void on_name_get(uint8_t conidx, uint32_t metainfo, uint16_t token, uint16_t offset,
                        uint16_t max_len)
{
    const size_t device_name_len = sizeof(device_name) - 1;
    const size_t short_len = (device_name_len > max_len ? max_len : device_name_len);

    gapc_le_get_name_cfm(conidx, token, GAP_ERR_NO_ERROR, device_name_len, short_len,
                         (const uint8_t *)device_name);
}

static void on_appearance_get(uint8_t conidx, uint32_t metainfo, uint16_t token)
{
    /* Send 'unknown' appearance */
    gapc_le_get_appearance_cfm(conidx, token, GAP_ERR_NO_ERROR, 0);
}

/* ---------------- HRPS callbacks ---------------- */

static void on_hrps_meas_send_complete(uint16_t status)
{
    hr_ready_to_send = true;
}

static void on_hr_bond_data_upd(uint8_t conidx, uint16_t cfg_val)
{
    switch (cfg_val) {
    case PRF_CLI_STOP_NTFIND:
        LOG_INF("HR: Client requested stop notification/indication (conidx: %u)", conidx);
        hr_ready_to_send = false;
        break;

    case PRF_CLI_START_NTF:
    case PRF_CLI_START_IND:
        LOG_INF("HR: Client requested start notification/indication (conidx: %u)", conidx);
        hr_ready_to_send = true;
        break;

    default:
        break;
    }
}

static void on_hr_energy_exp_reset(uint8_t conidx)
{
    ARG_UNUSED(conidx);
}

/* ---------------- BLPS callbacks ---------------- */

static void on_blps_meas_send_complete(uint8_t conidx, uint16_t status)
{
    ARG_UNUSED(conidx);
    ARG_UNUSED(status);
    bp_ready_to_send = true;
}

static void on_blps_bond_data_upd(uint8_t conidx, uint8_t char_code, uint16_t cfg_val)
{
    ARG_UNUSED(char_code);

    switch (cfg_val) {
    case PRF_CLI_STOP_NTFIND:
        LOG_INF("BP: Client requested stop notification/indication (conidx: %u)", conidx);
        bp_ready_to_send = false;
        break;

    case PRF_CLI_START_NTF:
    case PRF_CLI_START_IND:
        LOG_INF("BP: Client requested start notification/indication (conidx: %u)", conidx);
        bp_ready_to_send = true;
        break;

    default:
        break;
    }
}

/* ---------------- HTPT callbacks ---------------- */
static void on_htpt_meas_send_complete(uint16_t status)
{
    ARG_UNUSED(status);
    ht_ready_to_send = true;
}

static void on_htpt_bond_data_upd(uint8_t conidx, uint8_t cfg_val)
{
    switch (cfg_val)
    {
    case HTPT_CFG_STABLE_MEAS_IND:
        LOG_INF("HTP: Client enabled indications");
        ht_ready_to_send = true;
        break;

    case 0:
        LOG_INF("HTP: Client disabled indications");
        ht_ready_to_send = false;
        break;

    default:
        LOG_INF("HTP: Unsupported cfg change");
        break;
    }
}

static void on_htpt_meas_intv_chg(uint8_t conidx, uint16_t interval)
{
    ARG_UNUSED(conidx);
    ARG_UNUSED(interval);
}

static const htpt_cb_t htpt_cb = {
    .cb_bond_data_upd = on_htpt_bond_data_upd,
    .cb_temp_send_cmp = on_htpt_meas_send_complete,
    .cb_meas_intv_chg_req = on_htpt_meas_intv_chg,
};


/* ---------------- GAP callbacks wiring ---------------- */

static const gapc_connection_req_cb_t gapc_con_cbs = {
    .le_connection_req = on_le_connection_req,
};

static const gapc_security_cb_t gapc_sec_cbs = {
    .key_received = on_key_received,
};

static const gapc_connection_info_cb_t gapc_con_inf_cbs = {
    .disconnected = on_disconnection,
    .name_get = on_name_get,
    .appearance_get = on_appearance_get,
};

/* All callbacks in this struct are optional */
static const gapc_le_config_cb_t gapc_le_cfg_cbs;

static void on_gapm_err(uint32_t metainfo, uint8_t code)
{
    LOG_ERR("gapm error %d", code);
}
static const gapm_cb_t gapm_err_cbs = {
    .cb_hw_error = on_gapm_err,
};

static const gapm_callbacks_t gapm_cbs = {
    .p_con_req_cbs = &gapc_con_cbs,
    .p_sec_cbs = &gapc_sec_cbs,
    .p_info_cbs = &gapc_con_inf_cbs,
    .p_le_config_cbs = &gapc_le_cfg_cbs,
    .p_bt_config_cbs = NULL,
    .p_gapm_cbs = &gapm_err_cbs,
};

/* ---------------- Profile callback structs ---------------- */

static const hrps_cb_t hrps_cb = {
    .cb_bond_data_upd = on_hr_bond_data_upd,
    .cb_meas_send_cmp = on_hrps_meas_send_complete,
    .cb_energy_exp_reset = on_hr_energy_exp_reset,
};

static const blps_cb_t blps_cb = {
    .cb_bond_data_upd = on_blps_bond_data_upd,
    .cb_meas_send_cmp = on_blps_meas_send_complete,
};

/* ---------------- Advertising data ---------------- */

static uint16_t set_advertising_data(uint8_t actv_idx)
{
    uint16_t err;

    uint16_t svc_hr   = GATT_SVC_HEART_RATE;      // 0x180D
    uint16_t svc_bp   = GATT_SVC_BLOOD_PRESSURE;  // 0x1810
    uint16_t svc_htp  = GATT_SVC_HEALTH_THERMOM;
    uint16_t svc_batt = get_batt_id();            // 0x180F

    const uint8_t num_svc = 4;

    const uint16_t adv_uuid_svc = GATT_HANDLE_LEN + (GATT_UUID_16_LEN * num_svc);
    const uint16_t adv_len = adv_uuid_svc;

    co_buf_t *p_buf;
    err = co_buf_alloc(&p_buf, 0, adv_len, 0);
	 __ASSERT(err == 0, "ADV buffer alloc failed");

    uint8_t *p_data = co_buf_data(p_buf);

    // Length of UUID list
    p_data[0] = (GATT_UUID_16_LEN * num_svc) + 1;
    p_data[1] = GAP_AD_TYPE_COMPLETE_LIST_16_BIT_UUID;

    memcpy(p_data + 2, &svc_hr,   sizeof(svc_hr));
    memcpy(p_data + 4, &svc_bp,   sizeof(svc_bp));
    memcpy(p_data + 6, &svc_htp, 2);
    memcpy(p_data + 8, &svc_batt, sizeof(svc_batt));

    err = gapm_le_set_adv_data(actv_idx, p_buf);
    co_buf_release(p_buf);

    return err;
}

static uint16_t set_scan_data(uint8_t actv_idx)
{
    co_buf_t *p_buf;
    uint16_t err;

    const size_t name_len = sizeof(device_name) - 1;
    const uint16_t scan_len = GATT_HANDLE_LEN + name_len;

    err = co_buf_alloc(&p_buf, 0, scan_len, 0);
    __ASSERT(err == 0, "SCAN buffer alloc failed");

    uint8_t *p_data = co_buf_data(p_buf);

    /* Complete device name */
    p_data[0] = name_len + 1;
    p_data[1] = GAP_AD_TYPE_COMPLETE_NAME;
    memcpy(p_data + 2, device_name, name_len);

    err = gapm_le_set_scan_response_data(actv_idx, p_buf);
    co_buf_release(p_buf);

    return err;
}

/**
 * Advertising callbacks
 */
static void on_adv_actv_stopped(uint32_t metainfo, uint8_t actv_idx, uint16_t reason)
{
    LOG_DBG("Advertising activity index %u stopped for reason %u", actv_idx, reason);
}

static void on_adv_actv_proc_cmp(uint32_t metainfo, uint8_t proc_id, uint8_t actv_idx,
                                 uint16_t status)
{
    if (status) {
        LOG_ERR("Advertising activity process completed with error %u", status);
        return;
    }

    switch (proc_id) {
    case GAPM_ACTV_CREATE_LE_ADV:
        LOG_DBG("Advertising activity is created");
        adv_actv_idx = actv_idx;
        set_advertising_data(actv_idx);
        break;

    case GAPM_ACTV_SET_ADV_DATA:
        LOG_DBG("Advertising data is set");
        set_scan_data(actv_idx);
        break;

    case GAPM_ACTV_SET_SCAN_RSP_DATA:
        LOG_DBG("Scan data is set");
        start_le_adv(actv_idx);
        break;

    case GAPM_ACTV_START:
        print_device_identity();
        address_verification_log_advertising_address(actv_idx);
        break;

    default:
        LOG_WRN("Unexpected GAPM activity complete, proc_id %u", proc_id);
        break;
    }
}

static void on_adv_created(uint32_t metainfo, uint8_t actv_idx, int8_t tx_pwr)
{
    LOG_DBG("Advertising activity created, index %u, selected tx power %d", actv_idx, tx_pwr);
}

static const gapm_le_adv_cb_actv_t le_adv_cbs = {
    .hdr.actv.stopped = on_adv_actv_stopped,
    .hdr.actv.proc_cmp = on_adv_actv_proc_cmp,
    .created = on_adv_created,
};

static uint16_t create_advertising(void)
{
    uint16_t err;

    gapm_le_adv_create_param_t adv_create_params = {
        .prop = GAPM_ADV_PROP_UNDIR_CONN_MASK,
        .disc_mode = GAPM_ADV_MODE_GEN_DISC,
        .tx_pwr = 0,
        .filter_pol = GAPM_ADV_ALLOW_SCAN_ANY_CON_ANY,
        .prim_cfg = {
            .adv_intv_min = 160, /* 100 ms */
            .adv_intv_max = 800, /* 500 ms */
            .ch_map = ADV_ALL_CHNLS_EN,
            .phy = GAPM_PHY_TYPE_LE_1M,
        },
    };

    err = gapm_le_create_adv_legacy(0, adv_type, &adv_create_params, &le_adv_cbs);
    if (err) {
        LOG_ERR("Error %u creating advertising activity", err);
    }

    return err;
}

/* ---------------- Add profiles ---------------- */

static void server_configure(void)
{
    uint16_t err;

    /* HRPS */
    uint16_t start_hdl_hr = 0;
    struct hrps_db_cfg hrps_cfg = {0};

    hrps_cfg.features = HRPS_BODY_SENSOR_LOC_CHAR_SUP_BIT | HRPS_HR_MEAS_NTF_CFG_BIT;
    hrps_cfg.body_sensor_loc = BODY_SENSOR_LOCATION_CHEST;

    err = prf_add_profile(TASK_ID_HRPS, 0, 0, &hrps_cfg, &hrps_cb, &start_hdl_hr);
    if (err) {
        LOG_ERR("Error %u adding HRPS profile", err);
    }

    /* BLPS */
    uint16_t start_hdl_bp = 0;
    struct blps_db_cfg blps_cfg = {0};

    blps_cfg.features = 0;
    blps_cfg.prfl_cfg = 0;

    err = prf_add_profile(TASK_ID_BLPS, 0, 0, &blps_cfg, &blps_cb, &start_hdl_bp);
    if (err) {
        LOG_ERR("Error %u adding BLPS profile", err);
    }

    //HTPT
    uint16_t start_hdl_ht = 0;
    struct htpt_db_cfg htpt_cfg = {
    .features = HTPT_TEMP_TYPE_CHAR_SUP_BIT,
    .temp_type = HTP_TYPE_BODY,
    };

    err = prf_add_profile(TASK_ID_HTPT, 0, 0, &htpt_cfg, &htpt_cb, &start_hdl_ht);
    if (err) {
    LOG_ERR("Error %u adding HTPT profile", err);
    }

}

void on_gapm_process_complete(uint32_t metainfo, uint16_t status)
{
    if (status) {
        LOG_ERR("gapm process completed with error %u", status);
        return;
    }

    LOG_DBG("gapm process completed successfully");
    k_sem_give(&init_sem);
}

/* ---------------- Measurement senders ---------------- */

static void send_hr_measurement(uint16_t value)
{
    uint16_t err;

    hrs_hr_meas_t hr_meas = {
        .flags = HRS_FLAG_HR_VALUE_FORMAT_POS,
        .heart_rate = value,
        .nb_rr_interval = 0,
    };

    /* Send to all subscribed connections */
    uint32_t conidx_bf = UINT32_MAX;
    err = hrps_meas_send(conidx_bf, &hr_meas);

    if (err) {
        LOG_ERR("Error %u sending HR measurement", err);
    }
}

static void send_bp_measurement(uint16_t value)
{
    uint16_t err;

    /* Dummy timestamp */
    prf_date_time_t ts = {
        .year = 2024,
        .month = 0x04,
        .day = 0x01,
        .hour = 0x01,
        .min = 0x01,
        .sec = 0x01,
    };

    /* Dummy BP measurement */
    bps_bp_meas_t meas = {
        .flags = BPS_MEAS_FLAG_TIME_STAMP_BIT | BPS_MEAS_PULSE_RATE_BIT,
        .user_id = 0,
        .systolic = value,
        .diastolic = value - 10,
        .mean_arterial_pressure = value - 5,
        .pulse_rate = 90,
        .meas_status = 0x01,
        .time_stamp = ts,
    };

    /* Send to first connection only (matches your BLPS sample behavior) */
    err = blps_meas_send(0, true, &meas);

    if (err) {
        LOG_ERR("Error %u sending BP measurement", err);
    }
}

static void update_sensor_value(void)
{
    /* Generating dummy values between 70 and 130 */
    if (current_value >= 130) {
        current_value = 70;
    } else {
        current_value++;
    }
}

static void update_ht_temp(void)
{
    ht_temp_value += ht_direction;

    if (ht_temp_value == 40 || ht_temp_value == 35)
        ht_direction = -ht_direction;
}

static void send_htpt_measurement(void)
{
    uint16_t err;

    htp_temp_meas_t meas = {
        .flags = HTP_UNIT_CELCIUS,
        .temp = ht_temp_value,
    };

    err = htpt_temp_send(&meas, HTP_TEMP_STABLE);

    if (err) {
        LOG_ERR("HTP send error %u", err);
    }
}


static void combined_process(void)
{
    update_sensor_value();

    if (!ctrl.connected) {
        LOG_DBG("Waiting for peer connection...\n");
        k_sem_take(&conn_sem, K_FOREVER);
        return;
    }

    /* HR gated by CCCD enable + send complete */
    if (hr_ready_to_send) {
        send_hr_measurement(current_value);
        hr_ready_to_send = false;
    }

    /* BP gated by CCCD enable + indication/notification complete */
    if (bp_ready_to_send) {
        send_bp_measurement(current_value);
        bp_ready_to_send = false;
    }

    update_ht_temp();
    if (ht_ready_to_send) {
    send_htpt_measurement();
    ht_ready_to_send = false;
    }

}

int main(void)
{
    uint16_t err;

    /* Start up bluetooth host stack */
    alif_ble_enable(NULL);

    if (address_verification(SAMPLE_ADDR_TYPE, &adv_type, &gapm_cfg)) {
        LOG_ERR("Address verification failed");
        return -EADV;
    }

    err = gapm_configure(0, &gapm_cfg, &gapm_cbs, on_gapm_process_complete);
    if (err) {
        LOG_ERR("gapm_configure error %u", err);
        return -1;
    }

    LOG_DBG("Waiting for init...\n");
    k_sem_take(&init_sem, K_FOREVER);
    LOG_DBG("Init complete!\n");

    /* Share connection info */
    service_conn(&ctrl);

    /* Adding battery service */
    config_battery_service();

    /* Add both profiles */
    server_configure();

    /* Create an advertising activity */
    create_advertising();

    while (1) {
        k_sleep(K_SECONDS(1));
        combined_process();
        battery_process();
    }
}
```

## src/cgms_app.h
```c
/* Copyright (C) 2025 Alif Semiconductor - All Rights Reserved.
 * Use, distribution and modification of this code is permitted under the
 * terms stated in the Alif Semiconductor Software License Agreement
 *
 * You should have received a copy of the Alif Semiconductor Software
 * License Agreement with this file. If not, please write to:
 * contact@alifsemi.com, or visit: https://alifsemi.com/license
 */

#ifndef CGMS_APP_H
#define CGMS_APP_H

void cgms_server_configure(void);
void cgms_disc_notify(uint16_t reason);

/* Service specific functions */
void service_conn_cgms(struct shared_control *ctrl);
void cgms_process(uint16_t current_value);
void addr_res_done(void);
gapm_callbacks_t cgms_append_cbs(gapm_callbacks_t *gapm_append_cbs);

#endif /* CGMS_APP_H */
```

## src/cgms_rom_1_0.c
```c
/* Copyright (C) 2025 Alif Semiconductor - All Rights Reserved.
 * Use, distribution and modification of this code is permitted under the
 * terms stated in the Alif Semiconductor Software License Agreement
 *
 * You should have received a copy of the Alif Semiconductor Software
 * License Agreement with this file. If not, please write to:
 * contact@alifsemi.com, or visit: https://alifsemi.com/license
 */

#include <zephyr/kernel.h>
#include <zephyr/logging/log.h>
#include "prf.h"
#include "gapm.h"
#include "gap.h"
#include "shared_control.h"

#include "cgmp_common.h"
#include "cgms.h"
#include "cgms_msg.h"


LOG_MODULE_REGISTER(cgms, LOG_LEVEL_DBG);

extern struct k_sem conn_sem;


#define CGMS_RUN_TIME_HOURS (5)
#define TIME_OFFSET_MINS (20)

/* BLE definitions */
//#define local_sec_level GAP_SEC1_AUTH_PAIR_ENC
#define local_sec_level 0

struct shared_control *s_shared_ptr;

static bool READY_TO_SEND;

static cgm_status_t cgms_status;

static cgm_meas_value_t meas;

void on_gapm_err(enum co_error err)
{
	LOG_ERR("gapm error %d", err);
}

const gapm_err_info_config_cb_t gapm_err_cbs = {
	.ctrl_hw_error = on_gapm_err,
};

gapm_callbacks_t cgms_append_cbs(gapm_callbacks_t *gapm_append_cbs)
{
	gapm_callbacks_t cbs = *gapm_append_cbs;

	cbs.p_err_info_config_cbs = &gapm_err_cbs;

	return cbs;
}

/*
 * CGMS callbacks
 */

static void on_cgms_meas_send_complete(uint8_t conidx, uint16_t status)
{
	READY_TO_SEND = true;
}

static void on_bond_data_upd(uint8_t conidx, uint8_t char_code, uint16_t cfg_val)
{
	switch (cfg_val) {
	case PRF_CLI_STOP_NTFIND:
		LOG_INF("Client requested stop notification/indication (conidx: %u)", conidx);
		READY_TO_SEND = false;
		break;
	case PRF_CLI_START_NTF:
		LOG_INF("Client requested start notification/indication (conidx: %u)", conidx);
			READY_TO_SEND = true;
			LOG_INF("Sending measurements");
		break;

	case PRF_CLI_START_IND:
	default:
		break;
	}
}

static void on_rd_status_req(uint8_t conidx, uint32_t token)
{
	uint16_t status = 0;
	uint16_t err;

	/* Dummy offset */
	cgms_status.time_offset = meas.time_offset;

	err = cgms_rd_status_cfm(conidx, token, status, &(cgms_status));

	if (err) {
		LOG_ERR(" Error sending status 0x%04x", err);
	}
}

/* Dummy start time info for request */
cgm_sess_start_time_t p_start_time_data = {
	.date_time.year = 2025,
	.date_time.month = 10,
};

static void on_re_sess_start_time_req(uint8_t conidx, uint32_t token)
{
	uint16_t status = GAP_ERR_NO_ERROR;

	cgms_rd_sess_start_time_cfm(conidx, token, status,
		&p_start_time_data);
}

static void on_rd_sess_run_time_req(uint8_t conidx, uint32_t token)
{
	uint16_t status;

	status = GAP_ERR_NO_ERROR;
	cgms_rd_sess_run_time_cfm(conidx, token, status, CGMS_RUN_TIME_HOURS);
}

static void on_sess_start_time_upd(uint8_t conidx, const cgm_sess_start_time_t *p_sess_start_time)
{
	/* For the sample application, a single session is started during startup */
	LOG_DBG("Session start time update attempt");
}

static void on_racp_req(uint8_t conidx, uint8_t op_code, uint8_t func_operator, uint8_t filter_type,
			uint16_t min_time_offset, uint16_t max_time_offset)
{
	/* Command received on  the RACP control point */
	/* No records are stored for this sample application */
}

static void on_racp_rsp_send_cmp(uint8_t conidx, uint16_t status)
{
	/* Completion of RACP command response transmission */
	/* No records are stored for this sample application */
}

static void on_ops_ctrl_pt_req(uint8_t conidx, uint8_t op_code,
			       const union cgm_ops_operand *p_operand)
{
	/* Command received on  the RACP control point */
	/* Special OPS not supported by this sample application */
}

static void on_ops_ctrl_pt_rsp_send_cmp(uint8_t conidx, uint16_t status)
{
	/* Completion of Special OPS Control Point command response transmission */
	/* Special OPS not supported by this sample application */
}

static const cgms_cb_t cgms_cb = {
	.cb_meas_send_cmp = on_cgms_meas_send_complete,
	.cb_bond_data_upd = on_bond_data_upd,
	.cb_rd_status_req = on_rd_status_req,
	.cb_rd_sess_start_time_req = on_re_sess_start_time_req,
	.cb_rd_sess_run_time_req = on_rd_sess_run_time_req,
	.cb_sess_start_time_upd = on_sess_start_time_upd,
	.cb_racp_req = on_racp_req,
	.cb_racp_rsp_send_cmp = on_racp_rsp_send_cmp,
	.cb_ops_ctrl_pt_req = on_ops_ctrl_pt_req,
	.cb_ops_ctrl_pt_rsp_send_cmp = on_ops_ctrl_pt_rsp_send_cmp,
};

/* Add heart rate profile to the stack */
void cgms_server_configure(void)
{
	uint16_t err;
	uint16_t start_hdl = 0;
	struct cgms_db_cfg cgms_cfg;

	cgms_cfg.cgm_feature = CGM_FEAT_HYPO_ALERT_SUP_BIT | CGM_FEAT_SENSOR_MALFUNC_DETEC_SUP_BIT;
	cgms_cfg.type_sample = CGM_TYPE_SMP_CAPILLARY_WHOLE_BLOOD;
	cgms_cfg.sample_location = CGM_SMP_LOC_FINGER;

	err = prf_add_profile(TASK_ID_CGMS, local_sec_level, 0, &cgms_cfg, &cgms_cb, &start_hdl);

	if (err) {
		LOG_ERR("Error %u adding profile", err);
	}
}

/*  Generate and send dummy data*/
static void send_measurement(uint16_t current_value)
{
	uint16_t err;
	/* Dummy measurement data */
	meas.flags = CGM_MEAS_FLAGS_CGM_TREND_INFO_BIT | CGM_MEAS_FLAGS_CGM_QUALITY_BIT;
	meas.gluc_concent = current_value - 20;
	meas.time_offset = current_value - 69;
	meas.warn = 0;
	meas.cal_temp = 0;
	meas.sensor_status = CGM_MEAS_ANNUNC_STATUS_DEV_BATT_LOW_BIT;
	meas.trend_info = current_value - 50;

	/* Send measurement to connected device */
	/* Set 0 to first parameter to send only to the first connected peer device */
	err = cgms_meas_send(0, &meas);

	if (err) {
		LOG_ERR("Error %u sending measurement", err);
	}
}

void cgms_process(uint16_t measurement)
{
	if (s_shared_ptr->connected && READY_TO_SEND) {
		send_measurement(measurement);
		READY_TO_SEND = false;
	} else if (!s_shared_ptr->connected) {
		LOG_DBG("Waiting for peer connection...\n");
		k_sem_take(&conn_sem, K_FOREVER);
	}
}

void addr_res_done(void)
{
	/* Continue app */
	k_sem_give(&conn_sem);
}

void service_conn_cgms(struct shared_control *ctrl)
{
	s_shared_ptr = ctrl;
}

void cgms_disc_notify(uint16_t reason)
{
	READY_TO_SEND = false;
}
```

## src/cgms_rom_1_2.c
```c
/* Copyright (C) 2025 Alif Semiconductor - All Rights Reserved.
 * Use, distribution and modification of this code is permitted under the
 * terms stated in the Alif Semiconductor Software License Agreement
 *
 * You should have received a copy of the Alif Semiconductor Software
 * License Agreement with this file. If not, please write to:
 * contact@alifsemi.com, or visit: https://alifsemi.com/license
 */

#include <zephyr/kernel.h>
#include <zephyr/logging/log.h>
#include "prf_types.h"
#include "cgmss.h"
#include "shared_control.h"
#include "co_time.h"

LOG_MODULE_REGISTER(cgms, LOG_LEVEL_DBG);

extern struct k_sem conn_sem;
extern uint8_t cgms_conidx;


#define CGMS_RUN_TIME_HOURS (5)
#define CGMS_CGM_TYPE CGMS_TYPE_CAPILLARY_WHOLE_BLOOD
#define CGMS_SAMPLE_LOCATION CGMS_SAMPLE_LOCATION_FINGER

typedef struct {
	prf_date_time_t date_time;
	int8_t time_zone;
	uint8_t dst_offset;
} app_start_time_t;

typedef struct {
	uint8_t cccd_state_bf;
} app_bond_data_t;

typedef struct {
	app_bond_data_t bond_data;
	app_start_time_t start_time;
	bool ready_to_send;
} app_env_t;

/* Dummy starting values for glucose and time offset */
uint16_t glucose = 0x00AA;
uint16_t time_offset_minutes = 0x00BB;

/* BLE definitions */
#define local_sec_level 0

struct shared_control *s_shared_ptr;

static void on_gapm_err(uint32_t metainfo, uint8_t code)
{
	LOG_ERR("gapm error %d", code);
}
static const gapm_cb_t gapm_err_cbs = {
	.cb_hw_error = on_gapm_err,
};

gapm_callbacks_t cgms_append_cbs(gapm_callbacks_t *gapm_append_cbs)
{
	gapm_callbacks_t cbs = *gapm_append_cbs;

	cbs.p_gapm_cbs = &gapm_err_cbs;

	return cbs;
}

const char cgms_char_name[CGMS_CHAR_TYPE_MAX][31] = {
	"CGM Measurement",
	"CGM Feature",
	"Record Access Control Point",
	"CGM Specific Ops Control Point",
	"CGM Status",
	"CGM Session Start Time",
	"CGM Session Run Time",
};

static app_env_t app_env;

/*
 * CGMS callbacks
 */
static void on_set_session_start_time_req(uint8_t conidx, uint16_t token, co_buf_t *p_buf)
{
	/* for the sample application, a session is started during startup */
	uint16_t status = PRF_ERR_REQ_DISALLOWED;

	LOG_DBG("Sample application continuously running a sesison");
	cgmss_set_value_cfm(conidx, status, token);
}

static void on_value_req(uint8_t conidx, uint8_t char_type, uint16_t token)
{
	co_buf_t *p_buf;
	uint8_t *p_data;
	uint16_t length;

	switch (char_type) {
	case CGMS_CHAR_TYPE_FEATURE:
		length = CGMS_FEATURE_LEN;
		break;

	case CGMS_CHAR_TYPE_STATUS:
		length = CGMS_STATUS_LEN;
		break;

	case CGMS_CHAR_TYPE_SESSION_START_TIME:
		length = CGMS_SESSION_START_TIME_LEN;
		break;

	default:
		length = CGMS_SESSION_RUN_TIME_LEN;
		break;
	}

	cgms_buf_alloc(&p_buf, length);
	p_data = co_buf_data(p_buf);

	switch (char_type) {
	case CGMS_CHAR_TYPE_FEATURE:
		/* CGM Feature field */
		*p_data++ = 0u;

		/* CGMSS_E2E_CRC */
		*p_data++ = 0u;
		*p_data++ = 0u;

		/* CGM Type-Sample Location field */
		*p_data = CGMS_CGM_TYPE
			| (CGMS_SAMPLE_LOCATION << 4);
		break;

	case CGMS_CHAR_TYPE_STATUS:
		/* Time offset field */
		co_write16(p_data, co_htole16(time_offset_minutes));
		p_data += 2u;
		/* CGM Status field */
		*p_data++ = 0u;
		*p_data++ = 0u;
		*p_data = 0u;
		break;

	case CGMS_CHAR_TYPE_SESSION_START_TIME:
		/* Session Start Time field */
		co_write16(p_data, co_htole16(app_env.start_time.date_time.year));
		p_data += 2u;
		*p_data++ = app_env.start_time.date_time.month;
		*p_data++ = app_env.start_time.date_time.day;
		*p_data++ = app_env.start_time.date_time.hour;
		*p_data++ = app_env.start_time.date_time.min;
		*p_data++ = app_env.start_time.date_time.sec;
		/* Time Zone field */
		*p_data++ = app_env.start_time.time_zone;
		/* DST Offset field */
		*p_data = app_env.start_time.dst_offset;
		break;

	default:
		uint16_t time = CGMS_RUN_TIME_HOURS;

		co_write16(p_data, co_htole16(time));
		break;
	}

	cgmss_value_cfm(conidx, token, char_type, p_buf);
	co_buf_release(p_buf);

	LOG_DBG("Read request for %s characteristic", cgms_char_name[char_type]);
}

static void on_control_req(uint8_t conidx, uint8_t char_type, uint16_t token, co_buf_t *p_buf)
{
	/* No records stored for this sample application */
	//uint16_t status = PRF_ERR_REQ_DISALLOWED;

	LOG_DBG("No records available");
	cgmss_set_value_cfm(conidx, GAP_ERR_NO_ERROR, token);
}

static void on_get_cccd_req(uint8_t conidx, uint8_t char_type, uint16_t token)
{
	co_buf_t *p_buf;
	uint16_t value;

	value = PRF_CLI_STOP_NTFIND;

	if ((app_env.bond_data.cccd_state_bf & CO_BIT(char_type)) != 0) {
		value = (char_type == CGMS_CHAR_TYPE_MEASUREMENT) ? PRF_CLI_START_NTF
		: PRF_CLI_START_IND;
	}

	cgms_buf_alloc(&p_buf, PRF_CCC_DESC_LEN);
	co_write16(co_buf_data(p_buf), co_htole16(value));
	cgmss_get_cccd_cfm(conidx, token, p_buf);
	co_buf_release(p_buf);

	LOG_DBG("Get CCCD request for %s characteristic", cgms_char_name[char_type]);
}

/* static void on_set_cccd_req(uint8_t conidx, uint8_t char_type, uint16_t token, co_buf_t *p_buf)
{
	uint16_t status = GAP_ERR_NO_ERROR;
	uint16_t value = co_letoh16(co_read16(co_buf_data(p_buf)));

	value = co_letoh16(co_read16(co_buf_data(p_buf)));

	if (value != PRF_CLI_STOP_NTFIND) {
    bool ok = ((char_type == CGMS_CHAR_TYPE_MEASUREMENT) && (value == PRF_CLI_START_NTF))
           || ((char_type != CGMS_CHAR_TYPE_MEASUREMENT) && (value == PRF_CLI_START_IND));

    if (ok) {
        app_env.bond_data.cccd_state_bf |= CO_BIT(char_type);

        // Only let demo send when MEASUREMENT notifications are enabled
        if (char_type == CGMS_CHAR_TYPE_MEASUREMENT) {
            app_env.ready_to_send = true;
			cgms_conidx = conidx;
        }
    } else {
        status = ATT_ERR_VALUE_NOT_ALLOWED;
    }
	} else {
    app_env.bond_data.cccd_state_bf &= ~CO_BIT(char_type);

    if (char_type == CGMS_CHAR_TYPE_MEASUREMENT) {
        app_env.ready_to_send = false;
		cgms_conidx = 0xFF;
    }
	
	}
} */


static void on_set_cccd_req(uint8_t conidx, uint8_t char_type, uint16_t token, co_buf_t *p_buf)
{
	uint16_t status = GAP_ERR_NO_ERROR;
	uint16_t value;

	value = co_letoh16(co_read16(co_buf_data(p_buf)));

	if (value != PRF_CLI_STOP_NTFIND) {
		if (((char_type == CGMS_CHAR_TYPE_MEASUREMENT) && (value == PRF_CLI_START_NTF))
			|| ((char_type != CGMS_CHAR_TYPE_MEASUREMENT)
			&& (value == PRF_CLI_START_IND))) {
			app_env.bond_data.cccd_state_bf |= CO_BIT(char_type);
			app_env.ready_to_send = true;
		} else {
			status = ATT_ERR_VALUE_NOT_ALLOWED;
		}
	} else {
		app_env.bond_data.cccd_state_bf &= ~CO_BIT(char_type);
		app_env.ready_to_send = false;
	}
	cgmss_set_value_cfm(conidx, status, token);
}

static void on_sent(uint8_t conidx, uint8_t char_type, uint16_t status)
{
	app_env.ready_to_send = true;
}

static const cgmss_cbs_t cgms_cb = {
	.cb_set_session_start_time_req = on_set_session_start_time_req,
	.cb_value_req = on_value_req,
	.cb_control_req = on_control_req,
	.cb_get_cccd_req = on_get_cccd_req,
	.cb_set_cccd_req = on_set_cccd_req,
	.cb_sent = on_sent,
};

static void set_start_time(void)
{
	/* dummy session start date and time */
	app_env.start_time.date_time.year = 2025;
	app_env.start_time.date_time.month = 1;
	app_env.start_time.date_time.day = 1;
	app_env.start_time.date_time.hour = 0;
	app_env.start_time.date_time.min = 0;
	app_env.start_time.date_time.sec = 0;
	app_env.start_time.time_zone = 10;
	app_env.start_time.dst_offset = 0;
}

void cgms_server_configure(void)
{
	uint16_t err;
	uint16_t start_hdl = 0;
	uint8_t cgmss_cfg_bf = 0;
	
	memset(&app_env, 0, sizeof(app_env));

	err = prf_add_profile(TASK_ID_CGMSS, local_sec_level, 0, &cgmss_cfg_bf,
			&cgms_cb, &start_hdl);

	if (err) {
		LOG_ERR("Error %u adding profile", err);
	}

	/* Set sample start time for CGMS session */
	set_start_time();
}

/*  Generate and send dummy data*/
static void send_measurement(uint16_t current_value)
{
	uint16_t err;

	co_buf_t *p_buf;
	uint8_t *p_data;

	cgms_buf_alloc(&p_buf, CGMS_MEASUREMENT_MIN_LEN);
	p_data = co_buf_data(p_buf);

	/* Size field */
	*p_data++ = CGMS_MEASUREMENT_MIN_LEN;
	/* Flags field */
	*p_data++ = 0u;
	/* CGM Glucose Concentration field */
	co_write16(p_data, co_htole16(glucose));
	p_data += 2;
	/* Time Offset field */
	co_write16(p_data, co_htole16(time_offset_minutes));

	err = cgmss_send_measurement(0, p_buf);
	co_buf_release(p_buf);

	if (err) {
		LOG_ERR("Error %u sending measurement", err);
	}
}


/* void cgms_process(uint16_t measurement)
{
	glucose = (glucose >= 0x00DD ? 0x00A9 : glucose) + 1;
	time_offset_minutes = (time_offset_minutes >= 0x00EE ? 0x00BA : time_offset_minutes) + 1;

	if (s_shared_ptr && s_shared_ptr->connected && app_env.ready_to_send) {
		send_measurement(measurement);
		app_env.ready_to_send = false;
	}  else if (!s_shared_ptr->connected) {
		LOG_DBG("Waiting for peer connection...\n");
		k_sem_take(&conn_sem, K_FOREVER);
	} 
} */

/* void cgms_process(uint8_t conidx, uint16_t measurement)
{
    // Guard 1: shared ptr not set yet 
    if (s_shared_ptr == NULL) {
        return;
    }

    // Guard 2: only run when connected 
    if (!s_shared_ptr->connected) {
        return;
    }

    // Guard 3: conidx must be valid 
    if (conidx == 0xFF) {
        return;
    }

    // Guard 4: only send after CCCD enable happened 
    if (!app_env.ready_to_send) {
        return;
    }

    glucose = (glucose >= 0x00DD ? 0x00A9 : glucose) + 1;
    time_offset_minutes = (time_offset_minutes >= 0x00EE ? 0x00BA : time_offset_minutes) + 1;

    send_measurement(conidx, measurement);
    app_env.ready_to_send = false;
} */

void cgms_process(uint16_t measurement)
{
	/* Dummy measurement data */
	glucose = (glucose >= 0x00DD ? 0x00A9 : glucose) + 1;
	time_offset_minutes = (time_offset_minutes >= 0x00EE ? 0x00BA : time_offset_minutes) + 1;

	if (s_shared_ptr->connected && app_env.ready_to_send) {
		send_measurement(measurement);
		app_env.ready_to_send = false;
	} else if (!s_shared_ptr->connected) {
		LOG_DBG("Waiting for peer connection...\n");
		k_sem_take(&conn_sem, K_FOREVER);
	}
}

void addr_res_done(void)
{
	/* Continue app */
	k_sem_give(&conn_sem);
}

void service_conn_cgms(struct shared_control *ctrl)
{
	s_shared_ptr = ctrl;
}

void cgms_disc_notify(uint16_t reason)
{
	app_env.ready_to_send = false;
	cgms_conidx = 0xFF;  
}
```

## src/prxp_app.h
```c
/* Copyright (C) 2025 Alif Semiconductor - All Rights Reserved.
 * Use, distribution and modification of this code is permitted under the
 * terms stated in the Alif Semiconductor Software License Agreement
 *
 * You should have received a copy of the Alif Semiconductor Software
 * License Agreement with this file. If not, please write to:
 * contact@alifsemi.com, or visit: https://alifsemi.com/license
 */

#ifndef PRXP_APP_H
#define PRXP_APP_H

extern bool config_ready;
void prxp_server_configure(void);
//void get_tx_power(void);
void ias_process(void);
//void tx_power_read(void);
void prxp_disc_notify(uint16_t reason);
gapm_callbacks_t prxp_append_cbs(gapm_callbacks_t *gapm_append_cbs);
gapm_le_adv_create_param_t append_adv_param(gapm_le_adv_create_param_t *adv_append_params);

#endif /* PRXP_APP_H */
```

## src/prxp_rom_1_0.c
```c
/* Copyright (C) 2025 Alif Semiconductor - All Rights Reserved.
 * Use, distribution and modification of this code is permitted under the
 * terms stated in the Alif Semiconductor Software License Agreement
 *
 * You should have received a copy of the Alif Semiconductor Software
 * License Agreement with this file. If not, please write to:
 * contact@alifsemi.com, or visit: https://alifsemi.com/license
 */

#include <zephyr/kernel.h>
#include <zephyr/logging/log.h>
#include "alif_ble.h"
#include "gapm_le_adv.h"
#include "co_buf.h"
#include "shared_control.h"

/*  Profiles definitions */
#include "prf.h"
#include "proxr.h"
#include "proxr_msg.h"
#include "prxp_app.h"

LOG_MODULE_REGISTER(prxp, LOG_LEVEL_DBG);

void ll_notify(void);
void ias_reset(void);

static uint8_t ll_level;
static uint8_t iass_level;

/* profile callbacks */
static void on_alert_upd(uint8_t conidx, uint8_t char_code, uint8_t alert_lvl)
{
	LOG_WRN("ALERT UPDATE");
	switch (char_code) {
	case PROXR_ERR_CHAR:
		LOG_DBG("PROXR_ERR_CHAR");
		break;
	case PROXR_LLS_CHAR:
		LOG_DBG("PROXR_LLS_CHAR");
		break;
	case PROXR_IAS_CHAR:
		LOG_DBG("PROXR_IAS_CHAR");
		break;
	default:
		LOG_DBG("alert char_code %02x", char_code);
		break;
	}

	switch (alert_lvl) {
	case PROXR_ALERT_NONE:
		LOG_DBG("PROXR_ALERT_NONE");
		break;
	case PROXR_ALERT_MILD:
		LOG_DBG("PROXR_ALERT_MILD");
		break;
	case PROXR_ALERT_HIGH:
		LOG_DBG("PROXR_ALERT_HIGH");
		break;
	default:
		LOG_DBG("alert level value %02x", alert_lvl);
		break;
	}

	if (char_code == PROXR_IAS_CHAR) {
		iass_level = alert_lvl;
	}
}

static const proxr_cb_t proxr_cb = {
	.cb_alert_upd = on_alert_upd,
};

/* Add profile to the stack */
void prxp_server_configure(void)
{
	uint16_t err;

	/* Dynamic allocation of service start handle*/
	uint16_t start_hdl = 0;

	/* Database configuration structure */
	struct proxr_db_cfg proxr_cfg = {
		.features = PROXR_IAS_TXPS_NOT_SUP,
	};
	err = prf_add_profile(TASK_ID_PROXR, 0, 0, &proxr_cfg, &proxr_cb, &start_hdl);

	if (err) {
		LOG_ERR("Error %u adding profile", err);
	}
}

void ll_notify(void)
{
	if (ll_level != PROXR_ALERT_NONE) {
		LOG_WRN("Link lost alert with level 0x%02x", ll_level);
		ll_level = PROXR_ALERT_NONE;
	}
}

void ias_reset(void)
{
	iass_level = PROXR_ALERT_NONE;
}

void prxp_disc_notify(uint16_t reason)
{
	if (reason != LL_ERR_REMOTE_USER_TERM_CON) {
		ll_notify();
	}
	ias_reset();
}

static void on_gapm_err(enum co_error err)
{
	LOG_ERR("gapm error %d", err);
}

static const gapm_err_info_config_cb_t gapm_err_cbs = {
	.ctrl_hw_error = on_gapm_err,
};

gapm_callbacks_t prxp_append_cbs(gapm_callbacks_t *gapm_append_cbs)
{
	gapm_callbacks_t cbs = *gapm_append_cbs;

	cbs.p_err_info_config_cbs = &gapm_err_cbs;

	return cbs;
}

void tx_power_read(void)
{
	/* No need to implement, required for newer BLE ROM versions */
}

void ias_process(void)
{
	/* IAS alert shall continue until disconnection or set to None*/
	if (iass_level == PROXR_ALERT_MILD) {
		LOG_WRN("IAS mild alert");
	} else if (iass_level == PROXR_ALERT_HIGH) {
		LOG_WRN("IAS high alert");
	}
}

gapm_le_adv_create_param_t append_adv_param(gapm_le_adv_create_param_t *adv_append_params)
{
	int8_t tx_pwr_param = 0;

	gapm_le_adv_create_param_t adv_params = *adv_append_params;

	adv_params.max_tx_pwr = tx_pwr_param;
	return adv_params;
}
```

## src/prxp_rom_1_2.c
```c
/* Copyright (C) 2025 Alif Semiconductor - All Rights Reserved.
 * Use, distribution and modification of this code is permitted under the
 * terms stated in the Alif Semiconductor Software License Agreement
 *
 * You should have received a copy of the Alif Semiconductor Software
 * License Agreement with this file. If not, please write to:
 * contact@alifsemi.com, or visit: https://alifsemi.com/license
 */

#include <zephyr/kernel.h>
#include <zephyr/logging/log.h>
#include "alif_ble.h"
#include "gapm_le_adv.h"
#include "co_buf.h"
#include "shared_control.h"

/*  Profiles definitions */
#include "llss.h"
#include "iass.h"
#include "tpss.h"
#include "prxp_app.h"

LOG_MODULE_REGISTER(prxp, LOG_LEVEL_DBG);

void ll_notify(void);
void ias_reset(void);
//static bool tx_read_cmp;

/* profile callbacks */
static uint8_t ll_level;
static uint8_t iass_level;
//static int8_t tx_pwr_lvl;

void ll_notify(void)
{
	if (ll_level != LLS_ALERT_LEVEL_NONE) {
		LOG_WRN("Link lost alert with level 0x%02x", ll_level);
		ll_level = LLS_ALERT_LEVEL_NONE;
	}
}

void ias_reset(void)
{
	iass_level = IAS_ALERT_LEVEL_NONE;
}

static void on_get_level_req(uint8_t conidx, uint16_t token)
{
	co_buf_t *p_buf;

	prf_buf_alloc(&p_buf, LLS_ALERT_LEVEL_SIZE);
	*co_buf_data(p_buf) = ll_level;
	llss_get_level_cfm(conidx, token, p_buf);
	co_buf_release(p_buf);

	LOG_DBG("Level requested");
}

static void on_set_level_req(uint8_t conidx, uint16_t token, co_buf_t *p_buf)
{
	uint8_t level = *co_buf_data(p_buf);
	uint16_t status;

	if (level < LLS_ALERT_LEVEL_MAX) {
		ll_level = level;
		status = GAP_ERR_NO_ERROR;
		LOG_INF("Set level requested: %d", level);
	} else {
		status = ATT_ERR_VALUE_NOT_ALLOWED;
	}

	llss_set_level_cfm(conidx, status, token);
}

static const llss_cbs_t llss_cb = {
	.cb_get_level_req = on_get_level_req,
	.cb_set_level_req = on_set_level_req,
};

/* static void on_level(uint8_t conidx, co_buf_t *p_buf)
{
	uint8_t level = *co_buf_data(p_buf);

	if (level < IAS_ALERT_LEVEL_MAX) {
		iass_level = level;
	} else {
		LOG_ERR("Invalid Immediate Alert Level");
	}
} */

/* static const iass_cbs_t iass_cb = {
	.cb_level = on_level,
}; */

uint16_t temp_token;

/* static void cmp_cb(uint8_t conidx, uint32_t metainfo, uint16_t status, uint8_t phy,
		   int8_t power_level, int8_t max_power_level)
{
	tx_pwr_lvl = power_level;
	tx_read_cmp = true;
	co_buf_t *p_buf;

	prf_buf_alloc(&p_buf, TPS_LEVEL_SIZE);
	*co_buf_data(p_buf) = (uint8_t)tx_pwr_lvl;
	tpss_level_cfm(conidx, temp_token, p_buf);
	co_buf_release(p_buf);
	LOG_INF("Tx Power level 1M PHY sent:: %" PRId8 "\n", tx_pwr_lvl);
	temp_token = 0;
} */

/*static void on_level_req(uint8_t conidx, uint16_t token)
{
	temp_token = token;
	gapc_le_get_local_tx_power_level(conidx, 0, GAPC_PHY_PWR_1MBPS_VALUE, cmp_cb);
} */

/* static const tpss_cbs_t tpss_cb = {
	.cb_level_req = on_level_req,
}; */

/* Add profile to the stack */
void prxp_server_configure(void)
{
	uint16_t err;

	/* Dynamic allocation of service start handle*/
	uint16_t start_hdl = 0;

	alif_ble_mutex_lock(K_FOREVER);
	err = prf_add_profile(TASK_ID_LLSS, 0, 0, NULL, &llss_cb, &start_hdl);
	alif_ble_mutex_unlock();

	/*alif_ble_mutex_lock(K_FOREVER);
	err = prf_add_profile(TASK_ID_IASS, 0, 0, NULL, &iass_cb, &start_hdl);
	alif_ble_mutex_unlock();*/

	/* alif_ble_mutex_lock(K_FOREVER);
	err = prf_add_profile(TASK_ID_TPSS, 0, 0, NULL, &tpss_cb, &start_hdl);
	alif_ble_mutex_unlock(); */

	if (err) {
		LOG_ERR("Error %u adding profile", err);
	}
}

void on_gapm_err(uint32_t metainfo, uint8_t code)
{
	LOG_ERR("gapm error %d", code);
}
static const gapm_cb_t gapm_err_cbs = {
	.cb_hw_error = on_gapm_err,
};

gapm_callbacks_t prxp_append_cbs(gapm_callbacks_t *gapm_append_cbs)
{
	gapm_callbacks_t cbs = *gapm_append_cbs;

	cbs.p_gapm_cbs = &gapm_err_cbs;
	return cbs;
}

gapm_le_adv_create_param_t append_adv_param(gapm_le_adv_create_param_t *adv_append_params)
{
	int8_t tx_pwr_param = 0;
	gapm_le_adv_create_param_t adv_params = *adv_append_params;

	adv_params.tx_pwr = tx_pwr_param;
	return adv_params;
}

void ias_process(void)
{
	/* IAS alert shall continue until disconnection or set to None*/
	if (iass_level == IAS_ALERT_LEVEL_MILD) {
		LOG_WRN("IAS mild alert");
	} else if (iass_level == IAS_ALERT_LEVEL_HIGH) {
		LOG_WRN("IAS high alert");
	}
}

void prxp_disc_notify(uint16_t reason)
{
	if (reason != LL_ERR_REMOTE_USER_TERM_CON) {
		ll_notify();
	}
	ias_reset();
}
```

## src/rtc_emulator.c
```c
/* Copyright (C) 2024 Alif Semiconductor - All Rights Reserved.
 * Use, distribution and modification of this code is permitted under the
 * terms stated in the Alif Semiconductor Software License Agreement
 *
 * You should have received a copy of the Alif Semiconductor Software
 * License Agreement with this file. If not, please write to:
 * contact@alifsemi.com, or visit: https://alifsemi.com/license
 */

#include <zephyr/kernel.h>
#include "prf_types.h"
#include "rtc_emulator.h"

/* Define a thread data structure */
struct k_thread rtc_thread_data;

/* Dummy timestamp info */
static prf_date_time_t device_base_time = {
	.year = 2024,
	.month = 1,
	.day = 1,
	.hour = 0,
	.min = 0,
	.sec = 0,
};

/* Define stack size for the thread */
#define STACK_SIZE 1024

/* Define the thread priority*/
#define THREAD_PRIORITY 7

/* Define a thread stack area */
K_THREAD_STACK_DEFINE(rtc_stack_area, STACK_SIZE);

/* Thread entry function */
void rtc_thread(void *arg1, void *arg2, void *arg3)
{
	while (1) {
		device_base_time.sec++;
		if (device_base_time.sec >= 60) {
			device_base_time.sec = 0;
			device_base_time.min++;
			if (device_base_time.min >= 60) {
				device_base_time.min = 0;
				device_base_time.hour++;
				if (device_base_time.hour >= 24) {
					device_base_time.hour = 0;
					device_base_time.day++;
					/*Simplified month length handling for demonstration
					 * purposes February and leap years are not handled
					 */
					if ((device_base_time.month == 1 ||
					     device_base_time.month == 3 ||
					     device_base_time.month == 5 ||
					     device_base_time.month == 7 ||
					     device_base_time.month == 8 ||
					     device_base_time.month == 10 ||
					     device_base_time.month == 12) &&
					    device_base_time.day > 31) {
						device_base_time.day = 1;
						device_base_time.month++;
					} else if ((device_base_time.month == 4 ||
						    device_base_time.month == 6 ||
						    device_base_time.month == 9 ||
						    device_base_time.month == 11) &&
						   device_base_time.day > 30) {
						device_base_time.day = 1;
						device_base_time.month++;
					} else if (device_base_time.month == 2 &&
						   device_base_time.day > 28) {
							/* Simplified, no
							 * leap year handling
							 */
						device_base_time.day = 1;
						device_base_time.month++;
					}
					if (device_base_time.month > 12) {
						device_base_time.month = 1;
						device_base_time.year++;
					}
				}
			}
		}
		k_sleep(K_SECONDS(1));
	}
}

void start_rtc_emulator(void)
{
	k_thread_create(&rtc_thread_data, rtc_stack_area, K_THREAD_STACK_SIZEOF(rtc_stack_area),
			rtc_thread, NULL, NULL, NULL, THREAD_PRIORITY, 0, K_NO_WAIT);
}

void *get_device_time(void)
{
	return &device_base_time;
}
```

## src/rtc_emulator.h
```c
/* Copyright (C) 2024 Alif Semiconductor - All Rights Reserved.
 * Use, distribution and modification of this code is permitted under the
 * terms stated in the Alif Semiconductor Software License Agreement
 *
 * You should have received a copy of the Alif Semiconductor Software
 * License Agreement with this file. If not, please write to:
 * contact@alifsemi.com, or visit: https://alifsemi.com/license
 */

/*
 * RTC emulator
 */

void start_rtc_emulator(void);
void *get_device_time(void);
```
