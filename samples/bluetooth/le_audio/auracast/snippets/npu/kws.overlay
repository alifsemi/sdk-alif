/* Copyright (C) Alif Semiconductor - All Rights Reserved.
 * Use, distribution and modification of this code is permitted under the
 * terms stated in the Alif Semiconductor Software License Agreement
 *
 * You should have received a copy of the Alif Semiconductor Software
 * License Agreement with this file. If not, please write to:
 * contact@alifsemi.com, or visit: https://alifsemi.com/license
 */

/* i2s1 default pinmux conflicts with ospi0 */
&i2s1 {
	status = "disabled";
};

&ospi0 {
	bus-speed = <80000000>;
	status = "okay";
};

&ethosu0 {
	status = "okay";
};
