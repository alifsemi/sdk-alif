## samples/bluetooth/le_throughput/sample.yaml
```yaml
sample:
  name: LE Throughput
tests:
  sample.bt_custom.le_throughput:
    build_only: true
    tags:
      - bluetooth
      - bt_custom
```

## samples/drivers/ipm/ipm_arm_mhuv2/sample.yaml
```yaml
---
sample:
  name: MHUv2 driver sample
tests:
  sample.drivers.ipm.arm_mhuv2:
    tags: MHUv2
    platform_allow:
      - alif_e8_dk/ae822fa0e5597xx0/rtss_hp
      - alif_e8_dk/ae822fa0e5597xx0/rtss_he
  sample.drivers.ipm.arm_mhuv2.a32_he_responder:
    tags: MHUv2
    extra_configs:
      - CONFIG_A32_HE_R=y
    platform_allow:
      - alif_e8_dk/ae822fa0e5597xx0/apss
```

## samples/modules/executorch/alif_asr/boards/alif_e8_dk_ae822fa0e5597xx0_rtss_he.conf
```kconfig
CONFIG_ACTIVATION_BUF_SECTION="SRAM0.activation_buf"
CONFIG_I2S=y
CONFIG_SYSTEM_HEAP_SRAM0=y
CONFIG_ACTIVATION_BUF_SZ=0x200000
```

## samples/modules/tflite-micro/alif_img_class/Kconfig
```kconfig
config ACTIVATION_BUF_SECTION
	string "Linker section where activation buffer (tensor arena) is placed"
	default "SRAM1.activation_buf"

config ACTIVATION_BUF_SZ
	hex "Tensor arena size"
	default 0x200000

config MODEL_SECTION
	string "Linker section where ML model is placed"
	default ".rodata.tflm_model"

config APP_DISPLAY_DIRECT_MODE
	bool "Render LVGL directly into double-buffered CDC200 framebuffers"
	depends on CDC200 && LVGL
	help
	  Use LVGL DIRECT render mode with two full-screen framebuffers: the
	  CDC200 driver's own framebuffer plus one extra buffer allocated in
	  SRAM0. The flush callback page-flips at vblank, which removes the
	  tearing caused by copying partial renders into the framebuffer that
	  is being scanned out. Costs one extra full-screen framebuffer of SRAM0.

source "Kconfig.zephyr"
	
```

## tests/common/Kconfig.pstate
```kconfig
# Copyright Alif Semiconductor - All Rights Reserved.
# Use, distribution and modification of this code is permitted under the
# terms stated in the Alif Semiconductor Software License Agreement
#
# You should have received a copy of the Alif Semiconductor Software
# License Agreement with this file. If not, please write to:
# contact@alifsemi.com, or visit: https://alifsemi.com/license

menu "Alif test P-state selection"

config ALIF_TEST_PSTATE_ALL
	bool "Run every PLL row and HFRC down to 19.2 MHz"
	help
	  Enable every extra PLL row for this core and the HFRC rows at
	  76.8, 38.4, and 19.2 MHz. Slower HFRC dividers stay off because
	  peripherals need a higher input clock. Select those with their
	  own symbols. The boot PLL stays enabled.

comment "PLL frequencies"

config ALIF_TEST_PSTATE_PLL_200
	bool "200 MHz PLL"
	depends on RTSS_HP
	depends on !ALIF_TEST_PSTATE_ALL
	help
	  Walk the 200 MHz PLL row in addition to the boot PLL.

config ALIF_TEST_PSTATE_PLL_100
	bool "100 MHz PLL"
	depends on RTSS_HP
	depends on !ALIF_TEST_PSTATE_ALL
	help
	  Walk the 100 MHz PLL row in addition to the boot PLL.

config ALIF_TEST_PSTATE_PLL_120
	bool "120 MHz PLL"
	depends on !RTSS_HP
	depends on !ALIF_TEST_PSTATE_ALL
	help
	  Walk the 120 MHz PLL row in addition to the boot PLL.

config ALIF_TEST_PSTATE_PLL_80
	bool "80 MHz PLL"
	depends on !RTSS_HP
	depends on !ALIF_TEST_PSTATE_ALL
	help
	  Walk the 80 MHz PLL row in addition to the boot PLL.

config ALIF_TEST_PSTATE_PLL_60
	bool "60 MHz PLL"
	depends on !RTSS_HP
	depends on !ALIF_TEST_PSTATE_ALL
	help
	  Walk the 60 MHz PLL row in addition to the boot PLL.
	  HP has no 60 MHz PLL row.

comment "HFRC frequencies"

config ALIF_TEST_PSTATE_HFRC_76P8
	bool "76.8 MHz HFRC"
	depends on !ALIF_TEST_PSTATE_ALL
	help
	  Walk the 76.8 MHz HFRC row in addition to the selected PLL rows.

config ALIF_TEST_PSTATE_HFRC_38P4
	bool "38.4 MHz HFRC"
	depends on !ALIF_TEST_PSTATE_ALL
	help
	  Walk the 38.4 MHz HFRC row in addition to the selected PLL rows.

config ALIF_TEST_PSTATE_HFRC_19P2
	bool "19.2 MHz HFRC"
	depends on !ALIF_TEST_PSTATE_ALL
	help
	  Walk the 19.2 MHz HFRC row in addition to the selected PLL rows.

config ALIF_TEST_PSTATE_HFRC_9P6
	bool "9.6 MHz HFRC"
	depends on !ALIF_TEST_PSTATE_ALL
	help
	  Walk the 9.6 MHz HFRC row in addition to the selected PLL rows.

config ALIF_TEST_PSTATE_HFRC_4P8
	bool "4.8 MHz HFRC"
	depends on !ALIF_TEST_PSTATE_ALL
	help
	  Walk the 4.8 MHz HFRC row in addition to the selected PLL rows.

config ALIF_TEST_PSTATE_HFRC_2P4
	bool "2.4 MHz HFRC"
	depends on !ALIF_TEST_PSTATE_ALL
	help
	  Walk the 2.4 MHz HFRC row in addition to the selected PLL rows.

config ALIF_TEST_PSTATE_HFRC_1P2
	bool "1.2 MHz HFRC"
	depends on !ALIF_TEST_PSTATE_ALL
	help
	  Walk the 1.2 MHz HFRC row in addition to the selected PLL rows.

config ALIF_TEST_PSTATE_HFRC_0P6
	bool "0.6 MHz HFRC"
	depends on !ALIF_TEST_PSTATE_ALL
	help
	  Walk the 0.6 MHz HFRC row in addition to the selected PLL rows.

endmenu
```

## tests/drivers/adc/testcase.yaml
```yaml
common:
  tags: adc drivers
  depends_on: adc
  harness: ztest
  timeout: 600
  platform_allow:
    - alif_b1_dk/ab1c1f4m51820ph0/rtss_he
    - alif_e1c_dk/ae1c1f4051920hh/rtss_he
    - alif_e8_dk/ae822fa0e5597xx0/rtss_he
    - alif_e8_dk/ae822fa0e5597xx0/rtss_hp
    - alif_e7_dk/ae722f80f55d5xx/rtss_he
    - alif_e7_dk/ae722f80f55d5xx/rtss_hp
  integration_platforms:
    - alif_e8_dk/ae822fa0e5597xx0/rtss_he

# CONFIG_TEST_ADC_CH<N> is enabled per scenario rather than in "common", because the
# invalid-channel ZTESTs are compiled only when no channel is enabled. Keeping the
# channel options out of "common" lets the *_invalid_channel scenarios below build
# the negative paths.
tests:
  drivers.adc.adc12.single_ended:
    extra_dtc_overlay_files:
      - boards/alif_adc1.overlay
    extra_configs:
      - CONFIG_TEST_ADC_CH0=y
      - CONFIG_TEST_ADC_CH1=y
      - CONFIG_TEST_ADC_CH2=y
      - CONFIG_TEST_ADC_CH3=y
      - CONFIG_TEST_ADC_CH4=y
      - CONFIG_TEST_ADC_CH5=y
      - CONFIG_TEST_ADC_CH6=y
      - CONFIG_TEST_ADC_CH7=y

  drivers.adc.adc12.continuous:
    extra_dtc_overlay_files:
      - boards/alif_adc1.overlay
      - boards/alif_adc1_continuous.overlay
    extra_configs:
      - CONFIG_TEST_ADC_CONTINUOUS=y

  drivers.adc.adc12.differential:
    extra_dtc_overlay_files:
      - boards/alif_adc1.overlay
    extra_configs:
      - CONFIG_TEST_ADC_DIFFERENTIAL=y
      - CONFIG_TEST_ADC_CH0=y
      - CONFIG_TEST_ADC_CH1=y
      - CONFIG_TEST_ADC_CH2=y
      - CONFIG_TEST_ADC_CH3=y
      - CONFIG_TEST_ADC_CH4=y
      - CONFIG_TEST_ADC_CH5=y
      - CONFIG_TEST_ADC_CH6=y
      - CONFIG_TEST_ADC_CH7=y

  # No CONFIG_TEST_ADC_CH<N>: builds the ADC12 channel 3-7 differential
  # error-scenario tests, which expect adc_channel_setup() to fail.
  drivers.adc.adc12.differential_invalid_channel:
    extra_dtc_overlay_files:
      - boards/alif_adc1.overlay
    extra_configs:
      - CONFIG_TEST_ADC_DIFFERENTIAL=y

  drivers.adc.adc12.multich:
    extra_dtc_overlay_files:
      - boards/alif_adc1.overlay
      - boards/alif_adc1_multich.overlay
    extra_configs:
      - CONFIG_TEST_ADC_MULTICH=y

  drivers.adc.adc12.continuous_differential:
    extra_dtc_overlay_files:
      - boards/alif_adc1.overlay
      - boards/alif_adc1_continuous.overlay
    extra_configs:
      - CONFIG_TEST_ADC_CONTINUOUS=y
      - CONFIG_TEST_ADC_DIFFERENTIAL=y

  drivers.adc.adc12.gain:
    extra_dtc_overlay_files:
      - boards/alif_adc1.overlay
      - boards/alif_adc1_gain.overlay
    extra_configs:
      - CONFIG_TEST_ADC_CH0=y
      - CONFIG_TEST_ADC_CH1=y
      - CONFIG_TEST_ADC_CH2=y
      - CONFIG_TEST_ADC_CH3=y
      - CONFIG_TEST_ADC_CH4=y
      - CONFIG_TEST_ADC_CH5=y
      - CONFIG_TEST_ADC_CH6=y
      - CONFIG_TEST_ADC_CH7=y

  drivers.adc.adc12.samples8:
    extra_dtc_overlay_files:
      - boards/alif_adc1.overlay
      - boards/alif_adc1_samples8.overlay
    extra_configs:
      - CONFIG_TEST_ADC_CH0=y
      - CONFIG_TEST_ADC_CH1=y
      - CONFIG_TEST_ADC_CH2=y
      - CONFIG_TEST_ADC_CH3=y
      - CONFIG_TEST_ADC_CH4=y
      - CONFIG_TEST_ADC_CH5=y
      - CONFIG_TEST_ADC_CH6=y
      - CONFIG_TEST_ADC_CH7=y

  drivers.adc.adc24.differential:
    extra_dtc_overlay_files:
      - boards/alif_adc24.overlay
    extra_configs:
      - CONFIG_TEST_ADC24=y
      - CONFIG_TEST_ADC_DIFFERENTIAL=y
      - CONFIG_TEST_ADC_CH0=y
      - CONFIG_TEST_ADC_CH1=y
      - CONFIG_TEST_ADC_CH2=y
      - CONFIG_TEST_ADC_CH3=y

  # No CONFIG_TEST_ADC_CH<N>: builds the ADC24 channel 4-7 differential
  # error-scenario tests, which expect adc_channel_setup() to fail.
  drivers.adc.adc24.differential_invalid_channel:
    extra_dtc_overlay_files:
      - boards/alif_adc24.overlay
    extra_configs:
      - CONFIG_TEST_ADC24=y
      - CONFIG_TEST_ADC_DIFFERENTIAL=y

  drivers.adc.adc24.continuous:
    extra_dtc_overlay_files:
      - boards/alif_adc24.overlay
      - boards/alif_adc24_continuous.overlay
    extra_configs:
      - CONFIG_TEST_ADC24=y
      - CONFIG_TEST_ADC_DIFFERENTIAL=y
      - CONFIG_TEST_ADC_CONTINUOUS=y

  drivers.adc.adc24.multich:
    extra_dtc_overlay_files:
      - boards/alif_adc24.overlay
      - boards/alif_adc24_multich.overlay
    extra_configs:
      - CONFIG_TEST_ADC24=y
      - CONFIG_TEST_ADC_DIFFERENTIAL=y
      - CONFIG_TEST_ADC_MULTICH=y
```

## tests/drivers/cmp/testcase.yaml
```yaml
common:
  tags: drivers cmp
  depends_on: cmp
  harness: ztest
  platform_allow:
    - alif_e7_dk/ae722f80f55d5xx/rtss_he
    - alif_e7_dk/ae722f80f55d5xx/rtss_hp
    - alif_e8_dk/ae822fa0e5597xx0/rtss_he
    - alif_e8_dk/ae822fa0e5597xx0/rtss_hp
  integration_platforms:
    - alif_e8_dk/ae822fa0e5597xx0/rtss_he
tests:
  drivers.cmp:
    extra_dtc_overlay_files:
      - boards/alif_cmp1.overlay
  drivers.cmp.lpcmp:
    extra_dtc_overlay_files:
      - boards/alif_lpcmp.overlay
  drivers.cmp.lpcmp.ref_ext:
    extra_dtc_overlay_files:
      - boards/alif_lpcmp.overlay
      - boards/alif_lpcmp_ref_ext.overlay
  drivers.cmp.lpcmp.hys6:
    extra_dtc_overlay_files:
      - boards/alif_lpcmp.overlay
      - boards/alif_lpcmp_hys6.overlay
  drivers.cmp.lpcmp.hys12:
    extra_dtc_overlay_files:
      - boards/alif_lpcmp.overlay
      - boards/alif_lpcmp_hys12.overlay
  drivers.cmp.lpcmp.hys18:
    extra_dtc_overlay_files:
      - boards/alif_lpcmp.overlay
      - boards/alif_lpcmp_hys18.overlay
  drivers.cmp.lpcmp.hys24:
    extra_dtc_overlay_files:
      - boards/alif_lpcmp.overlay
      - boards/alif_lpcmp_hys24.overlay
  drivers.cmp.lpcmp.hys30:
    extra_dtc_overlay_files:
      - boards/alif_lpcmp.overlay
      - boards/alif_lpcmp_hys30.overlay
  drivers.cmp.lpcmp.hys36:
    extra_dtc_overlay_files:
      - boards/alif_lpcmp.overlay
      - boards/alif_lpcmp_hys36.overlay
```

## tests/drivers/dave2d/testcase.yaml
```yaml
common:
  tags:
    - drivers
    - dave2d
    - gpu2d
  harness: ztest
  platform_allow:
    - alif_e8_dk/ae822fa0e5597xx0/rtss_hp
    - alif_e8_dk/ae822fa0e5597xx0/rtss_he
  integration_platforms:
    - alif_e8_dk/ae822fa0e5597xx0/rtss_hp

tests:
  drivers.dave2d.primitives:
    filter: dt_compat_enabled("tes,dave2d")
```

## tests/drivers/display/testcase.yaml
```yaml
common:
  tags:
    - drivers
    - display
  depends_on: display
  harness: ztest
  harness_config:
    fixture: fixture_display
  timeout: 180
  filter: dt_compat_enabled("tes,cdc-2.1")
  platform_allow:
    - alif_e8_dk/ae822fa0e5597xx0/rtss_hp
    - alif_e8_dk/ae822fa0e5597xx0/rtss_he
    - alif_e7_dk/ae722f80f55d5xx/rtss_hp
    - alif_e7_dk/ae722f80f55d5xx/rtss_he
    - alif_e1c_dk/ae1c1f4051920hh/rtss_he
    - alif_b1_dk/ab1c1f4m51820ph0/rtss_he
  integration_platforms:
    - alif_e8_dk/ae822fa0e5597xx0/rtss_hp

tests:
  # Parallel RGB on all CDC200 targets. App boards/<board>.overlay applies
  # automatically when present (B1 panel timing, E1C console UART).
  drivers.display.cdc200: {}

  # MW405 / ILI9806E 2-lane MIPI-DSI (E7/E8 DK).
  drivers.display.cdc200.mipi_2lane:
    extra_dtc_overlay_files:
      - boards/serial_display_2lane.overlay
    extra_conf_files:
      - boards/serial_display.conf
    platform_allow:
      - alif_e8_dk/ae822fa0e5597xx0/rtss_hp
      - alif_e8_dk/ae822fa0e5597xx0/rtss_he
      - alif_e7_dk/ae722f80f55d5xx/rtss_hp
      - alif_e7_dk/ae722f80f55d5xx/rtss_he
    integration_platforms:
      - alif_e8_dk/ae822fa0e5597xx0/rtss_hp

  # ILI9488 1-lane MIPI-DSI (E1C / B1 DK).
  drivers.display.cdc200.mipi_1lane:
    extra_dtc_overlay_files:
      - boards/serial_display_1lane.overlay
    extra_conf_files:
      - boards/serial_display.conf
    platform_allow:
      - alif_e1c_dk/ae1c1f4051920hh/rtss_he
      - alif_b1_dk/ab1c1f4m51820ph0/rtss_he
    integration_platforms:
      - alif_e1c_dk/ae1c1f4051920hh/rtss_he
```
