## tests/drivers/flash/psram/testcase.yaml
```yaml
common:
  tags:
    - drivers
    - memc
    - psram
    - hyperram
  harness: ztest
  timeout: 180
  # Overlays are per scenario. Twister appends common extra_dtc_overlay_files
  # onto each test, so the APS and S80KS bases must not share this section.
  filter: dt_alias_exists("spi_psram")

tests:
  # APS512XXN. CONFIG_TEST_PSRAM is the Kconfig default.
  drivers.psram.xip:
    extra_dtc_overlay_files:
      - boards/alif_psram.overlay
    platform_allow:
      - alif_e8_dk/ae822fa0e5597xx0/rtss_he
      - alif_e8_dk/ae822fa0e5597xx0/rtss_hp
      - alif_e8_ak/ae822fa0e5597xx0/rtss_he
      - alif_e8_ak/ae822fa0e5597xx0/rtss_hp
    integration_platforms:
      - alif_e8_ak/ae822fa0e5597xx0/rtss_he

  # Timing overlays only change bus-speed / latency-code. They must be
  # appended (extra_dtc_overlay_files), not passed as DTC_OVERLAY_FILE,
  # which would replace alif_psram.overlay and drop pins + XIP window.
  drivers.psram.xip.overlay_50mhz:
    extra_dtc_overlay_files:
      - boards/alif_psram.overlay
      - boards/psram_50Mhz.overlay
    platform_allow:
      - alif_e8_dk/ae822fa0e5597xx0/rtss_he
      - alif_e8_dk/ae822fa0e5597xx0/rtss_hp
      - alif_e8_ak/ae822fa0e5597xx0/rtss_he
      - alif_e8_ak/ae822fa0e5597xx0/rtss_hp

  drivers.psram.xip.overlay_100mhz:
    extra_dtc_overlay_files:
      - boards/alif_psram.overlay
      - boards/psram_100Mhz.overlay
    platform_allow:
      - alif_e8_dk/ae822fa0e5597xx0/rtss_he
      - alif_e8_dk/ae822fa0e5597xx0/rtss_hp
      - alif_e8_ak/ae822fa0e5597xx0/rtss_he
      - alif_e8_ak/ae822fa0e5597xx0/rtss_hp

  # 200 MHz needs a 400 MHz OSPI input clock (E7/E8). Balletto is 160 MHz.
  drivers.psram.xip.overlay_200mhz:
    extra_dtc_overlay_files:
      - boards/alif_psram.overlay
      - boards/psram_200Mhz.overlay
    platform_allow:
      - alif_e8_dk/ae822fa0e5597xx0/rtss_he
      - alif_e8_dk/ae822fa0e5597xx0/rtss_hp
      - alif_e8_ak/ae822fa0e5597xx0/rtss_he
      - alif_e8_ak/ae822fa0e5597xx0/rtss_hp

  drivers.psram.xip.full_chip:
    extra_configs:
      - CONFIG_TEST_PSRAM_FULL_CHIP=y
    extra_dtc_overlay_files:
      - boards/alif_psram.overlay
    platform_allow:
      - alif_e8_dk/ae822fa0e5597xx0/rtss_he
      - alif_e8_dk/ae822fa0e5597xx0/rtss_hp
      - alif_e8_ak/ae822fa0e5597xx0/rtss_he
      - alif_e8_ak/ae822fa0e5597xx0/rtss_hp
    timeout: 1800

  # S80KS2564 on OSPI1. Do not also apply alif_psram.overlay.
  drivers.hyperram.xip:
    extra_configs:
      - CONFIG_TEST_HYPERRAM=y
    extra_dtc_overlay_files:
      - boards/alif_hex_s80ks.overlay
    platform_allow:
      - alif_e8_dk/ae822fa0e5597xx0/rtss_he
      - alif_e8_dk/ae822fa0e5597xx0/rtss_hp
    integration_platforms:
      - alif_e8_dk/ae822fa0e5597xx0/rtss_hp

  # LC4 valid to 104 MHz.
  drivers.hyperram.xip.100mhz_lc4:
    extra_configs:
      - CONFIG_TEST_HYPERRAM=y
    extra_dtc_overlay_files:
      - boards/alif_hex_s80ks.overlay
      - boards/hyperram_100mhz.overlay
    platform_allow:
      - alif_e8_dk/ae822fa0e5597xx0/rtss_he
      - alif_e8_dk/ae822fa0e5597xx0/rtss_hp

  # 200 MHz requires LC7.
  drivers.hyperram.xip.200mhz_lc7:
    extra_configs:
      - CONFIG_TEST_HYPERRAM=y
    extra_dtc_overlay_files:
      - boards/alif_hex_s80ks.overlay
      - boards/hyperram_200mhz.overlay
    platform_allow:
      - alif_e8_dk/ae822fa0e5597xx0/rtss_he
      - alif_e8_dk/ae822fa0e5597xx0/rtss_hp

  drivers.hyperram.xip.full_chip:
    extra_configs:
      - CONFIG_TEST_HYPERRAM=y
      - CONFIG_TEST_HYPERRAM_FULL_CHIP=y
    extra_dtc_overlay_files:
      - boards/alif_hex_s80ks.overlay
    platform_allow:
      - alif_e8_dk/ae822fa0e5597xx0/rtss_he
      - alif_e8_dk/ae822fa0e5597xx0/rtss_hp
    timeout: 1800
```

## tests/drivers/gt911/testcase.yaml
```yaml
tests:
  drivers.gt911:
    tags: drivers input gt911
    depends_on: i2c
    min_ram: 16
    timeout: 60
    harness: ztest
    extra_args: SNIPPET=alif-gt911
    extra_configs:
      - CONFIG_TEST_GT911_INTERACTIVE=n
    platform_allow:
      - alif_b1_dk/ab1c1f4m51820ph0/rtss_he
      - alif_e1c_dk/ae1c1f4051920hh/rtss_he
      - alif_e8_dk/ae822fa0e5597xx0/rtss_he
      - alif_e8_dk/ae822fa0e5597xx0/rtss_hp
      - alif_e7_dk/ae722f80f55d5xx/rtss_he
      - alif_e7_dk/ae722f80f55d5xx/rtss_hp
    integration_platforms:
      - alif_b1_dk/ab1c1f4m51820ph0/rtss_he
      - alif_e1c_dk/ae1c1f4051920hh/rtss_he
      - alif_e8_dk/ae822fa0e5597xx0/rtss_he
      - alif_e8_dk/ae822fa0e5597xx0/rtss_hp
      - alif_e7_dk/ae722f80f55d5xx/rtss_he
      - alif_e7_dk/ae722f80f55d5xx/rtss_hp
  drivers.gt911.interactive:
    tags: drivers input gt911
    depends_on: i2c
    min_ram: 16
    timeout: 600
    harness: ztest
    extra_args: SNIPPET=alif-gt911
    extra_configs:
      - CONFIG_TEST_GT911_INTERACTIVE=y
    platform_allow:
      - alif_b1_dk/ab1c1f4m51820ph0/rtss_he
      - alif_e1c_dk/ae1c1f4051920hh/rtss_he
      - alif_e8_dk/ae822fa0e5597xx0/rtss_he
      - alif_e8_dk/ae822fa0e5597xx0/rtss_hp
      - alif_e7_dk/ae722f80f55d5xx/rtss_he
      - alif_e7_dk/ae722f80f55d5xx/rtss_hp
    integration_platforms:
      - alif_b1_dk/ab1c1f4m51820ph0/rtss_he
      - alif_e1c_dk/ae1c1f4051920hh/rtss_he
      - alif_e8_dk/ae822fa0e5597xx0/rtss_he
      - alif_e8_dk/ae822fa0e5597xx0/rtss_hp
      - alif_e7_dk/ae722f80f55d5xx/rtss_he
      - alif_e7_dk/ae722f80f55d5xx/rtss_hp
  drivers.gt911.poll:
    tags: drivers input gt911
    depends_on: i2c
    min_ram: 16
    timeout: 60
    harness: ztest
    extra_args: SNIPPET=alif-gt911
    extra_configs:
      - CONFIG_INPUT_GT911_INTERRUPT=n
      - CONFIG_TEST_GT911_INTERACTIVE=n
    platform_allow:
      - alif_b1_dk/ab1c1f4m51820ph0/rtss_he
      - alif_e1c_dk/ae1c1f4051920hh/rtss_he
      - alif_e8_dk/ae822fa0e5597xx0/rtss_he
      - alif_e8_dk/ae822fa0e5597xx0/rtss_hp
      - alif_e7_dk/ae722f80f55d5xx/rtss_he
      - alif_e7_dk/ae722f80f55d5xx/rtss_hp
    integration_platforms:
      - alif_b1_dk/ab1c1f4m51820ph0/rtss_he
      - alif_e1c_dk/ae1c1f4051920hh/rtss_he
      - alif_e8_dk/ae822fa0e5597xx0/rtss_he
      - alif_e8_dk/ae822fa0e5597xx0/rtss_hp
      - alif_e7_dk/ae722f80f55d5xx/rtss_he
      - alif_e7_dk/ae722f80f55d5xx/rtss_hp
```

## tests/drivers/i3c_controller_target/Kconfig.role
```kconfig
# Copyright Alif Semiconductor - All Rights Reserved.
# SPDX-License-Identifier: Apache-2.0

choice I3C_TEST_ROLE
	prompt "I3C test role"
	default I3C_TEST_CONTROLLER

config I3C_TEST_CONTROLLER
	bool "Build the controller image"

config I3C_TEST_TARGET
	bool "Build the target image"

endchoice

config I3C_TEST_STRESS_LOOPS
	int "Controller stress iterations"
	default 10
	range 1 100
	help
	  Number of echo, IBI, and mixed iterations in the controller stress test.

config I3C_TEST_BULK_BYTES
	int "Bytes transferred by the bulk throughput test"
	default 4096
	range 256 1048576

config I3C_TEST_BULK_CHUNK
	int "Bulk transfer payload per transaction"
	default 32
	range 1 248
	help
	  Keep this within the smaller controller/target receive FIFO until
	  threshold streaming has been validated on the selected instance.

config I3C_TEST_ENABLE_HDR
	bool "Run the controller HDR-DDR transfer test"
	default y

config I3C_TEST_HANDOFF
	bool "Run capability-gated controller-role handoff tests"
	default y

config I3C_TEST_DISCOVER_WAIT_MS
	int "Time to wait for the target hot-join"
	default 20000
	help
	  Controller image: wait until the target raises hot-join and GETPID
	  matches the test PID. The target image raises hot-join from its peer
	  session.
```
