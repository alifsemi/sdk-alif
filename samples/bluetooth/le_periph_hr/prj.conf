## CMakeLists.txt
```
# Copyright (C) 2024 Alif Semiconductor - All Rights Reserved.
# Use, distribution and modification of this code is permitted under the
# terms stated in the Alif Semiconductor Software License Agreement
#
# You should have received a copy of the Alif Semiconductor Software
# License Agreement with this file. If not, please write to:
# contact@alifsemi.com, or visit: https://alifsemi.com/license

cmake_minimum_required(VERSION 3.20.0)

# Include BLE Power Management snippet by default
if(NOT pm-ble IN_LIST SNIPPET)
  set(SNIPPET pm-ble ${SNIPPET} CACHE STRING "" FORCE)
endif()

find_package(Zephyr REQUIRED HINTS $ENV{ZEPHYR_BASE})
project(le_periph_hr)

target_sources(app PRIVATE
    src/main.c
)
```

## sample.yaml
```
sample:
  name: LE Periph HR
tests:
  sample.bt_custom.le_periph_hr:
    build_only: true
    tags:
      - bluetooth
      - bt_custom
```

## prj.conf
```kconfig
CONFIG_USE_SEGGER_RTT=y
CONFIG_RTT_CONSOLE=y
CONFIG_BT=y
CONFIG_BT_CUSTOM=y

CONFIG_LOG=y
CONFIG_ASSERT=y

# Bluetooth Low Energy device name
CONFIG_BLE_DEVICE_NAME="ALIF_HR"
```

## src/main.c
```c
/* Copyright (C) 2024 Alif Semiconductor - All Rights Reserved.
 * Use, distribution and modification of this code is permitted under the
 * terms stated in the Alif Semiconductor Software License Agreement
 *
 * You should have received a copy of the Alif Semiconductor Software
 * License Agreement with this file. If not, please write to:
 * contact@alifsemi.com, or visit: https://alifsemi.com/license
 */

/*
 * This example will start an instance of a peripheral Heart Rate and send
 * periodic notification updates to the first device that connects to it.
 * Battery and Device Information services are included in the sample.
 */

#include <string.h>
#include <zephyr/kernel.h>
#include <zephyr/logging/log.h>
#include <zephyr/sys/printk.h>
#include <se_service.h>
#include "alif_ble.h"
#include "gapm.h"
#include "gap_le.h"
#include "gapc_le.h"
#include "gapc_sec.h"
#include "gapm_le.h"
#include "gapm_le_adv.h"
#include "co_buf.h"
#include "address_verification.h"

#include "prf.h"
#include "hrp_common.h"
#include "hrps.h"
#include "diss.h"
#include "gatt.h"
#include "batt_svc.h"
#include "shared_control.h"
#include <alif/bluetooth/bt_adv_data.h>
#include <alif/bluetooth/bt_scan_rsp.h>
#include "gapm_api.h"
#include "power_mgr.h"

#define BODY_SENSOR_LOCATION_CHEST 0x01

/* Define advertising address type */
#define SAMPLE_ADDR_TYPE ALIF_STATIC_RAND_ADDR

/* Store and share advertising address type */
static uint8_t adv_type;

struct shared_control ctrl = {false, 0, 0};

enum hrps_feat_bf {
	/* Body Sensor Location Feature Supported */
	HRPS_BODY_SENSOR_LOC_CHAR_SUP_POS = 0,
	HRPS_BODY_SENSOR_LOC_CHAR_SUP_BIT = CO_BIT(HRPS_BODY_SENSOR_LOC_CHAR_SUP_POS),

	/* Energy Expanded Feature Supported */
	HRPS_ENGY_EXP_FEAT_SUP_POS = 1,
	HRPS_ENGY_EXP_FEAT_SUP_BIT = CO_BIT(HRPS_ENGY_EXP_FEAT_SUP_POS),

	/* Heart Rate Measurement Notification Supported */
	HRPS_HR_MEAS_NTF_CFG_POS = 2,
	HRPS_HR_MEAS_NTF_CFG_BIT = CO_BIT(HRPS_HR_MEAS_NTF_CFG_POS),
};

/* Initial dummy value for Heart Rate sensor */
static uint16_t current_value = 70;

/* Variable to check if peer device is ready to receive data"*/
static bool ready_to_send;

K_SEM_DEFINE(conn_sem, 0, 1);

LOG_MODULE_REGISTER(main, LOG_LEVEL_DBG);

/**
 * Bluetooth stack configuration
 */
static gapm_config_t gapm_cfg = {
	.role = GAP_ROLE_LE_PERIPHERAL,
	.pairing_mode = GAPM_PAIRING_DISABLE,
	.privacy_cfg = 0,
	.renew_dur = 1500,
	.private_identity.addr = {0xCA, 0xFE, 0xFB, 0xDE, 0x11, 0x07},
	.irk.key = {0, 0, 0, 0, 0, 0, 0, 0, 0, 0, 0, 0, 0, 0, 0, 0},
	.gap_start_hdl = 0,
	.gatt_start_hdl = 0,
	.att_cfg = 0,
	.sugg_max_tx_octets = GAP_LE_MIN_OCTETS,
	.sugg_max_tx_time = GAP_LE_MIN_TIME,
	.tx_pref_phy = GAP_PHY_ANY,
	.rx_pref_phy = GAP_PHY_ANY,
	.tx_path_comp = 0,
	.rx_path_comp = 0,
	.class_of_device = 0,  /* BT Classic only */
	.dflt_link_policy = 0, /* BT Classic only */
};

const gapc_le_con_param_nego_with_ce_len_t preferred_connection_param = {
	.ce_len_min = 5,
	.ce_len_max = 10,
	.hdr.interval_min = 800,
	.hdr.interval_max = 800,
	.hdr.latency = 0,
	.hdr.sup_to = 800};

/* Load name from configuration file */
#define DEVICE_NAME CONFIG_BLE_DEVICE_NAME

/* Store advertising activity index for re-starting after disconnection */
static uint8_t adv_actv_idx;

/* Connection index awaiting a parameter update, and remaining retry attempts */
static uint8_t conn_param_conidx;
static uint8_t conn_param_retries;

#define CONN_PARAM_UPDATE_DELAY K_MSEC(500)
#define CONN_PARAM_UPDATE_MAX_RETRIES 3

static void conn_param_update_work_handler(struct k_work *work);
static K_WORK_DELAYABLE_DEFINE(conn_param_update_work, conn_param_update_work_handler);

/* HRPS callbacks */

static void on_hrps_meas_send_complete(uint16_t status)
{
	ready_to_send = true;
}

static void on_bond_data_upd(uint8_t conidx, uint16_t cfg_val)
{
	switch (cfg_val) {
	case PRF_CLI_STOP_NTFIND: {
		LOG_INF("Client requested stop notification/indication (conidx: %u)", conidx);
		ready_to_send = false;
	} break;

	case PRF_CLI_START_NTF:
	case PRF_CLI_START_IND: {
		LOG_INF("Client requested start notification/indication (conidx: %u)", conidx);
		ready_to_send = true;
		LOG_DBG("Sending measurements");
	}
	}
}

static void on_energy_exp_reset(uint8_t conidx)
{
}

static const hrps_cb_t hrps_cb = {
	.cb_bond_data_upd = on_bond_data_upd,
	.cb_meas_send_cmp = on_hrps_meas_send_complete,
	.cb_energy_exp_reset = on_energy_exp_reset,
};

static uint16_t set_advertising_data(uint8_t actv_idx)
{
	int ret;
	uint16_t svc[3];
	uint16_t comp_id = CONFIG_BLE_COMPANY_ID;

	/* This sample write AD Name, Profile list and Company ID */

	/* Define GATT profiles */
	svc[0] = GATT_SVC_HEART_RATE;
	svc[1] = get_batt_id();
	svc[2] = GATT_SVC_DEVICE_INFO;

	ret = bt_adv_data_set_tlv(GAP_AD_TYPE_COMPLETE_LIST_16_BIT_UUID, svc, sizeof(svc));
	if (ret) {
		LOG_ERR("AD profile set fail %d", ret);
		return ATT_ERR_INSUFF_RESOURCE;
	}

	ret = bt_adv_data_set_manufacturer(comp_id, NULL, 0);

	if (ret) {
		LOG_ERR("AD manufacturer data fail %d", ret);
		return ATT_ERR_INSUFF_RESOURCE;
	}

	ret = bt_adv_data_set_name_auto(DEVICE_NAME, strlen(DEVICE_NAME));

	if (ret) {
		LOG_ERR("AD device name data fail %d", ret);
		return ATT_ERR_INSUFF_RESOURCE;
	}

	return bt_gapm_advertiment_data_set(actv_idx);
}

static uint16_t create_advertising(void)
{
	gapm_le_adv_create_param_t adv_create_params = {
		.prop = GAPM_ADV_PROP_UNDIR_CONN_MASK,
		.disc_mode = GAPM_ADV_MODE_GEN_DISC,
		.tx_pwr = 0,
		.filter_pol = GAPM_ADV_ALLOW_SCAN_ANY_CON_ANY,
		.prim_cfg = {
			.adv_intv_min = 160, /* 100 ms */
			.adv_intv_max = 800, /* 500 ms */
			.ch_map = ADV_ALL_CHNLS_EN,
			.phy = GAPM_PHY_TYPE_LE_1M,
		},
	};

	return bt_gapm_le_create_advertisement_service(adv_type, &adv_create_params, NULL,
						       &adv_actv_idx);
}

/* Add heart rate profile to the stack */
static uint16_t hr_server_configure(void)
{
	uint16_t start_hdl = 0;
	struct hrps_db_cfg hrps_cfg;

	/* Add the heart rate server profile and register our callbacks */
	hrps_cfg.features = HRPS_BODY_SENSOR_LOC_CHAR_SUP_BIT | HRPS_HR_MEAS_NTF_CFG_BIT;
	hrps_cfg.body_sensor_loc = BODY_SENSOR_LOCATION_CHEST;

	return prf_add_profile(TASK_ID_HRPS, 0, 0, &hrps_cfg, &hrps_cb, &start_hdl);
}

static const char dis_manufacturer[] = "Alif Semiconductor";
static char dis_model[sizeof(((get_device_revision_data_t *)0)->ALIF_PN) + 1];
static char dis_serial_num[sizeof(((get_device_revision_data_t *)0)->SerialN) * 2 + 1];
static char dis_fw_rev[VERSION_RESPONSE_LENGTH + 1];

static void copy_se_string(char *dst, size_t dst_len, const volatile uint8_t *src,
			   size_t src_len)
{
	size_t n = MIN(dst_len - 1, src_len);
	size_t i;

	for (i = 0; i < n; i++) {
		uint8_t c = src[i];

		if (c == '\0' || c < 0x20 || c > 0x7e) {
			break;
		}
		dst[i] = (char)c;
	}
	dst[i] = '\0';
}

static void rtrim(char *s)
{
	size_t n = strlen(s);

	while (n > 0 && (s[n - 1] == '\n' || s[n - 1] == '\r' || s[n - 1] == ' ')) {
		s[--n] = '\0';
	}
}

/* Read the part number, serial number and SE firmware banner once. */
static void dis_load_device_info(void)
{
	get_device_revision_data_t data;
	int ret;
	size_t i;

	ret = se_service_system_get_device_data(&data);
	if (ret) {
		LOG_ERR("DIS: device data read failed %d", ret);
	} else {
		copy_se_string(dis_model, sizeof(dis_model), data.ALIF_PN, sizeof(data.ALIF_PN));
		for (i = 0; i < sizeof(data.SerialN); i++) {
			snprintk(&dis_serial_num[i * 2], 3, "%02X", data.SerialN[i]);
		}
	}

	memset(dis_fw_rev, 0, sizeof(dis_fw_rev));
	ret = se_service_get_se_revision((uint8_t *)dis_fw_rev);
	if (ret) {
		LOG_ERR("DIS: SE revision read failed %d", ret);
		dis_fw_rev[0] = '\0';
	} else {
		dis_fw_rev[VERSION_RESPONSE_LENGTH] = '\0';
		rtrim(dis_fw_rev);
	}

	LOG_INF("DIS model '%s' serial '%s' fw '%s'", dis_model, dis_serial_num, dis_fw_rev);
}

static void on_diss_value_req(uint8_t conidx, uint8_t char_type, uint16_t token)
{
	const char *str = NULL;

	switch (char_type) {
	case DISS_CHAR_TYPE_MANUFACTURER_NAME:
		str = dis_manufacturer;
		break;
	case DISS_CHAR_TYPE_MODEL_NUMBER:
		str = dis_model;
		break;
	case DISS_CHAR_TYPE_SERIAL_NUMBER:
		str = dis_serial_num;
		break;
	case DISS_CHAR_TYPE_FW_REVISION:
		str = dis_fw_rev;
		break;
	default:
		break;
	}

	uint16_t len = str ? strlen(str) : 0;
	co_buf_t *p_buf = NULL;

	if (co_buf_alloc(&p_buf, GATT_BUFFER_HEADER_LEN, len, GATT_BUFFER_TAIL_LEN) !=
	    CO_BUF_ERR_NO_ERROR) {
		return;
	}
	if (len) {
		memcpy(co_buf_data(p_buf), str, len);
	}
	diss_value_cfm(conidx, token, p_buf);
	co_buf_release(p_buf);
}

static const diss_cbs_t diss_cbs = {
	.cb_value_req = on_diss_value_req,
};

static uint16_t configure_dis(void)
{
	uint16_t start_hdl = 0;

	dis_load_device_info();
	uint16_t char_type_bf = CO_BIT(DISS_CHAR_TYPE_MANUFACTURER_NAME) |
				CO_BIT(DISS_CHAR_TYPE_MODEL_NUMBER) |
				CO_BIT(DISS_CHAR_TYPE_SERIAL_NUMBER) |
				CO_BIT(DISS_CHAR_TYPE_FW_REVISION);

	return prf_add_profile(TASK_ID_DISS, GAP_SEC_NOT_ENC, 0, &char_type_bf, &diss_cbs,
			       &start_hdl);
}

static void send_measurement(int16_t current_value)
{
	uint16_t err;
	hrs_hr_meas_t hr_meas = {
		.flags = HRS_FLAG_HR_VALUE_FORMAT_POS,
		.heart_rate = current_value,
		.nb_rr_interval = 0,
	};

	/* Set bit field to all 1's to send notification
	 * on all connections that are subscribed
	 */
	uint32_t conidx_bf = UINT32_MAX;
	err = hrps_meas_send(conidx_bf, &hr_meas);

	if (err) {
		LOG_ERR("Error %u sending measurement", err);
	}
}

void read_sensor_value(void)
{
	/* Generating dummy values between 70 and 130 */
	if (current_value >= 130) {
		current_value = 70;
	} else {
		current_value++;
	}
}

void service_process(void)
{
	read_sensor_value();

	if (ctrl.connected) {
		if (ready_to_send) {
			send_measurement(current_value);
			ready_to_send = false;
		}
	} else {
		LOG_DBG("Waiting for peer connection...\n");
		k_sem_take(&conn_sem, K_FOREVER);
	}
}

static void on_gapc_proc_cmp_cb(uint8_t const conidx, uint32_t const metainfo,
				uint16_t const status)
{
	/* The controller can reject the update with a transaction collision (0xBA)
	 * when the peer is running its own LLCP procedure at the same time. Retry.
	 */
	if (status == LL_ERR_DIFF_TRANSACTION_COLLISION && conn_param_retries) {
		conn_param_retries--;
		LOG_WRN("Connection param update collided, retrying (%u left)",
			conn_param_retries);
		k_work_reschedule(&conn_param_update_work, CONN_PARAM_UPDATE_DELAY);
		return;
	}

	if (status) {
		LOG_ERR("GAPC LE connection param update failed %u", status);
	} else {
		LOG_INF("GAPC LE connection param update success");
	}

	ctrl.connected = true;
	k_sem_give(&conn_sem);

	power_mgr_log_flush();
}

static void conn_param_update_work_handler(struct k_work *work)
{
	uint16_t const ret = gapc_le_update_params(conn_param_conidx, 0,
						   &preferred_connection_param,
						   on_gapc_proc_cmp_cb);

	if (ret) {
		LOG_ERR("GAPC LE connection param update start failed %u", ret);
		/* Don’t block forever if the update procedure can’t be started. */
		ctrl.connected = true;
		k_sem_give(&conn_sem);
	}
}

static void app_connected_handle(uint8_t const con_idx)
{
	conn_param_conidx = con_idx;
	conn_param_retries = CONN_PARAM_UPDATE_MAX_RETRIES;

	/* Defer the update so it does not collide with the peer's connection-setup
	 * procedures (e.g. feature exchange) that run right after connection.
	 */
	k_work_reschedule(&conn_param_update_work, CONN_PARAM_UPDATE_DELAY);

	LOG_DBG("Please enable notifications on peer device..");
	power_mgr_log_flush();
}

static void app_connection_status_update(enum gapm_connection_event const con_event,
					 uint8_t const con_idx, uint16_t const status)
{
	switch (con_event) {
	case GAPM_API_SEC_CONNECTED_KNOWN_DEVICE:
		LOG_INF("Connection index %u connected to known device", con_idx);
		app_connected_handle(con_idx);
		break;
	case GAPM_API_DEV_CONNECTED:
		LOG_INF("Connection index %u connected to new device", con_idx);
		app_connected_handle(con_idx);
		break;
	case GAPM_API_DEV_DISCONNECTED:
		LOG_INF("Connection index %u disconnected for reason %u", con_idx, status);
		ctrl.connected = false;
		break;
	case GAPM_API_PAIRING_FAIL:
		LOG_ERR("Connection pairing index %u fail for reason %u", con_idx, status);
		break;
	}
}

static gapm_user_cb_t gapm_user_cb = {
	.connection_status_update = app_connection_status_update,
};

int main(void)
{
	uint16_t err;

	/* Start up bluetooth host stack */
	alif_ble_enable(NULL);

	if (address_verification(SAMPLE_ADDR_TYPE, &adv_type, &gapm_cfg)) {
		LOG_ERR("Address verification failed");
		return -EADV;
	}

	/* Set a preferred connections params  */
	bt_gapm_preferred_connection_paras_set(&preferred_connection_param);

	/* Configure Bluetooth Stack */
	LOG_INF("Init gapm service");
	err = bt_gapm_init(&gapm_cfg, &gapm_user_cb, DEVICE_NAME, strlen(DEVICE_NAME));
	if (err) {
		LOG_ERR("gapm_configure error %u", err);
		return -1;
	}

	/* Share connection info */
	service_conn(&ctrl);

	/* Adding battery service */
	config_battery_service();

	err = configure_dis();
	if (err) {
		LOG_ERR("DIS configuration failed %u", err);
		return -1;
	}

	hr_server_configure();

	err = create_advertising();
	if (err) {
		LOG_ERR("Advertisement create fail %u", err);
		return -1;
	}

	err = set_advertising_data(adv_actv_idx);
	if (err) {
		LOG_ERR("Advertisement data set fail %u", err);
		return -1;
	}

	err = bt_gapm_scan_response_set(adv_actv_idx);
	if (err) {
		LOG_ERR("Scan response set fail %u", err);
		return -1;
	}

	err = bt_gapm_advertisement_start(adv_actv_idx);
	if (err) {
		LOG_ERR("Advertisement start fail %u", err);
		return -1;
	}

	print_device_identity();

	while (1) {
		k_sleep(K_SECONDS(1));
		service_process();
		battery_process();
	}
}
```
