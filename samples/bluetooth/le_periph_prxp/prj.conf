## CMakeLists.txt
```
# Copyright (C) 2024 Alif Semiconductor - All Rights Reserved.
# Use, distribution and modification of this code is permitted under the
# terms stated in the Alif Semiconductor Software License Agreement
#
# You should have received a copy of the Alif Semiconductor Software
# License Agreement with this file. If not, please write to:
# contact@alifsemi.com, or visit: https://alifsemi.com/license

cmake_minimum_required(VERSION 3.20.0)

# Include BLE Power Management snippet by default
if(NOT pm-ble IN_LIST SNIPPET)
  set(SNIPPET pm-ble ${SNIPPET} CACHE STRING "" FORCE)
endif()

find_package(Zephyr REQUIRED HINTS $ENV{ZEPHYR_BASE})
project(le_periph_prxp)

# Include directories
target_include_directories(app PRIVATE
	${CMAKE_CURRENT_SOURCE_DIR}/inc
)

target_sources(app PRIVATE
    src/main.c
    src/prxp_rom_1_2.c
)
```

## sample.yaml
```
sample:
  name: LE Periph PRXP
tests:
  sample.bt_custom.le_periph_prxp:
    build_only: true
    tags:
      - bluetooth
      - bt_custom
```

## prj.conf
```kconfig
CONFIG_BT=y
CONFIG_BT_CUSTOM=y
CONFIG_LOG=y
CONFIG_ASSERT=y
CONFIG_ALIF_BLE_HOST_PATCHING=y

# Needed for Zephyr randomizer
CONFIG_ENTROPY_GENERATOR=y
CONFIG_TEST_RANDOM_GENERATOR=y

# Bluetooth Low Energy device name
CONFIG_BLE_DEVICE_NAME="ALIF_PRXP"
```

## src/main.c
```c
/* Copyright (C) 2024 Alif Semiconductor - All Rights Reserved.
 * Use, distribution and modification of this code is permitted under the
 * terms stated in the Alif Semiconductor Software License Agreement
 *
 * You should have received a copy of the Alif Semiconductor Software
 * License Agreement with this file. If not, please write to:
 * contact@alifsemi.com, or visit: https://alifsemi.com/license
 */

/*
 * This example will start an instance of a peripheral Proximity Profile (PRXP)
 * it will notify when the link has been lost with the alert level set from the
 * central device. Includes Battery Service support.
 */

#include <zephyr/kernel.h>
#include <zephyr/logging/log.h>
#include "alif_ble.h"
#include "gapm.h"
#include "gap_le.h"
#include "gapc_le.h"
#include "gapc_sec.h"
#include "gapm_le.h"
#include "gapm_le_adv.h"
#include "co_buf.h"
#include "address_verification.h"
#include <alif/bluetooth/bt_adv_data.h>
#include <alif/bluetooth/bt_scan_rsp.h>
#include "gapm_api.h"

/*  Profiles definitions */
#include "batt_svc.h"
#include "shared_control.h"
#include "prf.h"
#include "bass.h"

#include "prxp_app.h"

/* Define advertising address type */
#define SAMPLE_ADDR_TYPE	ALIF_STATIC_RAND_ADDR

/* Store and share advertising address type */
static uint8_t adv_type;

LOG_MODULE_REGISTER(main, LOG_LEVEL_DBG);

/* Bluetooth stack configuration */
static gapm_config_t gapm_cfg = {
	.role = GAP_ROLE_LE_PERIPHERAL,
	.pairing_mode = GAPM_PAIRING_DISABLE,
	.privacy_cfg = 0,
	.renew_dur = 1500,
	.private_identity.addr = {0, 0, 0, 0, 0, 0},
	.irk.key = {0, 0, 0, 0, 0, 0, 0, 0, 0, 0, 0, 0, 0, 0, 0, 0},
	.gap_start_hdl = 0,
	.gatt_start_hdl = 0,
	.att_cfg = 0,
	.sugg_max_tx_octets = GAP_LE_MIN_OCTETS,
	.sugg_max_tx_time = GAP_LE_MIN_TIME,
	.tx_pref_phy = GAP_PHY_ANY,
	.rx_pref_phy = GAP_PHY_ANY,
	.tx_path_comp = 0,
	.rx_path_comp = 0,
};

static struct shared_control ctrl = {false, 0, 0};

/* Load name from configuration file */
#define DEVICE_NAME CONFIG_BLE_DEVICE_NAME

static uint8_t adv_actv_idx;


/*
 *	Advertising functions
 */

static uint8_t adv_actv_idx;

static uint16_t set_advertising_data(uint8_t actv_idx)
{
	int ret;
	uint16_t svc[2];

	/* gatt service identifier */
	svc[0] = GATT_SVC_LINK_LOSS;
	svc[1] = get_batt_id();

	ret = bt_adv_data_set_tlv(GAP_AD_TYPE_COMPLETE_LIST_16_BIT_UUID, svc, sizeof(svc));
	if (ret) {
		LOG_ERR("AD profile set fail %d", ret);
		return ATT_ERR_INSUFF_RESOURCE;
	}

	ret = bt_adv_data_set_name_auto(DEVICE_NAME, strlen(DEVICE_NAME));

	if (ret) {
		LOG_ERR("AD device name data fail %d", ret);
		return ATT_ERR_INSUFF_RESOURCE;
	}

	return bt_gapm_advertiment_data_set(actv_idx);
}

uint16_t create_advertising(void)
{
	gapm_le_adv_create_param_t adv_create_params = {
		.prop = GAPM_ADV_PROP_UNDIR_CONN_MASK,
		.disc_mode = GAPM_ADV_MODE_GEN_DISC,
		.filter_pol = GAPM_ADV_ALLOW_SCAN_ANY_CON_ANY,
		.tx_pwr = 0,
		.prim_cfg = {
				.adv_intv_min = 160, /* 100 ms */
				.adv_intv_max = 800, /* 500 ms */
				.ch_map = ADV_ALL_CHNLS_EN,
				.phy = GAPM_PHY_TYPE_LE_1M,
			},
	};

	return bt_gapm_le_create_advertisement_service(adv_type, &adv_create_params, NULL,
						      &adv_actv_idx);
}

void app_connection_status_update(enum gapm_connection_event con_event, uint8_t con_idx,
				  uint16_t status)
{
	switch (con_event) {
	case GAPM_API_SEC_CONNECTED_KNOWN_DEVICE:
		ctrl.connected = true;
		LOG_INF("Connection index %u connected to known device", con_idx);
		LOG_DBG("Please enable notifications on peer device..");
		break;
	case GAPM_API_DEV_CONNECTED:
		ctrl.connected = true;
		LOG_INF("Connection index %u connected to new device", con_idx);
		LOG_DBG("Please enable notifications on peer device..");
		break;
	case GAPM_API_DEV_DISCONNECTED:
		LOG_INF("Connection index %u disconnected for reason %u", con_idx, status);
		disc_notify(status);
		/* Update shared control */
		ctrl.connected = false;
		break;
	case GAPM_API_PAIRING_FAIL:
		LOG_INF("Connection pairing index %u fail for reason %u", con_idx, status);
		break;
	}
}

static gapm_user_cb_t gapm_user_cb = {
	.connection_status_update = app_connection_status_update,
};

int main(void)
{
	uint16_t err;

	/* Start up bluetooth host stack */
	alif_ble_enable(NULL);

	if (address_verification(SAMPLE_ADDR_TYPE, &adv_type, &gapm_cfg)) {
		LOG_ERR("Address verification failed");
		return -EADV;
	}

	/* Configure Bluetooth Stack */
	LOG_INF("Init gapm service");
	err = bt_gapm_init(&gapm_cfg, &gapm_user_cb, DEVICE_NAME, strlen(DEVICE_NAME));
	if (err) {
		LOG_ERR("gapm_configure error %u", err);
		return -1;
	}

	/* Share control structure */
	service_conn(&ctrl);

	/* Adding battery service */
	config_battery_service();

	server_configure();

	/* Create an advertising activity */
	err = create_advertising();
	if (err) {
		LOG_ERR("Advertisement create fail %u", err);
		return -1;
	}

	err = set_advertising_data(adv_actv_idx);
	if (err) {
		LOG_ERR("Advertisement data set fail %u", err);
		return -1;
	}

	err = bt_gapm_scan_response_set(adv_actv_idx);
	if (err) {
		LOG_ERR("Scan response set fail %u", err);
		return -1;
	}

	err = bt_gapm_advertisement_start(adv_actv_idx);
	if (err) {
		LOG_ERR("Advertisement start fail %u", err);
		return -1;
	}

	print_device_identity();

	while (1) {
		k_sleep(K_SECONDS(2));
		battery_process();
		ias_process();
	}
	return -EINVAL;
}
```

## inc/prxp_app.h
```c
/* Copyright (C) 2025 Alif Semiconductor - All Rights Reserved.
 * Use, distribution and modification of this code is permitted under the
 * terms stated in the Alif Semiconductor Software License Agreement
 *
 * You should have received a copy of the Alif Semiconductor Software
 * License Agreement with this file. If not, please write to:
 * contact@alifsemi.com, or visit: https://alifsemi.com/license
 */

#ifndef PRXP_APP_H
#define PRXP_APP_H

extern bool config_ready;
void server_configure(void);
void get_tx_power(void);
void ias_process(void);
void tx_power_read(void);
void disc_notify(uint16_t reason);
gapm_callbacks_t append_cbs(gapm_callbacks_t *gapm_append_cbs);

#endif /* PRXP_APP_H */
```

## src/prxp_rom_1_0.c
```c
/* Copyright (C) 2025 Alif Semiconductor - All Rights Reserved.
 * Use, distribution and modification of this code is permitted under the
 * terms stated in the Alif Semiconductor Software License Agreement
 *
 * You should have received a copy of the Alif Semiconductor Software
 * License Agreement with this file. If not, please write to:
 * contact@alifsemi.com, or visit: https://alifsemi.com/license
 */

#include <zephyr/kernel.h>
#include <zephyr/logging/log.h>
#include "alif_ble.h"
#include "gapm_le_adv.h"
#include "co_buf.h"
#include "shared_control.h"

/*  Profiles definitions */
#include "prf.h"
#include "proxr.h"
#include "proxr_msg.h"
#include "prxp_app.h"

LOG_MODULE_REGISTER(prxp_rom_1_0, LOG_LEVEL_DBG);

void ll_notify(void);
void ias_reset(void);

static uint8_t ll_level;
static uint8_t iass_level;

/* profile callbacks */
static void on_alert_upd(uint8_t conidx, uint8_t char_code, uint8_t alert_lvl)
{
	LOG_WRN("ALERT UPDATE");
	switch (char_code) {
	case PROXR_ERR_CHAR:
		LOG_DBG("PROXR_ERR_CHAR");
		break;
	case PROXR_LLS_CHAR:
		LOG_DBG("PROXR_LLS_CHAR");
		break;
	case PROXR_IAS_CHAR:
		LOG_DBG("PROXR_IAS_CHAR");
		break;
	default:
		LOG_DBG("alert char_code %02x", char_code);
		break;
	}

	switch (alert_lvl) {
	case PROXR_ALERT_NONE:
		LOG_DBG("PROXR_ALERT_NONE");
		break;
	case PROXR_ALERT_MILD:
		LOG_DBG("PROXR_ALERT_MILD");
		break;
	case PROXR_ALERT_HIGH:
		LOG_DBG("PROXR_ALERT_HIGH");
		break;
	default:
		LOG_DBG("alert level value %02x", alert_lvl);
		break;
	}

	if (char_code == PROXR_IAS_CHAR) {
		iass_level = alert_lvl;
	}
}

static const proxr_cb_t proxr_cb = {
	.cb_alert_upd = on_alert_upd,
};

/* Add profile to the stack */
void server_configure(void)
{
	uint16_t err;

	/* Dynamic allocation of service start handle*/
	uint16_t start_hdl = 0;

	/* Database configuration structure */
	struct proxr_db_cfg proxr_cfg = {
		.features = PROXR_IAS_TXPS_NOT_SUP,
	};
	err = prf_add_profile(TASK_ID_PROXR, 0, 0, &proxr_cfg, &proxr_cb, &start_hdl);

	if (err) {
		LOG_ERR("Error %u adding profile", err);
	}
}

void ll_notify(void)
{
	if (ll_level != PROXR_ALERT_NONE) {
		LOG_WRN("Link lost alert with level 0x%02x", ll_level);
		ll_level = PROXR_ALERT_NONE;
	}
}

void ias_reset(void)
{
	iass_level = PROXR_ALERT_NONE;
}

void disc_notify(uint16_t reason)
{
	if (reason != LL_ERR_REMOTE_USER_TERM_CON) {
		ll_notify();
	}
	ias_reset();
}

static void on_gapm_err(enum co_error err)
{
	LOG_ERR("gapm error %d", err);
}

static const gapm_err_info_config_cb_t gapm_err_cbs = {
	.ctrl_hw_error = on_gapm_err,
};

gapm_callbacks_t append_cbs(gapm_callbacks_t *gapm_append_cbs)
{
	gapm_callbacks_t cbs = *gapm_append_cbs;

	cbs.p_err_info_config_cbs = &gapm_err_cbs;

	return cbs;
}

void tx_power_read(void)
{
	/* No need to implement, required for newer BLE ROM versions */
}

void ias_process(void)
{
	/* IAS alert shall continue until disconnection or set to None*/
	if (iass_level == PROXR_ALERT_MILD) {
		LOG_WRN("IAS mild alert");
	} else if (iass_level == PROXR_ALERT_HIGH) {
		LOG_WRN("IAS high alert");
	}
}

gapm_le_adv_create_param_t append_adv_param(gapm_le_adv_create_param_t *adv_append_params)
{
	int8_t tx_pwr_param = 0;

	gapm_le_adv_create_param_t adv_params = *adv_append_params;

	adv_params.max_tx_pwr = tx_pwr_param;
	return adv_params;
}
```

## src/prxp_rom_1_2.c
```c
/* Copyright (C) 2025 Alif Semiconductor - All Rights Reserved.
 * Use, distribution and modification of this code is permitted under the
 * terms stated in the Alif Semiconductor Software License Agreement
 *
 * You should have received a copy of the Alif Semiconductor Software
 * License Agreement with this file. If not, please write to:
 * contact@alifsemi.com, or visit: https://alifsemi.com/license
 */

#include <zephyr/kernel.h>
#include <zephyr/logging/log.h>
#include "alif_ble.h"
#include "gapm_le_adv.h"
#include "co_buf.h"
#include "shared_control.h"

/*  Profiles definitions */
#include "llss.h"
#include "iass.h"
#include "tpss.h"
#include "prxp_app.h"

LOG_MODULE_REGISTER(prxp, LOG_LEVEL_DBG);

void ll_notify(void);
void ias_reset(void);
static bool tx_read_cmp;

/* profile callbacks */
static uint8_t ll_level;
static uint8_t iass_level;
static int8_t tx_pwr_lvl;

void ll_notify(void)
{
	if (ll_level != LLS_ALERT_LEVEL_NONE) {
		LOG_WRN("Link lost alert with level 0x%02x", ll_level);
		ll_level = LLS_ALERT_LEVEL_NONE;
	}
}

void ias_reset(void)
{
	iass_level = IAS_ALERT_LEVEL_NONE;
}

static void on_get_level_req(uint8_t conidx, uint16_t token)
{
	co_buf_t *p_buf;

	prf_buf_alloc(&p_buf, LLS_ALERT_LEVEL_SIZE);
	*co_buf_data(p_buf) = ll_level;
	llss_get_level_cfm(conidx, token, p_buf);
	co_buf_release(p_buf);

	LOG_DBG("Level requested");
}

static void on_set_level_req(uint8_t conidx, uint16_t token, co_buf_t *p_buf)
{
	uint8_t level = *co_buf_data(p_buf);
	uint16_t status;

	if (level < LLS_ALERT_LEVEL_MAX) {
		ll_level = level;
		status = GAP_ERR_NO_ERROR;
		LOG_INF("Set level requested: %d", level);
	} else {
		status = ATT_ERR_VALUE_NOT_ALLOWED;
	}

	llss_set_level_cfm(conidx, status, token);
}

static const llss_cbs_t llss_cb = {
	.cb_get_level_req = on_get_level_req,
	.cb_set_level_req = on_set_level_req,
};

static void on_level(uint8_t conidx, co_buf_t *p_buf)
{
	uint8_t level = *co_buf_data(p_buf);

	if (level < IAS_ALERT_LEVEL_MAX) {
		iass_level = level;
	} else {
		LOG_ERR("Invalid Immediate Alert Level");
	}
}

static const iass_cbs_t iass_cb = {
	.cb_level = on_level,
};

uint16_t temp_token;

static void cmp_cb(uint8_t conidx, uint32_t metainfo, uint16_t status, uint8_t phy,
		   int8_t power_level, int8_t max_power_level)
{
	tx_pwr_lvl = power_level;
	tx_read_cmp = true;
	co_buf_t *p_buf;

	prf_buf_alloc(&p_buf, TPS_LEVEL_SIZE);
	*co_buf_data(p_buf) = (uint8_t)tx_pwr_lvl;
	tpss_level_cfm(conidx, temp_token, p_buf);
	co_buf_release(p_buf);
	/* Show Tx Power value in signed integer format */
	LOG_INF("Tx Power level 1M PHY sent:: %" PRId8 "\n", tx_pwr_lvl);
	temp_token = 0;
}

static void on_level_req(uint8_t conidx, uint16_t token)
{
	temp_token = token;
	gapc_le_get_local_tx_power_level(conidx, 0, GAPC_PHY_PWR_1MBPS_VALUE, cmp_cb);
}

static const tpss_cbs_t tpss_cb = {
	.cb_level_req = on_level_req,
};

/* Add profile to the stack */
void server_configure(void)
{
	uint16_t err;

	/* Dynamic allocation of service start handle*/
	uint16_t start_hdl = 0;

	alif_ble_mutex_lock(K_FOREVER);
	err = prf_add_profile(TASK_ID_LLSS, 0, 0, NULL, &llss_cb, &start_hdl);
	alif_ble_mutex_unlock();

	alif_ble_mutex_lock(K_FOREVER);
	err = prf_add_profile(TASK_ID_IASS, 0, 0, NULL, &iass_cb, &start_hdl);
	alif_ble_mutex_unlock();

	alif_ble_mutex_lock(K_FOREVER);
	err = prf_add_profile(TASK_ID_TPSS, 0, 0, NULL, &tpss_cb, &start_hdl);
	alif_ble_mutex_unlock();

	if (err) {
		LOG_ERR("Error %u adding profile", err);
	}
}

void ias_process(void)
{
	/* IAS alert shall continue until disconnection or set to None*/
	if (iass_level == IAS_ALERT_LEVEL_MILD) {
		LOG_WRN("IAS mild alert");
	} else if (iass_level == IAS_ALERT_LEVEL_HIGH) {
		LOG_WRN("IAS high alert");
	}
}

void disc_notify(uint16_t reason)
{
	if (reason != LL_ERR_REMOTE_USER_TERM_CON) {
		ll_notify();
	}
	ias_reset();
}
```
