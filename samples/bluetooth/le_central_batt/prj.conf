## CMakeLists.txt
```
# Copyright (C) 2025 Alif Semiconductor - All Rights Reserved.
# Use, distribution and modification of this code is permitted under the
# terms stated in the Alif Semiconductor Software License Agreement
#
# You should have received a copy of the Alif Semiconductor Software
# License Agreement with this file. If not, please write to:
# contact@alifsemi.com, or visit: https://alifsemi.com/license

cmake_minimum_required(VERSION 3.20.0)
find_package(Zephyr REQUIRED HINTS $ENV{ZEPHYR_BASE})
project(le_central_batt)

target_sources(app PRIVATE
	src/main.c
)
```

## sample.yaml
```
sample:
  name: LE Central Batt
tests:
  sample.bt_custom.le_central_batt:
    build_only: true
    tags:
      - bluetooth
      - bt_custom
```

## prj.conf
```kconfig
CONFIG_USE_SEGGER_RTT=y
CONFIG_RTT_CONSOLE=y
CONFIG_BT=y
CONFIG_BT_CUSTOM=y

CONFIG_LOG=y
CONFIG_ASSERT=y

CONFIG_ENTROPY_GENERATOR=y
CONFIG_TEST_RANDOM_GENERATOR=y

# Bluetooth Low Energy device name
CONFIG_BLE_DEVICE_NAME="ALIF_BATT_CTRL"

CONFIG_LOG_MODE_MINIMAL=y
```

## src/main.c
```c
/* Copyright (C) 2025 Alif Semiconductor - All Rights Reserved.
 * Use, distribution and modification of this code is permitted under the
 * terms stated in the Alif Semiconductor Software License Agreement
 *
 * You should have received a copy of the Alif Semiconductor Software
 * License Agreement with this file. If not, please write to:
 * contact@alifsemi.com, or visit: https://alifsemi.com/license
 */

#include <zephyr/kernel.h>
#include <zephyr/logging/log.h>
#include "alif_ble.h"
#include "batt_cli.h"
#include "central_itf.h"

static const char le_periph_device_name[]  = "ALIF_BATT_BLE";
LOG_MODULE_REGISTER(main, LOG_LEVEL_DBG);

int main(void)
{
	uint16_t err;

	/* init BLE */
	alif_ble_enable(NULL);

	/* Register peer device name to scan for */
	central_itf_reg_peer_name(le_periph_device_name);

	/* Configure device */
	err = central_itf_gapm_cfg(battery_client_process);
	if (err) {
		return -1;
	}

	/* Add profile to BLE stack */
	add_profile_client();

	return 0;
}
```
